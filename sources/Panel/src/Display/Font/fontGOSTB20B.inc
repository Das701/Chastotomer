/*
    FaceName - GOST type B
    PointSize - 20
    FontWeight - bold
    Style - normal
    Family - default
    Cell width - 25
    Cell height - 25
    Offset x - -2
    Offset y - -7
*/
const unsigned char fontGOSTB20B[5775] =
{
/* 0x00 */   0x00, 0x00,
/* 0x01 */   0x00, 0x00,
/* 0x02 */   0x00, 0x00,
/* 0x03 */   0x00, 0x00,
/* 0x04 */   0x00, 0x00,
/* 0x05 */   0x00, 0x00,
/* 0x06 */   0x00, 0x00,
/* 0x07 */   0x00, 0x00,
/* 0x08 */   0x00, 0x00,
/* 0x09 */   0x00, 0x00,
/* 0x0A */   0x00, 0x00,
/* 0x0B */   0x00, 0x00,
/* 0x0C */   0x00, 0x00,
/* 0x0D */   0x00, 0x00,
/* 0x0E */   0x00, 0x00,
/* 0x0F */   0x00, 0x00,
/* 0x10 */   0x00, 0x00,
/* 0x11 */   0x00, 0x00,
/* 0x12 */   0x00, 0x00,
/* 0x13 */   0x00, 0x00,
/* 0x14 */   0x00, 0x00,
/* 0x15 */   0x00, 0x00,
/* 0x16 */   0x00, 0x00,
/* 0x17 */   0x00, 0x00,
/* 0x18 */   0x00, 0x00,
/* 0x19 */   0x00, 0x00,
/* 0x1A */   0x00, 0x00,
/* 0x1B */   0x00, 0x00,
/* 0x1C */   0x00, 0x00,
/* 0x1D */   0x00, 0x00,
/* 0x1E */   0x00, 0x00,
/* 0x1F */   0x00, 0x00,
/* 0x20 */   0x00, 0x02,
/* 0x21 */   0x07, 0x02,
/* 0x22 */   0x1C, 0x02,
/* 0x23 */   0x24, 0x02,
/* 0x24 */   0x4B, 0x02,
/* 0x25 */   0x7A, 0x02,
/* 0x26 */   0xC5, 0x02,
/* 0x27 */   0xEC, 0x02,
/* 0x28 */   0xF4, 0x02,
/* 0x29 */   0x0C, 0x03,
/* 0x2A */   0x24, 0x03,
/* 0x2B */   0x35, 0x03,
/* 0x2C */   0x4A, 0x03,
/* 0x2D */   0x54, 0x03,
/* 0x2E */   0x59, 0x03,
/* 0x2F */   0x5E, 0x03,
/* 0x30 */   0x8D, 0x03,
/* 0x31 */   0xB4, 0x03,
/* 0x32 */   0xC9, 0x03,
/* 0x33 */   0xF0, 0x03,
/* 0x34 */   0x17, 0x04,
/* 0x35 */   0x3E, 0x04,
/* 0x36 */   0x65, 0x04,
/* 0x37 */   0x8C, 0x04,
/* 0x38 */   0xB3, 0x04,
/* 0x39 */   0xDA, 0x04,
/* 0x3A */   0x01, 0x05,
/* 0x3B */   0x0D, 0x05,
/* 0x3C */   0x1D, 0x05,
/* 0x3D */   0x32, 0x05,
/* 0x3E */   0x41, 0x05,
/* 0x3F */   0x56, 0x05,
/* 0x40 */   0x7D, 0x05,
/* 0x41 */   0xB6, 0x05,
/* 0x42 */   0xDD, 0x05,
/* 0x43 */   0x04, 0x06,
/* 0x44 */   0x2B, 0x06,
/* 0x45 */   0x52, 0x06,
/* 0x46 */   0x79, 0x06,
/* 0x47 */   0xA0, 0x06,
/* 0x48 */   0xC7, 0x06,
/* 0x49 */   0xEE, 0x06,
/* 0x4A */   0x03, 0x07,
/* 0x4B */   0x18, 0x07,
/* 0x4C */   0x3F, 0x07,
/* 0x4D */   0x66, 0x07,
/* 0x4E */   0x8D, 0x07,
/* 0x4F */   0xB4, 0x07,
/* 0x50 */   0xDB, 0x07,
/* 0x51 */   0x02, 0x08,
/* 0x52 */   0x29, 0x08,
/* 0x53 */   0x50, 0x08,
/* 0x54 */   0x77, 0x08,
/* 0x55 */   0x9E, 0x08,
/* 0x56 */   0xC5, 0x08,
/* 0x57 */   0xEC, 0x08,
/* 0x58 */   0x25, 0x09,
/* 0x59 */   0x4C, 0x09,
/* 0x5A */   0x73, 0x09,
/* 0x5B */   0x9A, 0x09,
/* 0x5C */   0xB1, 0x09,
/* 0x5D */   0xE0, 0x09,
/* 0x5E */   0xF7, 0x09,
/* 0x5F */   0xFE, 0x09,
/* 0x60 */   0x05, 0x0A,
/* 0x61 */   0x2C, 0x0A,
/* 0x62 */   0x49, 0x0A,
/* 0x63 */   0x70, 0x0A,
/* 0x64 */   0x80, 0x0A,
/* 0x65 */   0xA7, 0x0A,
/* 0x66 */   0xC4, 0x0A,
/* 0x67 */   0xD9, 0x0A,
/* 0x68 */   0x02, 0x0B,
/* 0x69 */   0x29, 0x0B,
/* 0x6A */   0x3E, 0x0B,
/* 0x6B */   0x58, 0x0B,
/* 0x6C */   0x7F, 0x0B,
/* 0x6D */   0x94, 0x0B,
/* 0x6E */   0xB1, 0x0B,
/* 0x6F */   0xCE, 0x0B,
/* 0x70 */   0xEB, 0x0B,
/* 0x71 */   0x14, 0x0C,
/* 0x72 */   0x3D, 0x0C,
/* 0x73 */   0x4D, 0x0C,
/* 0x74 */   0x6A, 0x0C,
/* 0x75 */   0x7F, 0x0C,
/* 0x76 */   0x9C, 0x0C,
/* 0x77 */   0xB9, 0x0C,
/* 0x78 */   0xD6, 0x0C,
/* 0x79 */   0xF3, 0x0C,
/* 0x7A */   0x1C, 0x0D,
/* 0x7B */   0x39, 0x0D,
/* 0x7C */   0x50, 0x0D,
/* 0x7D */   0x65, 0x0D,
/* 0x7E */   0x7C, 0x0D,
/* 0x7F */   0x85, 0x0D,
/* 0x80 */   0x00, 0x00,
/* 0x81 */   0x00, 0x00,
/* 0x82 */   0x00, 0x00,
/* 0x83 */   0x00, 0x00,
/* 0x84 */   0x00, 0x00,
/* 0x85 */   0x00, 0x00,
/* 0x86 */   0x00, 0x00,
/* 0x87 */   0x00, 0x00,
/* 0x88 */   0x00, 0x00,
/* 0x89 */   0x00, 0x00,
/* 0x8A */   0x00, 0x00,
/* 0x8B */   0x00, 0x00,
/* 0x8C */   0x00, 0x00,
/* 0x8D */   0x00, 0x00,
/* 0x8E */   0x00, 0x00,
/* 0x8F */   0x00, 0x00,
/* 0x90 */   0x00, 0x00,
/* 0x91 */   0x00, 0x00,
/* 0x92 */   0x00, 0x00,
/* 0x93 */   0x00, 0x00,
/* 0x94 */   0x00, 0x00,
/* 0x95 */   0x00, 0x00,
/* 0x96 */   0x00, 0x00,
/* 0x97 */   0x00, 0x00,
/* 0x98 */   0x00, 0x00,
/* 0x99 */   0x00, 0x00,
/* 0x9A */   0x00, 0x00,
/* 0x9B */   0x00, 0x00,
/* 0x9C */   0x00, 0x00,
/* 0x9D */   0x00, 0x00,
/* 0x9E */   0x00, 0x00,
/* 0x9F */   0x00, 0x00,
/* 0xA0 */   0x00, 0x00,
/* 0xA1 */   0x00, 0x00,
/* 0xA2 */   0x00, 0x00,
/* 0xA3 */   0x00, 0x00,
/* 0xA4 */   0x00, 0x00,
/* 0xA5 */   0x00, 0x00,
/* 0xA6 */   0x00, 0x00,
/* 0xA7 */   0x00, 0x00,
/* 0xA8 */   0x00, 0x00,
/* 0xA9 */   0x00, 0x00,
/* 0xAA */   0x00, 0x00,
/* 0xAB */   0x00, 0x00,
/* 0xAC */   0x00, 0x00,
/* 0xAD */   0x00, 0x00,
/* 0xAE */   0x00, 0x00,
/* 0xAF */   0x00, 0x00,
/* 0xB0 */   0x00, 0x00,
/* 0xB1 */   0x00, 0x00,
/* 0xB2 */   0x00, 0x00,
/* 0xB3 */   0x00, 0x00,
/* 0xB4 */   0x00, 0x00,
/* 0xB5 */   0x00, 0x00,
/* 0xB6 */   0x00, 0x00,
/* 0xB7 */   0x00, 0x00,
/* 0xB8 */   0x00, 0x00,
/* 0xB9 */   0x00, 0x00,
/* 0xBA */   0x00, 0x00,
/* 0xBB */   0x00, 0x00,
/* 0xBC */   0x00, 0x00,
/* 0xBD */   0x00, 0x00,
/* 0xBE */   0x00, 0x00,
/* 0xBF */   0x00, 0x00,
/* 0xC0 */   0x9B, 0x0D,
/* 0xC1 */   0xC2, 0x0D,
/* 0xC2 */   0xE9, 0x0D,
/* 0xC3 */   0x10, 0x0E,
/* 0xC4 */   0x37, 0x0E,
/* 0xC5 */   0x62, 0x0E,
/* 0xC6 */   0x89, 0x0E,
/* 0xC7 */   0xB0, 0x0E,
/* 0xC8 */   0xD7, 0x0E,
/* 0xC9 */   0xFE, 0x0E,
/* 0xCA */   0x25, 0x0F,
/* 0xCB */   0x4C, 0x0F,
/* 0xCC */   0x73, 0x0F,
/* 0xCD */   0x9A, 0x0F,
/* 0xCE */   0xC1, 0x0F,
/* 0xCF */   0xE8, 0x0F,
/* 0xD0 */   0x0F, 0x10,
/* 0xD1 */   0x36, 0x10,
/* 0xD2 */   0x5D, 0x10,
/* 0xD3 */   0x84, 0x10,
/* 0xD4 */   0xAB, 0x10,
/* 0xD5 */   0xD2, 0x10,
/* 0xD6 */   0xF9, 0x10,
/* 0xD7 */   0x26, 0x11,
/* 0xD8 */   0x4D, 0x11,
/* 0xD9 */   0x74, 0x11,
/* 0xDA */   0xB6, 0x11,
/* 0xDB */   0xDD, 0x11,
/* 0xDC */   0x04, 0x12,
/* 0xDD */   0x2B, 0x12,
/* 0xDE */   0x52, 0x12,
/* 0xDF */   0x79, 0x12,
/* 0xE0 */   0xA0, 0x12,
/* 0xE1 */   0xBD, 0x12,
/* 0xE2 */   0xE4, 0x12,
/* 0xE3 */   0x0B, 0x13,
/* 0xE4 */   0x28, 0x13,
/* 0xE5 */   0x4F, 0x13,
/* 0xE6 */   0x6C, 0x13,
/* 0xE7 */   0x89, 0x13,
/* 0xE8 */   0xA6, 0x13,
/* 0xE9 */   0xC3, 0x13,
/* 0xEA */   0xEA, 0x13,
/* 0xEB */   0x07, 0x14,
/* 0xEC */   0x24, 0x14,
/* 0xED */   0x41, 0x14,
/* 0xEE */   0x5E, 0x14,
/* 0xEF */   0x7B, 0x14,
/* 0xF0 */   0x98, 0x14,
/* 0xF1 */   0xC1, 0x14,
/* 0xF2 */   0xD1, 0x14,
/* 0xF3 */   0xEE, 0x14,
/* 0xF4 */   0x17, 0x15,
/* 0xF5 */   0x48, 0x15,
/* 0xF6 */   0x65, 0x15,
/* 0xF7 */   0x86, 0x15,
/* 0xF8 */   0xA3, 0x15,
/* 0xF9 */   0xC0, 0x15,
/* 0xFA */   0xE1, 0x15,
/* 0xFB */   0xFE, 0x15,
/* 0xFC */   0x1B, 0x16,
/* 0xFD */   0x38, 0x16,
/* 0xFE */   0x55, 0x16,
/* 0xFF */   0x72, 0x16,

/* Symbol 0x20, offset 512 */
    25, 1, 0,
    0x00, 0x00, 0x00, 0x00, 

/* Symbol 0x21, offset 519 */
    3, 18, 0,
    0xE0, 0xE0, 0xE0, 0xE0, 0xE0, 0xE0, 0xE0, 0xE0, 0xE0, 0xE0, 0xE0, 0xE0, 0xE0, 0xE0, 0x00, 0x00, 0xE0, 0xE0, 

/* Symbol 0x22, offset 540 */
    6, 5, 0,
    0xFC, 0xDC, 0xDC, 0xDC, 0xD8, 

/* Symbol 0x23, offset 548 */
    15, 18, 0,
    0x07, 0x1C, 0x07, 0x1C, 0x07, 0x38, 0x06, 0x38, 0x3F, 0xFE, 0x3F, 0xFE,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 0xC0, 

/* Symbol 0x24, offset 587 */
    12, 22, 0,
    0x3F, 0xC0, 0x7F, 0xF0, 0xE6, 0x60, 0xE6, 0x00, 0xE6, 0x00, 0x76, 0x00,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 0x00, 

/* Symbol 0x25, offset 634 */
    25, 18, 0,
    0x7F, 0x00, 0xE0, 0x00, 0xF7, 0x80, 0xE0, 0x00, 0xE3, 0x81, 0xC0, 0x00,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 0x00, 

/* Symbol 0x26, offset 709 */
    14, 18, 0,
    0x1F, 0x80, 0x1F, 0xC0, 0x38, 0xC0, 0x38, 0xC0, 0x3D, 0xC0, 0x1F, 0x80,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 0x9C, 

/* Symbol 0x27, offset 748 */
    3, 5, 0,
    0xE0, 0xE0, 0xC0, 0xC0, 0xC0, 

/* Symbol 0x28, offset 756 */
    6, 21, 0,
    0x3C, 0x38, 0x70, 0x70, 0x70, 0xE0, 0xE0, 0xE0, 0xE0, 0xE0, 0xE0, 0xE0, 0xE0, 0xE0, 0x60, 0x70, 0x70, 0x70, 0x38, 0x38, 0x1C, 

/* Symbol 0x29, offset 780 */
    5, 21, 0,
    0xE0, 0x70, 0x70, 0x70, 0x38, 0x38, 0x38, 0x38, 0x38, 0x38, 0x38, 0x38, 0x38, 0x38, 0x38, 0x30, 0x70, 0x70, 0xE0, 0xE0, 0xC0, 

/* Symbol 0x2A, offset 804 */
    9, 7, 0,
    0x77, 0x00, 0x3E, 0x00, 0xFF, 0x80, 0xFF, 0x80, 0x3E, 0x00, 0x3F, 0x00, 0x77, 0x00, 

/* Symbol 0x2B, offset 821 */
    10, 16, 7,
    0x0C, 0x00, 0x0C, 0x00, 0x0C, 0x00, 0x0C, 0x00, 0xFF, 0xC0, 0x0C, 0x00, 0x0C, 0x00, 0x0C, 0x00, 0x0C, 0x00, 

/* Symbol 0x2C, offset 842 */
    3, 22, 15,
    0xE0, 0xE0, 0xE0, 0xC0, 0xC0, 0xC0, 0xC0, 

/* Symbol 0x2D, offset 852 */
    10, 12, 11,
    0xFF, 0xC0, 

/* Symbol 0x2E, offset 857 */
    3, 18, 16,
    0xE0, 0xE0, 

/* Symbol 0x2F, offset 862 */
    11, 22, 0,
    0x00, 0xE0, 0x01, 0xC0, 0x01, 0xC0, 0x01, 0xC0, 0x03, 0x80, 0x03, 0x80,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 0x00, 

/* Symbol 0x30, offset 909 */
    10, 18, 0,
    0x7F, 0x80, 0xF3, 0x80, 0xE1, 0xC0, 0xE1, 0xC0, 0xE1, 0xC0, 0xE1, 0xC0,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 0x00, 

/* Symbol 0x31, offset 948 */
    6, 18, 0,
    0x1C, 0x3C, 0x7C, 0xFC, 0xEC, 0x0C, 0x0C, 0x0C, 0x0C, 0x0C, 0x0C, 0x0C, 0x0C, 0x0C, 0x0C, 0x0C, 0x0C, 0x0C, 

/* Symbol 0x32, offset 969 */
    10, 18, 0,
    0x7F, 0x00, 0xF7, 0x80, 0xE3, 0xC0, 0x01, 0xC0, 0x01, 0xC0, 0x01, 0xC0,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 0xC0, 

/* Symbol 0x33, offset 1008 */
    10, 18, 0,
    0xFF, 0x00, 0x07, 0x80, 0x01, 0xC0, 0x01, 0xC0, 0x01, 0xC0, 0x01, 0xC0,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 0x00, 

/* Symbol 0x34, offset 1047 */
    12, 18, 0,
    0x1C, 0x00, 0x1C, 0x00, 0x1C, 0x00, 0x1C, 0x00, 0x38, 0x00, 0x38, 0x00,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 0x80, 

/* Symbol 0x35, offset 1086 */
    10, 18, 0,
    0xFF, 0xC0, 0xE0, 0x00, 0xE0, 0x00, 0xE0, 0x00, 0xE0, 0x00, 0xE0, 0x00,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 0x00, 

/* Symbol 0x36, offset 1125 */
    10, 18, 0,
    0x0F, 0x00, 0x1E, 0x00, 0x3C, 0x00, 0x78, 0x00, 0x70, 0x00, 0x70, 0x00,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 0x00, 

/* Symbol 0x37, offset 1164 */
    10, 18, 0,
    0xFF, 0xC0, 0xE1, 0xC0, 0xE1, 0xC0, 0x03, 0x80, 0x03, 0x80, 0x03, 0x80,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 0x00, 

/* Symbol 0x38, offset 1203 */
    12, 18, 0,
    0x3F, 0x80, 0x3F, 0xC0, 0x70, 0xE0, 0x70, 0xE0, 0x70, 0xE0, 0x70, 0xE0,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 0x80, 

/* Symbol 0x39, offset 1242 */
    10, 18, 0,
    0x7F, 0x80, 0xF3, 0xC0, 0xE1, 0xC0, 0xE1, 0xC0, 0xE1, 0xC0, 0xE1, 0xC0,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 0x00, 

/* Symbol 0x3A, offset 1281 */
    3, 18, 9,
    0xE0, 0xC0, 0x00, 0x00, 0x00, 0x00, 0x00, 0xE0, 0xE0, 

/* Symbol 0x3B, offset 1293 */
    3, 22, 9,
    0xE0, 0xC0, 0x00, 0x00, 0x00, 0x00, 0x00, 0xE0, 0xE0, 0xC0, 0xC0, 0xC0, 0xC0, 

/* Symbol 0x3C, offset 1309 */
    10, 16, 7,
    0x01, 0xC0, 0x07, 0xC0, 0x1F, 0x00, 0x7C, 0x00, 0xF0, 0x00, 0x7C, 0x00, 0x1F, 0x00, 0x07, 0xC0, 0x01, 0xC0, 

/* Symbol 0x3D, offset 1330 */
    10, 14, 8,
    0xFF, 0xC0, 0xFF, 0xC0, 0x00, 0x00, 0x00, 0x00, 0xFF, 0x80, 0xFF, 0xC0, 

/* Symbol 0x3E, offset 1345 */
    10, 16, 7,
    0xE0, 0x00, 0xF8, 0x00, 0x3E, 0x00, 0x0F, 0x80, 0x03, 0xC0, 0x0F, 0x80, 0x3E, 0x00, 0xF8, 0x00, 0xE0, 0x00, 

/* Symbol 0x3F, offset 1366 */
    10, 18, 0,
    0x7F, 0x00, 0xFF, 0x80, 0xE1, 0xC0, 0x01, 0xC0, 0x01, 0xC0, 0x03, 0xC0,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 0x00, 

/* Symbol 0x40, offset 1405 */
    19, 18, 0,
    0x07, 0xFC, 0x00, 0x1F, 0xBF, 0x00, 0x3C, 0x07, 0x80, 0x78, 0x03, 0xC0,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 0x00, 

/* Symbol 0x41, offset 1462 */
    14, 18, 0,
    0x07, 0x00, 0x07, 0x80, 0x07, 0x80, 0x0F, 0x80, 0x0F, 0xC0, 0x0F, 0xC0,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 0x1C, 

/* Symbol 0x42, offset 1501 */
    12, 18, 0,
    0xFF, 0xC0, 0xE1, 0xE0, 0xE0, 0xE0, 0xE0, 0xE0, 0xE0, 0xE0, 0xE0, 0xE0,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 0xC0, 

/* Symbol 0x43, offset 1540 */
    10, 18, 0,
    0x7F, 0xC0, 0xF0, 0x00, 0xE0, 0x00, 0xE0, 0x00, 0xE0, 0x00, 0xE0, 0x00,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 0xC0, 

/* Symbol 0x44, offset 1579 */
    12, 18, 0,
    0xFF, 0xE0, 0xE0, 0xE0, 0xE0, 0x70, 0xE0, 0x70, 0xE0, 0x70, 0xE0, 0x70,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 0xC0, 

/* Symbol 0x45, offset 1618 */
    10, 18, 0,
    0xFF, 0xC0, 0xE0, 0x00, 0xE0, 0x00, 0xE0, 0x00, 0xE0, 0x00, 0xE0, 0x00,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 0xC0, 

/* Symbol 0x46, offset 1657 */
    10, 18, 0,
    0xFF, 0xC0, 0xE0, 0x00, 0xE0, 0x00, 0xE0, 0x00, 0xE0, 0x00, 0xE0, 0x00,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 0x00, 

/* Symbol 0x47, offset 1696 */
    12, 18, 0,
    0x7F, 0xF0, 0xF0, 0x00, 0xE0, 0x00, 0xE0, 0x00, 0xE0, 0x00, 0xE0, 0x00,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 0xF0, 

/* Symbol 0x48, offset 1735 */
    12, 18, 0,
    0xE0, 0x70, 0xE0, 0x70, 0xE0, 0x70, 0xE0, 0x70, 0xE0, 0x70, 0xE0, 0x70,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 0x70, 

/* Symbol 0x49, offset 1774 */
    3, 18, 0,
    0xE0, 0xE0, 0xE0, 0xE0, 0xE0, 0xE0, 0xE0, 0xE0, 0xE0, 0xE0, 0xE0, 0xE0, 0xE0, 0xE0, 0xE0, 0xE0, 0xE0, 0xE0, 

/* Symbol 0x4A, offset 1795 */
    8, 18, 0,
    0x07, 0x07, 0x07, 0x07, 0x07, 0x07, 0x07, 0x07, 0x07, 0x07, 0x07, 0x07, 0x07, 0x07, 0x07, 0x07, 0xFF, 0xFC, 

/* Symbol 0x4B, offset 1816 */
    12, 18, 0,
    0xE0, 0x70, 0xE0, 0xE0, 0xE1, 0xC0, 0xE3, 0x80, 0xE7, 0x00, 0xEE, 0x00,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 0x70, 

/* Symbol 0x4C, offset 1855 */
    10, 18, 0,
    0xE0, 0x00, 0xE0, 0x00, 0xE0, 0x00, 0xE0, 0x00, 0xE0, 0x00, 0xE0, 0x00,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 0xC0, 

/* Symbol 0x4D, offset 1894 */
    14, 18, 0,
    0xE0, 0x1C, 0xE0, 0x3C, 0xF0, 0x3C, 0xF8, 0x7C, 0xF8, 0xFC, 0xFC, 0xFC,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 0x1C, 

/* Symbol 0x4E, offset 1933 */
    12, 18, 0,
    0xE0, 0x70, 0xE0, 0x70, 0xF0, 0x70, 0xF0, 0x70, 0xF8, 0x70, 0xFC, 0x70,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 0x70, 

/* Symbol 0x4F, offset 1972 */
    12, 18, 0,
    0x7F, 0xE0, 0xF0, 0xE0, 0xE0, 0x70, 0xE0, 0x70, 0xE0, 0x70, 0xE0, 0x70,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 0xC0, 

/* Symbol 0x50, offset 2011 */
    12, 18, 0,
    0xFF, 0xE0, 0xE0, 0xE0, 0xE0, 0x70, 0xE0, 0x70, 0xE0, 0x70, 0xE0, 0x70,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 0x00, 

/* Symbol 0x51, offset 2050 */
    14, 18, 0,
    0x7F, 0xE0, 0xF0, 0xE0, 0xE0, 0x70, 0xE0, 0x70, 0xE0, 0x70, 0xE0, 0x70,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 0xDC, 

/* Symbol 0x52, offset 2089 */
    12, 18, 0,
    0xFF, 0xE0, 0xE0, 0xE0, 0xE0, 0x70, 0xE0, 0x70, 0xE0, 0x70, 0xE0, 0x70,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 0x70, 

/* Symbol 0x53, offset 2128 */
    12, 18, 0,
    0x3F, 0xC0, 0x79, 0xF0, 0xE0, 0x60, 0xE0, 0x00, 0xE0, 0x00, 0xF0, 0x00,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 0x80, 

/* Symbol 0x54, offset 2167 */
    12, 18, 0,
    0xFF, 0xF0, 0x0E, 0x00, 0x0E, 0x00, 0x0E, 0x00, 0x0E, 0x00, 0x0E, 0x00,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 0x00, 

/* Symbol 0x55, offset 2206 */
    12, 18, 0,
    0xE0, 0x70, 0xE0, 0x70, 0xE0, 0x70, 0xE0, 0x70, 0xE0, 0x70, 0xE0, 0x70,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 0xC0, 

/* Symbol 0x56, offset 2245 */
    14, 18, 0,
    0xE0, 0x1C, 0xE0, 0x18, 0xE0, 0x38, 0x70, 0x38, 0x70, 0x30, 0x70, 0x70,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 0x00, 

/* Symbol 0x57, offset 2284 */
    17, 18, 0,
    0xE0, 0x01, 0x80, 0xE0, 0x03, 0x80, 0xE0, 0x03, 0x80, 0xE0, 0x03, 0x80,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 0x00, 

/* Symbol 0x58, offset 2341 */
    14, 18, 0,
    0xE0, 0x1C, 0xF0, 0x38, 0x70, 0x78, 0x38, 0x70, 0x3C, 0xE0, 0x1D, 0xE0,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 0x1C, 

/* Symbol 0x59, offset 2380 */
    14, 18, 0,
    0xE0, 0x1C, 0xF0, 0x38, 0x70, 0x78, 0x38, 0x70, 0x1C, 0xE0, 0x1D, 0xE0,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 0x00, 

/* Symbol 0x5A, offset 2419 */
    14, 18, 0,
    0xFF, 0xFC, 0x00, 0x38, 0x00, 0x78, 0x00, 0x70, 0x00, 0xE0, 0x01, 0xE0,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 0xFC, 

/* Symbol 0x5B, offset 2458 */
    5, 20, 0,
    0xE0, 0xE0, 0xE0, 0xE0, 0xE0, 0xE0, 0xE0, 0xE0, 0xE0, 0xE0, 0xE0, 0xE0, 0xE0, 0xE0, 0xE0, 0xE0, 0xE0, 0xE0, 0xF8, 0xF0, 

/* Symbol 0x5C, offset 2481 */
    11, 22, 0,
    0xE0, 0x00, 0xE0, 0x00, 0x70, 0x00, 0x70, 0x00, 0x38, 0x00, 0x38, 0x00,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 0xC0, 

/* Symbol 0x5D, offset 2528 */
    4, 20, 0,
    0x70, 0x70, 0x70, 0x70, 0x70, 0x70, 0x70, 0x70, 0x70, 0x70, 0x70, 0x70, 0x70, 0x70, 0x70, 0x70, 0x70, 0x70, 0xF0, 0xF0, 

/* Symbol 0x5E, offset 2551 */
    25, 1, 0,
    0x00, 0x00, 0x00, 0x00, 

/* Symbol 0x5F, offset 2558 */
    10, 21, 19,
    0xFF, 0xC0, 0xFF, 0xC0, 

/* Symbol 0x60, offset 2565 */
    12, 18, 0,
    0x80, 0x30, 0x80, 0x30, 0x80, 0x30, 0x80, 0x30, 0x80, 0x30, 0x80, 0x30,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 0xF0, 

/* Symbol 0x61, offset 2604 */
    12, 18, 5,
    0x3F, 0xC0, 0x7F, 0xC0, 0xE1, 0xC0, 0xE1, 0xC0, 0xE1, 0xC0, 0xE1, 0xC0, 0xE1, 0xC0, 0xE1, 0xC0, 0xE1, 0xC0, 0xE1, 0xC0, 0xE1, 0xC0, 0x7F, 0xF0, 0x3F, 0x70, 

/* Symbol 0x62, offset 2633 */
    10, 18, 0,
    0xE0, 0x00, 0xE0, 0x00, 0xE0, 0x00, 0xE0, 0x00, 0xE0, 0x00, 0xFF, 0x00,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 0x00, 

/* Symbol 0x63, offset 2672 */
    8, 18, 5,
    0x3F, 0x7F, 0xE0, 0xE0, 0xE0, 0xE0, 0xE0, 0xE0, 0xE0, 0xE0, 0xE0, 0x7F, 0x3F, 

/* Symbol 0x64, offset 2688 */
    10, 18, 0,
    0x01, 0xC0, 0x01, 0xC0, 0x01, 0xC0, 0x01, 0xC0, 0x01, 0xC0, 0x3F, 0xC0,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 0xC0, 

/* Symbol 0x65, offset 2727 */
    10, 18, 5,
    0x3F, 0x00, 0x7F, 0x80, 0xE1, 0xC0, 0xE1, 0xC0, 0xE1, 0xC0, 0xE1, 0xC0, 0xFF, 0xC0, 0xE0, 0x00, 0xE0, 0x00, 0xE0, 0x00, 0xE0, 0x00, 0x7F, 0xC0, 0x3F, 0xC0, 

/* Symbol 0x66, offset 2756 */
    7, 18, 0,
    0x3E, 0x78, 0x70, 0x70, 0x70, 0xFE, 0xFE, 0x70, 0x70, 0x70, 0x70, 0x70, 0x70, 0x70, 0x70, 0x70, 0x70, 0x70, 

/* Symbol 0x67, offset 2777 */
    10, 24, 5,
    0x3F, 0xC0, 0x7F, 0xC0, 0xE1, 0xC0, 0xE1, 0xC0, 0xE1, 0xC0, 0xE1, 0xC0,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 0x00, 

/* Symbol 0x68, offset 2818 */
    10, 18, 0,
    0xE0, 0x00, 0xE0, 0x00, 0xE0, 0x00, 0xE0, 0x00, 0xE0, 0x00, 0xFF, 0x00,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 0xC0, 

/* Symbol 0x69, offset 2857 */
    3, 18, 0,
    0xE0, 0x00, 0x00, 0x00, 0x00, 0xE0, 0xE0, 0xE0, 0xE0, 0xE0, 0xE0, 0xE0, 0xE0, 0xE0, 0xE0, 0xE0, 0xE0, 0xE0, 

/* Symbol 0x6A, offset 2878 */
    3, 23, 0,
    0xE0, 0x00, 0x00, 0x00, 0x00, 0xE0, 0xE0, 0xE0, 0xE0, 0xE0, 0xE0, 0xE0, 0xE0, 0xE0, 0xE0, 0xE0, 0xE0, 0xE0, 0xE0, 0xE0, 0xE0, 0xC0, 0xC0, 

/* Symbol 0x6B, offset 2904 */
    10, 18, 0,
    0xE0, 0x00, 0xE0, 0x00, 0xE0, 0x00, 0xE0, 0x00, 0xE0, 0x00, 0xE1, 0xC0,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 0xC0, 

/* Symbol 0x6C, offset 2943 */
    5, 18, 0,
    0xE0, 0xE0, 0xE0, 0xE0, 0xE0, 0xE0, 0xE0, 0xE0, 0xE0, 0xE0, 0xE0, 0xE0, 0xE0, 0xE0, 0xE0, 0xE0, 0xF0, 0x78, 

/* Symbol 0x6D, offset 2964 */
    14, 18, 5,
    0xFF, 0xF0, 0xFF, 0xF8, 0xE7, 0x3C, 0xE7, 0x1C, 0xE7, 0x1C, 0xE7, 0x1C, 0xE7, 0x1C, 0xE7, 0x1C, 0xE7, 0x1C, 0xE7, 0x1C, 0xE7, 0x1C, 0xE7, 0x1C, 0xE7, 0x1C, 

/* Symbol 0x6E, offset 2993 */
    10, 18, 5,
    0xFF, 0x00, 0xFF, 0x80, 0xE1, 0xC0, 0xE1, 0xC0, 0xE1, 0xC0, 0xE1, 0xC0, 0xE1, 0xC0, 0xE1, 0xC0, 0xE1, 0xC0, 0xE1, 0xC0, 0xE1, 0xC0, 0xE1, 0xC0, 0xE1, 0xC0, 

/* Symbol 0x6F, offset 3022 */
    10, 18, 5,
    0x3F, 0x00, 0x7F, 0x80, 0xE1, 0xC0, 0xE1, 0xC0, 0xE1, 0xC0, 0xE1, 0xC0, 0xE1, 0xC0, 0xE1, 0xC0, 0xE1, 0xC0, 0xE1, 0xC0, 0xE1, 0xC0, 0x7F, 0x80, 0x3F, 0x00, 

/* Symbol 0x70, offset 3051 */
    10, 24, 5,
    0xFF, 0x00, 0xFF, 0x80, 0xE1, 0xC0, 0xE1, 0xC0, 0xE1, 0xC0, 0xE1, 0xC0,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 0x00, 

/* Symbol 0x71, offset 3092 */
    10, 24, 5,
    0x3F, 0xC0, 0x7F, 0xC0, 0xE1, 0xC0, 0xE1, 0xC0, 0xE1, 0xC0, 0xE1, 0xC0,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 0x80, 

/* Symbol 0x72, offset 3133 */
    8, 18, 5,
    0xFE, 0xFF, 0xE7, 0xE3, 0xE0, 0xE0, 0xE0, 0xE0, 0xE0, 0xE0, 0xE0, 0xE0, 0xE0, 

/* Symbol 0x73, offset 3149 */
    10, 18, 5,
    0x3F, 0x00, 0x7F, 0xC0, 0xE1, 0xC0, 0xE0, 0x00, 0xF0, 0x00, 0x7C, 0x00, 0x1E, 0x00, 0x0F, 0x80, 0x03, 0xC0, 0x01, 0xC0, 0xE1, 0xC0, 0xFF, 0x80, 0x3F, 0x00, 

/* Symbol 0x74, offset 3178 */
    8, 18, 0,
    0x38, 0x38, 0x38, 0x38, 0x38, 0xFF, 0xFF, 0x38, 0x38, 0x38, 0x38, 0x38, 0x38, 0x38, 0x38, 0x38, 0x38, 0x30, 

/* Symbol 0x75, offset 3199 */
    10, 18, 5,
    0xE1, 0xC0, 0xE1, 0xC0, 0xE1, 0xC0, 0xE1, 0xC0, 0xE1, 0xC0, 0xE1, 0xC0, 0xE1, 0xC0, 0xE1, 0xC0, 0xE1, 0xC0, 0xE1, 0xC0, 0xE1, 0xC0, 0x7F, 0xC0, 0x3F, 0xC0, 

/* Symbol 0x76, offset 3228 */
    10, 18, 5,
    0xE1, 0xC0, 0xE1, 0xC0, 0xE1, 0xC0, 0x73, 0x80, 0x73, 0x80, 0x73, 0x80, 0x3F, 0x00, 0x3F, 0x00, 0x3F, 0x00, 0x1E, 0x00, 0x1E, 0x00, 0x1E, 0x00, 0x0C, 0x00, 

/* Symbol 0x77, offset 3257 */
    14, 18, 5,
    0xE0, 0x1C, 0xE0, 0x1C, 0xE0, 0x18, 0xE0, 0x38, 0x77, 0x38, 0x77, 0xB8, 0x77, 0xB0, 0x7F, 0xF0, 0x3F, 0xF0, 0x3D, 0xF0, 0x3D, 0xE0, 0x3C, 0xE0, 0x18, 0xE0, 

/* Symbol 0x78, offset 3286 */
    10, 18, 5,
    0xE1, 0xC0, 0xE1, 0xC0, 0x73, 0x80, 0x7F, 0x80, 0x3F, 0x00, 0x1E, 0x00, 0x1E, 0x00, 0x1E, 0x00, 0x3F, 0x00, 0x7F, 0x80, 0x73, 0x80, 0xE1, 0xC0, 0xE1, 0xC0, 

/* Symbol 0x79, offset 3315 */
    10, 24, 5,
    0xC1, 0xC0, 0xE1, 0xC0, 0xE1, 0x80, 0xE3, 0x80, 0x73, 0x80, 0x73, 0x80,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 0x00, 

/* Symbol 0x7A, offset 3356 */
    10, 18, 5,
    0xFF, 0xC0, 0xFF, 0xC0, 0x03, 0x80, 0x07, 0x80, 0x07, 0x00, 0x0E, 0x00, 0x1E, 0x00, 0x1C, 0x00, 0x38, 0x00, 0x78, 0x00, 0x70, 0x00, 0xFF, 0xC0, 0xFF, 0xC0, 

/* Symbol 0x7B, offset 3385 */
    7, 20, 0,
    0x38, 0x38, 0x38, 0x38, 0x38, 0x38, 0x38, 0x38, 0xF0, 0xF0, 0x38, 0x38, 0x38, 0x38, 0x38, 0x38, 0x38, 0x38, 0x3C, 0x1E, 

/* Symbol 0x7C, offset 3408 */
    7, 18, 0,
    0xEE, 0xEE, 0xEE, 0xEE, 0xEE, 0xEE, 0xEE, 0xEE, 0xEE, 0xEE, 0xEE, 0xEE, 0xEE, 0xEE, 0xEE, 0xEE, 0xEE, 0xE6, 

/* Symbol 0x7D, offset 3429 */
    6, 20, 0,
    0x38, 0x38, 0x38, 0x38, 0x38, 0x38, 0x38, 0x38, 0x3C, 0x3C, 0x38, 0x38, 0x38, 0x38, 0x38, 0x38, 0x38, 0x38, 0xF0, 0xE0, 

/* Symbol 0x7E, offset 3452 */
    12, 13, 10,
    0x7E, 0x00, 0xFF, 0xF0, 0x07, 0xE0, 

/* Symbol 0x7F, offset 3461 */
    6, 19, 0,
    0x8C, 0x8C, 0x8C, 0x8C, 0x8C, 0x8C, 0x8C, 0x8C, 0x8C, 0x8C, 0x8C, 0x8C, 0x8C, 0x8C, 0x8C, 0x8C, 0x8C, 0x8C, 0xFC, 

/* Symbol 0xC0, offset 3483 */
    14, 18, 0,
    0x07, 0x00, 0x07, 0x80, 0x07, 0x80, 0x0F, 0x80, 0x0F, 0xC0, 0x0F, 0xC0,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 0x1C, 

/* Symbol 0xC1, offset 3522 */
    12, 18, 0,
    0xFF, 0xC0, 0xE0, 0x00, 0xE0, 0x00, 0xE0, 0x00, 0xE0, 0x00, 0xE0, 0x00,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 0xC0, 

/* Symbol 0xC2, offset 3561 */
    12, 18, 0,
    0xFF, 0xC0, 0xE1, 0xE0, 0xE0, 0xE0, 0xE0, 0xE0, 0xE0, 0xE0, 0xE0, 0xE0,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 0xC0, 

/* Symbol 0xC3, offset 3600 */
    10, 18, 0,
    0xFF, 0xC0, 0xE0, 0x00, 0xE0, 0x00, 0xE0, 0x00, 0xE0, 0x00, 0xE0, 0x00,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 0x00, 

/* Symbol 0xC4, offset 3639 */
    14, 20, 0,
    0x0F, 0xF0, 0x1C, 0x70, 0x1C, 0x70, 0x1C, 0x70, 0x1C, 0x70, 0x1C, 0x70,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 0x1C, 

/* Symbol 0xC5, offset 3682 */
    10, 18, 0,
    0xFF, 0xC0, 0xE0, 0x00, 0xE0, 0x00, 0xE0, 0x00, 0xE0, 0x00, 0xE0, 0x00,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 0xC0, 

/* Symbol 0xC6, offset 3721 */
    16, 18, 0,
    0xE3, 0x87, 0xF3, 0x8E, 0x73, 0x9C, 0x3B, 0xBC, 0x3F, 0xB8, 0x1F, 0xF0,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 0x87, 

/* Symbol 0xC7, offset 3760 */
    10, 18, 0,
    0x7F, 0x80, 0xF3, 0xC0, 0xE1, 0xC0, 0x01, 0xC0, 0x01, 0xC0, 0x01, 0xC0,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 0x00, 

/* Symbol 0xC8, offset 3799 */
    12, 18, 0,
    0xE0, 0x70, 0xE0, 0xF0, 0xE0, 0xF0, 0xE1, 0xF0, 0xE1, 0xF0, 0xE3, 0xF0,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 0x70, 

/* Symbol 0xC9, offset 3838 */
    12, 18, 0,
    0xE0, 0x70, 0xE0, 0xF0, 0xE0, 0xF0, 0xE1, 0xF0, 0xE1, 0xF0, 0xE3, 0xF0,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 0x70, 

/* Symbol 0xCA, offset 3877 */
    12, 18, 0,
    0xE0, 0x70, 0xE0, 0xE0, 0xE1, 0xC0, 0xE3, 0x80, 0xE7, 0x00, 0xEE, 0x00,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 0x70, 

/* Symbol 0xCB, offset 3916 */
    12, 18, 0,
    0x0F, 0xF0, 0x0E, 0x70, 0x0E, 0x70, 0x0C, 0x70, 0x1C, 0x70, 0x1C, 0x70,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 0x70, 

/* Symbol 0xCC, offset 3955 */
    14, 18, 0,
    0xE0, 0x1C, 0xE0, 0x3C, 0xF0, 0x3C, 0xF8, 0x7C, 0xF8, 0xFC, 0xFC, 0xFC,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 0x1C, 

/* Symbol 0xCD, offset 3994 */
    12, 18, 0,
    0xE0, 0x70, 0xE0, 0x70, 0xE0, 0x70, 0xE0, 0x70, 0xE0, 0x70, 0xE0, 0x70,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 0x70, 

/* Symbol 0xCE, offset 4033 */
    12, 18, 0,
    0x7F, 0xE0, 0xF0, 0xE0, 0xE0, 0x70, 0xE0, 0x70, 0xE0, 0x70, 0xE0, 0x70,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 0xC0, 

/* Symbol 0xCF, offset 4072 */
    12, 18, 0,
    0xFF, 0xF0, 0xE0, 0x70, 0xE0, 0x70, 0xE0, 0x70, 0xE0, 0x70, 0xE0, 0x70,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 0x70, 

/* Symbol 0xD0, offset 4111 */
    12, 18, 0,
    0xFF, 0xE0, 0xE0, 0xE0, 0xE0, 0x70, 0xE0, 0x70, 0xE0, 0x70, 0xE0, 0x70,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 0x00, 

/* Symbol 0xD1, offset 4150 */
    10, 18, 0,
    0x7F, 0xC0, 0xF0, 0x00, 0xE0, 0x00, 0xE0, 0x00, 0xE0, 0x00, 0xE0, 0x00,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 0xC0, 

/* Symbol 0xD2, offset 4189 */
    12, 18, 0,
    0xFF, 0xF0, 0x0E, 0x00, 0x0E, 0x00, 0x0E, 0x00, 0x0E, 0x00, 0x0E, 0x00,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 0x00, 

/* Symbol 0xD3, offset 4228 */
    12, 18, 0,
    0xE0, 0x70, 0xE0, 0x70, 0xE0, 0x70, 0xE0, 0x70, 0xE0, 0x70, 0xE0, 0x70,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 0xC0, 

/* Symbol 0xD4, offset 4267 */
    16, 18, 0,
    0x03, 0x80, 0x03, 0x80, 0x0F, 0xF0, 0x3F, 0xFC, 0x7B, 0x9C, 0xF3, 0x8E,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 0x80, 

/* Symbol 0xD5, offset 4306 */
    14, 18, 0,
    0xE0, 0x1C, 0xF0, 0x38, 0x70, 0x78, 0x38, 0x70, 0x3C, 0xE0, 0x1D, 0xE0,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 0x1C, 

/* Symbol 0xD6, offset 4345 */
    14, 21, 0,
    0xE0, 0x70, 0xE0, 0x70, 0xE0, 0x70, 0xE0, 0x70, 0xE0, 0x70, 0xE0, 0x70,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 0x1C, 

/* Symbol 0xD7, offset 4390 */
    12, 18, 0,
    0xE0, 0x70, 0xE0, 0x70, 0xE0, 0x70, 0xE0, 0x70, 0xE0, 0x70, 0xE0, 0x70,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 0x70, 

/* Symbol 0xD8, offset 4429 */
    16, 18, 0,
    0xE3, 0x87, 0xE3, 0x87, 0xE3, 0x87, 0xE3, 0x87, 0xE3, 0x87, 0xE3, 0x87,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 0xFF, 

/* Symbol 0xD9, offset 4468 */
    17, 21, 0,
    0xE3, 0x87, 0x00, 0xE3, 0x87, 0x00, 0xE3, 0x87, 0x00, 0xE3, 0x87, 0x00,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 0x80, 

/* Symbol 0xDA, offset 4534 */
    16, 18, 0,
    0xFC, 0x00, 0x0C, 0x00, 0x0C, 0x00, 0x0C, 0x00, 0x0C, 0x00, 0x0C, 0x00,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 0xFC, 

/* Symbol 0xDB, offset 4573 */
    14, 18, 0,
    0xE0, 0x1C, 0xE0, 0x1C, 0xE0, 0x1C, 0xE0, 0x1C, 0xE0, 0x1C, 0xE0, 0x1C,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 0x1C, 

/* Symbol 0xDC, offset 4612 */
    12, 18, 0,
    0xE0, 0x00, 0xE0, 0x00, 0xE0, 0x00, 0xE0, 0x00, 0xE0, 0x00, 0xE0, 0x00,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 0xC0, 

/* Symbol 0xDD, offset 4651 */
    12, 18, 0,
    0xFF, 0xE0, 0x00, 0xE0, 0x00, 0x70, 0x00, 0x70, 0x00, 0x70, 0x00, 0x70,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 0xC0, 

/* Symbol 0xDE, offset 4690 */
    14, 18, 0,
    0xE7, 0xF8, 0xEF, 0x38, 0xEE, 0x1C, 0xEC, 0x1C, 0xEC, 0x1C, 0xEC, 0x1C,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 0xF0, 

/* Symbol 0xDF, offset 4729 */
    12, 18, 0,
    0x7F, 0xF0, 0xF0, 0x70, 0xE0, 0x70, 0xE0, 0x70, 0xE0, 0x70, 0xE0, 0x70,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 0x70, 

/* Symbol 0xE0, offset 4768 */
    12, 18, 5,
    0x3F, 0xC0, 0x7F, 0xC0, 0xE1, 0xC0, 0xE1, 0xC0, 0xE1, 0xC0, 0xE1, 0xC0, 0xE1, 0xC0, 0xE1, 0xC0, 0xE1, 0xC0, 0xE1, 0xC0, 0xE1, 0xC0, 0x7F, 0xF0, 0x3F, 0x70, 

/* Symbol 0xE1, offset 4797 */
    10, 18, 0,
    0xFF, 0xC0, 0x70, 0x00, 0x38, 0x00, 0x1C, 0x00, 0x0E, 0x00, 0x3F, 0x00,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 0x00, 

/* Symbol 0xE2, offset 4836 */
    10, 18, 0,
    0x7E, 0x00, 0xFE, 0x00, 0xE6, 0x00, 0xEE, 0x00, 0xFE, 0x00, 0xFF, 0x00,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 0x00, 

/* Symbol 0xE3, offset 4875 */
    10, 18, 5,
    0x3F, 0x00, 0xFF, 0x80, 0xE1, 0xC0, 0x01, 0xC0, 0x03, 0xC0, 0x0F, 0x80, 0x1E, 0x00, 0x7C, 0x00, 0xF0, 0x00, 0xE0, 0x00, 0xE0, 0xC0, 0xFF, 0xC0, 0x7F, 0x80, 

/* Symbol 0xE4, offset 4904 */
    10, 18, 0,
    0x7F, 0x80, 0x03, 0xC0, 0x01, 0xC0, 0x01, 0xC0, 0x01, 0xC0, 0x3F, 0xC0,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 0x00, 

/* Symbol 0xE5, offset 4943 */
    10, 18, 5,
    0x3F, 0x00, 0x7F, 0x80, 0xE1, 0xC0, 0xE1, 0xC0, 0xE1, 0xC0, 0xE1, 0xC0, 0xFF, 0xC0, 0xE0, 0x00, 0xE0, 0x00, 0xE0, 0x00, 0xE0, 0x00, 0x7F, 0xC0, 0x3F, 0xC0, 

/* Symbol 0xE6, offset 4972 */
    14, 18, 5,
    0xC7, 0x18, 0xE7, 0x3C, 0xF7, 0x38, 0x77, 0x70, 0x3F, 0xE0, 0x3F, 0xE0, 0x1F, 0xC0, 0x1F, 0xE0, 0x3F, 0xE0, 0x77, 0x70, 0x77, 0x78, 0xE7, 0x38, 0xC7, 0x1C, 

/* Symbol 0xE7, offset 5001 */
    9, 18, 5,
    0x7E, 0x00, 0xFF, 0x00, 0xE3, 0x80, 0x03, 0x80, 0x03, 0x80, 0x07, 0x80, 0x1F, 0x00, 0x07, 0x80, 0x03, 0x80, 0x03, 0x80, 0xC3, 0x80, 0xFF, 0x80, 0x7E, 0x00, 

/* Symbol 0xE8, offset 5030 */
    10, 18, 5,
    0xE1, 0xC0, 0xE1, 0xC0, 0xE1, 0xC0, 0xE1, 0xC0, 0xE1, 0xC0, 0xE1, 0xC0, 0xE1, 0xC0, 0xE1, 0xC0, 0xE1, 0xC0, 0xE1, 0xC0, 0xE1, 0xC0, 0x7F, 0xC0, 0x3F, 0xC0, 

/* Symbol 0xE9, offset 5059 */
    10, 18, 0,
    0x3F, 0x00, 0x00, 0x00, 0x00, 0x00, 0x00, 0x00, 0x00, 0x00, 0xE1, 0xC0,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 0xC0, 

/* Symbol 0xEA, offset 5098 */
    10, 18, 5,
    0xC1, 0xC0, 0xE3, 0xC0, 0xE7, 0x80, 0xEF, 0x00, 0xFE, 0x00, 0xFC, 0x00, 0xFC, 0x00, 0xFE, 0x00, 0xE7, 0x00, 0xE7, 0x00, 0xE3, 0x80, 0xE1, 0xC0, 0xC1, 0xC0, 

/* Symbol 0xEB, offset 5127 */
    10, 18, 5,
    0x0F, 0xC0, 0x1F, 0xC0, 0x1D, 0xC0, 0x1D, 0xC0, 0x39, 0xC0, 0x39, 0xC0, 0x39, 0xC0, 0x71, 0xC0, 0x71, 0xC0, 0x71, 0xC0, 0xE1, 0xC0, 0xE1, 0xC0, 0xE1, 0xC0, 

/* Symbol 0xEC, offset 5156 */
    12, 18, 5,
    0xE0, 0x70, 0xE0, 0xF0, 0xF0, 0xF0, 0xF9, 0xF0, 0xFB, 0xF0, 0xFF, 0xF0, 0xEF, 0x70, 0xEE, 0x70, 0xE0, 0x70, 0xE0, 0x70, 0xE0, 0x70, 0xE0, 0x70, 0xE0, 0x70, 

/* Symbol 0xED, offset 5185 */
    10, 18, 5,
    0xE1, 0xC0, 0xE1, 0xC0, 0xE1, 0xC0, 0xE1, 0xC0, 0xE1, 0xC0, 0xE1, 0xC0, 0xFF, 0xC0, 0xE1, 0xC0, 0xE1, 0xC0, 0xE1, 0xC0, 0xE1, 0xC0, 0xE1, 0xC0, 0xE1, 0xC0, 

/* Symbol 0xEE, offset 5214 */
    10, 18, 5,
    0x3F, 0x00, 0x7F, 0x80, 0xE1, 0xC0, 0xE1, 0xC0, 0xE1, 0xC0, 0xE1, 0xC0, 0xE1, 0xC0, 0xE1, 0xC0, 0xE1, 0xC0, 0xE1, 0xC0, 0xE1, 0xC0, 0x7F, 0x80, 0x3F, 0x00, 

/* Symbol 0xEF, offset 5243 */
    10, 18, 5,
    0xFF, 0x00, 0xFF, 0x80, 0xE1, 0xC0, 0xE1, 0xC0, 0xE1, 0xC0, 0xE1, 0xC0, 0xE1, 0xC0, 0xE1, 0xC0, 0xE1, 0xC0, 0xE1, 0xC0, 0xE1, 0xC0, 0xE1, 0xC0, 0xE1, 0xC0, 

/* Symbol 0xF0, offset 5272 */
    10, 24, 5,
    0xFF, 0x00, 0xFF, 0x80, 0xE1, 0xC0, 0xE1, 0xC0, 0xE1, 0xC0, 0xE1, 0xC0,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 0x00, 

/* Symbol 0xF1, offset 5313 */
    8, 18, 5,
    0x3F, 0x7F, 0xE0, 0xE0, 0xE0, 0xE0, 0xE0, 0xE0, 0xE0, 0xE0, 0xE0, 0x7F, 0x3F, 

/* Symbol 0xF2, offset 5329 */
    14, 18, 5,
    0xFF, 0xF0, 0xFF, 0xF8, 0xE7, 0x3C, 0xE7, 0x1C, 0xE7, 0x1C, 0xE7, 0x1C, 0xE7, 0x1C, 0xE7, 0x1C, 0xE7, 0x1C, 0xE7, 0x1C, 0xE7, 0x1C, 0xE7, 0x1C, 0xE7, 0x1C, 

/* Symbol 0xF3, offset 5358 */
    10, 24, 5,
    0xE1, 0xC0, 0xE1, 0xC0, 0xE1, 0xC0, 0xE1, 0xC0, 0xE1, 0xC0, 0xE1, 0xC0,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 0x00, 

/* Symbol 0xF4, offset 5399 */
    14, 24, 1,
    0x03, 0x00, 0x07, 0x00, 0x07, 0x00, 0x07, 0x00, 0x1F, 0xC0, 0x3F, 0xF0,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 0x00, 

/* Symbol 0xF5, offset 5448 */
    10, 18, 5,
    0xE1, 0xC0, 0xE1, 0xC0, 0x73, 0x80, 0x7F, 0x80, 0x3F, 0x00, 0x1E, 0x00, 0x1E, 0x00, 0x1E, 0x00, 0x3F, 0x00, 0x7F, 0x80, 0x73, 0x80, 0xE1, 0xC0, 0xE1, 0xC0, 

/* Symbol 0xF6, offset 5477 */
    12, 20, 5,
    0xE1, 0xC0, 0xE1, 0xC0, 0xE1, 0xC0, 0xE1, 0xC0, 0xE1, 0xC0, 0xE1, 0xC0, 0xE1, 0xC0, 0xE1, 0xC0, 0xE1, 0xC0, 0xE1, 0xC0, 0xE1, 0xC0, 0x7F, 0xF0, 0x3F, 0xF0, 0x00, 0x70, 0x00, 0x70, 

/* Symbol 0xF7, offset 5510 */
    10, 18, 5,
    0xE1, 0xC0, 0xE1, 0xC0, 0xE1, 0xC0, 0xE1, 0xC0, 0xE1, 0xC0, 0xF1, 0xC0, 0x7F, 0xC0, 0x01, 0xC0, 0x01, 0xC0, 0x01, 0xC0, 0x01, 0xC0, 0x01, 0xC0, 0x01, 0xC0, 

/* Symbol 0xF8, offset 5539 */
    14, 18, 5,
    0xE3, 0x1C, 0xE7, 0x1C, 0xE7, 0x1C, 0xE7, 0x1C, 0xE7, 0x1C, 0xE7, 0x1C, 0xE7, 0x1C, 0xE7, 0x1C, 0xE7, 0x1C, 0xE7, 0x1C, 0xE7, 0x1C, 0x7F, 0xFC, 0x3F, 0xFC, 

/* Symbol 0xF9, offset 5568 */
    16, 20, 5,
    0xE3, 0x1C, 0xE7, 0x1C, 0xE7, 0x1C, 0xE7, 0x1C, 0xE7, 0x1C, 0xE7, 0x1C, 0xE7, 0x1C, 0xE7, 0x1C, 0xE7, 0x1C, 0xE7, 0x1C, 0xE7, 0x1C, 0x7F, 0xFE, 0x3F, 0xFF, 0x00, 0x07, 0x00, 0x06, 

/* Symbol 0xFA, offset 5601 */
    11, 18, 5,
    0xF0, 0x00, 0xF0, 0x00, 0x70, 0x00, 0x70, 0x00, 0x70, 0x00, 0x70, 0x00, 0x7F, 0xC0, 0x71, 0xE0, 0x70, 0xE0, 0x70, 0xE0, 0x70, 0xE0, 0x7F, 0xC0, 0x7F, 0x80, 

/* Symbol 0xFB, offset 5630 */
    12, 18, 5,
    0xE0, 0x70, 0xE0, 0x70, 0xE0, 0x70, 0xE0, 0x70, 0xE0, 0x70, 0xE0, 0x70, 0xFE, 0x70, 0xEF, 0x70, 0xE7, 0x70, 0xE7, 0x70, 0xE7, 0x70, 0xFF, 0x70, 0xFE, 0x70, 

/* Symbol 0xFC, offset 5659 */
    10, 18, 5,
    0xE0, 0x00, 0xE0, 0x00, 0xE0, 0x00, 0xE0, 0x00, 0xE0, 0x00, 0xE0, 0x00, 0xFF, 0x80, 0xE3, 0xC0, 0xE1, 0xC0, 0xE1, 0xC0, 0xE1, 0xC0, 0xFF, 0x80, 0xFF, 0x00, 

/* Symbol 0xFD, offset 5688 */
    10, 18, 5,
    0xFF, 0x00, 0xFF, 0x80, 0x01, 0xC0, 0x01, 0xC0, 0x01, 0xC0, 0x01, 0xC0, 0x0F, 0xC0, 0x01, 0xC0, 0x01, 0xC0, 0x01, 0xC0, 0x01, 0xC0, 0xFF, 0x80, 0xFF, 0x00, 

/* Symbol 0xFE, offset 5717 */
    12, 18, 5,
    0xE7, 0xC0, 0xEF, 0xE0, 0xEE, 0x70, 0xEC, 0x70, 0xEC, 0x70, 0xEC, 0x70, 0xFC, 0x70, 0xEC, 0x70, 0xEC, 0x70, 0xEC, 0x70, 0xEE, 0x70, 0xEF, 0xE0, 0xE7, 0xC0, 

/* Symbol 0xFF, offset 5746 */
    10, 18, 5,
    0x3F, 0xC0, 0x7F, 0xC0, 0xE1, 0xC0, 0xE1, 0xC0, 0xE1, 0xC0, 0xF1, 0xC0, 0x7F, 0xC0, 0x1D, 0xC0, 0x39, 0xC0, 0x79, 0xC0, 0x71, 0xC0, 0xE1, 0xC0, 0xE1, 0xC0
};
