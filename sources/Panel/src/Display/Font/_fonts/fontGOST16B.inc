/*
    FaceName - GOST Type AU
    PointSize - 18
    FontWeight - bold
    Style - normal
    Family - default
    Cell width - 25
    Cell height - 25
    Offset x - 0
    Offset y - 0
*/
const unsigned char fontGOST16B[4571] =
{
/* 0x00 */   0x00, 0x00,
/* 0x01 */   0x00, 0x00,
/* 0x02 */   0x00, 0x00,
/* 0x03 */   0x00, 0x00,
/* 0x04 */   0x00, 0x00,
/* 0x05 */   0x00, 0x00,
/* 0x06 */   0x00, 0x00,
/* 0x07 */   0x00, 0x00,
/* 0x08 */   0x00, 0x00,
/* 0x09 */   0x00, 0x00,
/* 0x0A */   0x00, 0x00,
/* 0x0B */   0x00, 0x00,
/* 0x0C */   0x00, 0x00,
/* 0x0D */   0x00, 0x00,
/* 0x0E */   0x00, 0x00,
/* 0x0F */   0x00, 0x00,
/* 0x10 */   0x00, 0x00,
/* 0x11 */   0x00, 0x00,
/* 0x12 */   0x00, 0x00,
/* 0x13 */   0x00, 0x00,
/* 0x14 */   0x00, 0x00,
/* 0x15 */   0x00, 0x00,
/* 0x16 */   0x00, 0x00,
/* 0x17 */   0x00, 0x00,
/* 0x18 */   0x00, 0x00,
/* 0x19 */   0x00, 0x00,
/* 0x1A */   0x00, 0x00,
/* 0x1B */   0x00, 0x00,
/* 0x1C */   0x00, 0x00,
/* 0x1D */   0x00, 0x00,
/* 0x1E */   0x00, 0x00,
/* 0x1F */   0x00, 0x00,
/* 0x20 */   0x00, 0x02,
/* 0x21 */   0x07, 0x02,
/* 0x22 */   0x1A, 0x02,
/* 0x23 */   0x21, 0x02,
/* 0x24 */   0x44, 0x02,
/* 0x25 */   0x71, 0x02,
/* 0x26 */   0xA4, 0x02,
/* 0x27 */   0xC7, 0x02,
/* 0x28 */   0xCE, 0x02,
/* 0x29 */   0xE4, 0x02,
/* 0x2A */   0xFA, 0x02,
/* 0x2B */   0x02, 0x03,
/* 0x2C */   0x0C, 0x03,
/* 0x2D */   0x12, 0x03,
/* 0x2E */   0x16, 0x03,
/* 0x2F */   0x1A, 0x03,
/* 0x30 */   0x47, 0x03,
/* 0x31 */   0x6A, 0x03,
/* 0x32 */   0x7D, 0x03,
/* 0x33 */   0xA0, 0x03,
/* 0x34 */   0xB3, 0x03,
/* 0x35 */   0xD6, 0x03,
/* 0x36 */   0xE9, 0x03,
/* 0x37 */   0xFC, 0x03,
/* 0x38 */   0x1F, 0x04,
/* 0x39 */   0x42, 0x04,
/* 0x3A */   0x65, 0x04,
/* 0x3B */   0x6F, 0x04,
/* 0x3C */   0x7C, 0x04,
/* 0x3D */   0x86, 0x04,
/* 0x3E */   0x8D, 0x04,
/* 0x3F */   0x97, 0x04,
/* 0x40 */   0xBA, 0x04,
/* 0x41 */   0xED, 0x04,
/* 0x42 */   0x10, 0x05,
/* 0x43 */   0x33, 0x05,
/* 0x44 */   0x46, 0x05,
/* 0x45 */   0x69, 0x05,
/* 0x46 */   0x7C, 0x05,
/* 0x47 */   0x8F, 0x05,
/* 0x48 */   0xB2, 0x05,
/* 0x49 */   0xD5, 0x05,
/* 0x4A */   0xE8, 0x05,
/* 0x4B */   0xFB, 0x05,
/* 0x4C */   0x1E, 0x06,
/* 0x4D */   0x31, 0x06,
/* 0x4E */   0x54, 0x06,
/* 0x4F */   0x77, 0x06,
/* 0x50 */   0x9A, 0x06,
/* 0x51 */   0xBD, 0x06,
/* 0x52 */   0xE0, 0x06,
/* 0x53 */   0x03, 0x07,
/* 0x54 */   0x26, 0x07,
/* 0x55 */   0x49, 0x07,
/* 0x56 */   0x6C, 0x07,
/* 0x57 */   0x8F, 0x07,
/* 0x58 */   0xB2, 0x07,
/* 0x59 */   0xD5, 0x07,
/* 0x5A */   0xF8, 0x07,
/* 0x5B */   0x1B, 0x08,
/* 0x5C */   0x30, 0x08,
/* 0x5D */   0x5D, 0x08,
/* 0x5E */   0x72, 0x08,
/* 0x5F */   0x77, 0x08,
/* 0x60 */   0x7C, 0x08,
/* 0x61 */   0x83, 0x08,
/* 0x62 */   0x9E, 0x08,
/* 0x63 */   0xB1, 0x08,
/* 0x64 */   0xC0, 0x08,
/* 0x65 */   0xD3, 0x08,
/* 0x66 */   0xE2, 0x08,
/* 0x67 */   0xF5, 0x08,
/* 0x68 */   0x08, 0x09,
/* 0x69 */   0x1B, 0x09,
/* 0x6A */   0x2E, 0x09,
/* 0x6B */   0x45, 0x09,
/* 0x6C */   0x58, 0x09,
/* 0x6D */   0x6B, 0x09,
/* 0x6E */   0x86, 0x09,
/* 0x6F */   0x95, 0x09,
/* 0x70 */   0xA4, 0x09,
/* 0x71 */   0xB7, 0x09,
/* 0x72 */   0xCA, 0x09,
/* 0x73 */   0xD9, 0x09,
/* 0x74 */   0xE8, 0x09,
/* 0x75 */   0xFB, 0x09,
/* 0x76 */   0x0A, 0x0A,
/* 0x77 */   0x19, 0x0A,
/* 0x78 */   0x34, 0x0A,
/* 0x79 */   0x43, 0x0A,
/* 0x7A */   0x56, 0x0A,
/* 0x7B */   0x65, 0x0A,
/* 0x7C */   0x7B, 0x0A,
/* 0x7D */   0x8E, 0x0A,
/* 0x7E */   0xA4, 0x0A,
/* 0x7F */   0xAB, 0x0A,
/* 0x80 */   0xBC, 0x0A,
/* 0x81 */   0xCB, 0x0A,
/* 0x82 */   0xD9, 0x0A,
/* 0x83 */   0xE6, 0x0A,
/* 0x84 */   0x00, 0x00,
/* 0x85 */   0x00, 0x00,
/* 0x86 */   0x00, 0x00,
/* 0x87 */   0x00, 0x00,
/* 0x88 */   0x00, 0x00,
/* 0x89 */   0x00, 0x00,
/* 0x8A */   0x00, 0x00,
/* 0x8B */   0x00, 0x00,
/* 0x8C */   0x00, 0x00,
/* 0x8D */   0x00, 0x00,
/* 0x8E */   0x00, 0x00,
/* 0x8F */   0x00, 0x00,
/* 0x90 */   0x00, 0x00,
/* 0x91 */   0x00, 0x00,
/* 0x92 */   0x00, 0x00,
/* 0x93 */   0x00, 0x00,
/* 0x94 */   0x00, 0x00,
/* 0x95 */   0x00, 0x00,
/* 0x96 */   0x00, 0x00,
/* 0x97 */   0x00, 0x00,
/* 0x98 */   0x00, 0x00,
/* 0x99 */   0x00, 0x00,
/* 0x9A */   0x00, 0x00,
/* 0x9B */   0x00, 0x00,
/* 0x9C */   0x00, 0x00,
/* 0x9D */   0x00, 0x00,
/* 0x9E */   0x00, 0x00,
/* 0x9F */   0x00, 0x00,
/* 0xA0 */   0x00, 0x00,
/* 0xA1 */   0x00, 0x00,
/* 0xA2 */   0x00, 0x00,
/* 0xA3 */   0x00, 0x00,
/* 0xA4 */   0x00, 0x00,
/* 0xA5 */   0x00, 0x00,
/* 0xA6 */   0x00, 0x00,
/* 0xA7 */   0x00, 0x00,
/* 0xA8 */   0x00, 0x00,
/* 0xA9 */   0x00, 0x00,
/* 0xAA */   0x00, 0x00,
/* 0xAB */   0x00, 0x00,
/* 0xAC */   0x00, 0x00,
/* 0xAD */   0x00, 0x00,
/* 0xAE */   0x00, 0x00,
/* 0xAF */   0x00, 0x00,
/* 0xB0 */   0x00, 0x00,
/* 0xB1 */   0x00, 0x00,
/* 0xB2 */   0x00, 0x00,
/* 0xB3 */   0x00, 0x00,
/* 0xB4 */   0x00, 0x00,
/* 0xB5 */   0x00, 0x00,
/* 0xB6 */   0x00, 0x00,
/* 0xB7 */   0x00, 0x00,
/* 0xB8 */   0x00, 0x00,
/* 0xB9 */   0x00, 0x00,
/* 0xBA */   0x00, 0x00,
/* 0xBB */   0x00, 0x00,
/* 0xBC */   0x00, 0x00,
/* 0xBD */   0x00, 0x00,
/* 0xBE */   0x00, 0x00,
/* 0xBF */   0x00, 0x00,
/* 0xC0 */   0x09, 0x0B,
/* 0xC1 */   0x2C, 0x0B,
/* 0xC2 */   0x4F, 0x0B,
/* 0xC3 */   0x72, 0x0B,
/* 0xC4 */   0x85, 0x0B,
/* 0xC5 */   0xAA, 0x0B,
/* 0xC6 */   0xBD, 0x0B,
/* 0xC7 */   0xE0, 0x0B,
/* 0xC8 */   0x03, 0x0C,
/* 0xC9 */   0x28, 0x0C,
/* 0xCA */   0x51, 0x0C,
/* 0xCB */   0x74, 0x0C,
/* 0xCC */   0x97, 0x0C,
/* 0xCD */   0xBA, 0x0C,
/* 0xCE */   0xDD, 0x0C,
/* 0xCF */   0x00, 0x0D,
/* 0xD0 */   0x23, 0x0D,
/* 0xD1 */   0x46, 0x0D,
/* 0xD2 */   0x59, 0x0D,
/* 0xD3 */   0x7C, 0x0D,
/* 0xD4 */   0x9F, 0x0D,
/* 0xD5 */   0xC2, 0x0D,
/* 0xD6 */   0xE5, 0x0D,
/* 0xD7 */   0x0C, 0x0E,
/* 0xD8 */   0x2F, 0x0E,
/* 0xD9 */   0x52, 0x0E,
/* 0xDA */   0x79, 0x0E,
/* 0xDB */   0x9C, 0x0E,
/* 0xDC */   0xBF, 0x0E,
/* 0xDD */   0xE2, 0x0E,
/* 0xDE */   0x05, 0x0F,
/* 0xDF */   0x28, 0x0F,
/* 0xE0 */   0x4B, 0x0F,
/* 0xE1 */   0x66, 0x0F,
/* 0xE2 */   0x79, 0x0F,
/* 0xE3 */   0x8C, 0x0F,
/* 0xE4 */   0x9B, 0x0F,
/* 0xE5 */   0xAE, 0x0F,
/* 0xE6 */   0xBD, 0x0F,
/* 0xE7 */   0xD8, 0x0F,
/* 0xE8 */   0xE7, 0x0F,
/* 0xE9 */   0xF6, 0x0F,
/* 0xEA */   0x09, 0x10,
/* 0xEB */   0x18, 0x10,
/* 0xEC */   0x27, 0x10,
/* 0xED */   0x42, 0x10,
/* 0xEE */   0x51, 0x10,
/* 0xEF */   0x60, 0x10,
/* 0xF0 */   0x6F, 0x10,
/* 0xF1 */   0x82, 0x10,
/* 0xF2 */   0x91, 0x10,
/* 0xF3 */   0xAC, 0x10,
/* 0xF4 */   0xBF, 0x10,
/* 0xF5 */   0xE6, 0x10,
/* 0xF6 */   0xF5, 0x10,
/* 0xF7 */   0x14, 0x11,
/* 0xF8 */   0x23, 0x11,
/* 0xF9 */   0x3E, 0x11,
/* 0xFA */   0x5D, 0x11,
/* 0xFB */   0x78, 0x11,
/* 0xFC */   0x93, 0x11,
/* 0xFD */   0xA2, 0x11,
/* 0xFE */   0xB1, 0x11,
/* 0xFF */   0xCC, 0x11,

/* Symbol 0x20, offset 512 */
    25, 1, 0,
    0x00, 0x00, 0x00, 0x00, 

/* Symbol 0x21, offset 519 */
    2, 21, 5,
    0xC0, 0xC0, 0xC0, 0xC0, 0xC0, 0xC0, 0xC0, 0xC0, 0xC0, 0xC0, 0xC0, 0xC0, 0xC0, 0x00, 0x00, 0xC0, 

/* Symbol 0x22, offset 538 */
    5, 9, 5,
    0xD8, 0xF8, 0xF0, 0xF0, 

/* Symbol 0x23, offset 545 */
    12, 21, 5,
    0x06, 0x60, 0x0E, 0x60, 0x0C, 0xE0, 0x0C, 0xC0, 0x7F, 0xF0, 0x1C, 0xC0, 0x18, 0xC0, 0x19, 0xC0, 0x19, 0x80, 0x19, 0x80, 0x39, 0x80, 0xFF, 0xE0, 0x33, 0x80, 0x33, 0x00, 0x33, 0x00, 0x63, 0x00, 

/* Symbol 0x24, offset 580 */
    10, 23, 2,
    0x1C, 0x00, 0x1C, 0x00, 0x3F, 0x00, 0x7F, 0xC0, 0xFC, 0x00, 0xDC, 0x00,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 0x00, 

/* Symbol 0x25, offset 625 */
    19, 21, 5,
    0x3C, 0x06, 0x00, 0x66, 0x0E, 0x00, 0xC3, 0x0C, 0x00, 0xC3, 0x1C, 0x00,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 0x80, 

/* Symbol 0x26, offset 676 */
    11, 21, 5,
    0x3C, 0x00, 0x76, 0x00, 0x76, 0x00, 0x76, 0x00, 0x3C, 0x00, 0x1C, 0x00, 0x1C, 0x00, 0x3C, 0x00, 0x7E, 0x00, 0x67, 0x00, 0xC3, 0x60, 0xC3, 0xE0, 0xC1, 0xC0, 0xC3, 0xC0, 0x67, 0xE0, 0x3E, 0x60, 

/* Symbol 0x27, offset 711 */
    2, 9, 5,
    0xC0, 0xC0, 0xC0, 0xC0, 

/* Symbol 0x28, offset 718 */
    3, 22, 3,
    0x60, 0x60, 0xC0, 0xC0, 0xC0, 0xC0, 0xC0, 0xC0, 0xC0, 0xC0, 0xC0, 0xC0, 0xC0, 0xC0, 0xC0, 0xC0, 0xC0, 0x60, 0x60, 

/* Symbol 0x29, offset 740 */
    3, 22, 3,
    0xC0, 0xC0, 0x60, 0x60, 0x60, 0x60, 0x60, 0x60, 0x60, 0x60, 0x60, 0x60, 0x60, 0x60, 0x60, 0x60, 0x60, 0xC0, 0xC0, 

/* Symbol 0x2A, offset 762 */
    7, 10, 5,
    0x3C, 0x3C, 0x38, 0xFE, 0x3C, 

/* Symbol 0x2B, offset 770 */
    8, 19, 12,
    0x18, 0x18, 0x18, 0xFF, 0x18, 0x18, 0x18, 

/* Symbol 0x2C, offset 780 */
    2, 23, 20,
    0xC0, 0xC0, 0xC0, 

/* Symbol 0x2D, offset 786 */
    8, 16, 15,
    0xFF, 

/* Symbol 0x2E, offset 790 */
    2, 21, 20,
    0xC0, 

/* Symbol 0x2F, offset 794 */
    12, 23, 2,
    0x00, 0x30, 0x00, 0x60, 0x00, 0x60, 0x00, 0xC0, 0x00, 0xC0, 0x01, 0x80,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 0x00, 

/* Symbol 0x30, offset 839 */
    10, 21, 5,
    0x3F, 0x00, 0x61, 0x80, 0xC0, 0xC0, 0xC0, 0xC0, 0xC0, 0xC0, 0xC0, 0xC0, 0xC0, 0xC0, 0xC0, 0xC0, 0xC0, 0xC0, 0xC0, 0xC0, 0xC0, 0xC0, 0xC0, 0xC0, 0xC0, 0xC0, 0xC0, 0xC0, 0x61, 0x80, 0x3F, 0x00, 

/* Symbol 0x31, offset 874 */
    6, 21, 5,
    0x0C, 0x1C, 0x3C, 0x6C, 0xCC, 0x0C, 0x0C, 0x0C, 0x0C, 0x0C, 0x0C, 0x0C, 0x0C, 0x0C, 0x0C, 0x0C, 

/* Symbol 0x32, offset 893 */
    10, 21, 5,
    0x3E, 0x00, 0x63, 0x80, 0xC0, 0xC0, 0x00, 0xC0, 0x00, 0xC0, 0x00, 0xC0, 0x01, 0x80, 0x03, 0x00, 0x07, 0x00, 0x06, 0x00, 0x0C, 0x00, 0x18, 0x00, 0x38, 0x00, 0x70, 0x00, 0xE0, 0x00, 0xFF, 0xC0, 

/* Symbol 0x33, offset 928 */
    8, 21, 5,
    0xF8, 0x0C, 0x06, 0x06, 0x06, 0x06, 0x0E, 0x3C, 0x06, 0x03, 0x03, 0x03, 0x03, 0x03, 0x06, 0xFC, 

/* Symbol 0x34, offset 947 */
    9, 21, 5,
    0x18, 0x00, 0x38, 0x00, 0x30, 0x00, 0x30, 0x00, 0x30, 0x00, 0x30, 0x00, 0x70, 0x00, 0x66, 0x00, 0x66, 0x00, 0x66, 0x00, 0x66, 0x00, 0xFF, 0x80, 0x06, 0x00, 0x06, 0x00, 0x06, 0x00, 0x06, 0x00, 

/* Symbol 0x35, offset 982 */
    8, 21, 5,
    0xFF, 0xC0, 0xC0, 0xC0, 0xC0, 0xC0, 0xC0, 0xFC, 0x06, 0x03, 0x03, 0x03, 0x03, 0x03, 0x06, 0xFC, 

/* Symbol 0x36, offset 1001 */
    8, 21, 5,
    0x0E, 0x3C, 0x70, 0x60, 0xE0, 0xC0, 0xC0, 0xFE, 0xC7, 0xC3, 0xC3, 0xC3, 0xC3, 0xC3, 0x67, 0x7E, 

/* Symbol 0x37, offset 1020 */
    9, 21, 5,
    0xFF, 0x80, 0xC1, 0x80, 0xC3, 0x80, 0x03, 0x00, 0x03, 0x00, 0x03, 0x00, 0x07, 0x00, 0x06, 0x00, 0x06, 0x00, 0x06, 0x00, 0x0E, 0x00, 0x0C, 0x00, 0x0C, 0x00, 0x0C, 0x00, 0x0C, 0x00, 0x1C, 0x00, 

/* Symbol 0x38, offset 1055 */
    10, 21, 5,
    0x3E, 0x00, 0x73, 0x00, 0x61, 0x80, 0x61, 0x80, 0x61, 0x80, 0x61, 0x80, 0x73, 0x80, 0x7F, 0x00, 0xE1, 0x80, 0xC0, 0xC0, 0xC0, 0xC0, 0xC0, 0xC0, 0xC0, 0xC0, 0xC0, 0xC0, 0x61, 0x80, 0x3F, 0x00, 

/* Symbol 0x39, offset 1090 */
    9, 21, 5,
    0x3E, 0x00, 0x63, 0x00, 0xC1, 0x80, 0xC1, 0x80, 0xC1, 0x80, 0xC1, 0x80, 0xC1, 0x80, 0x61, 0x80, 0x3F, 0x80, 0x01, 0x80, 0x01, 0x80, 0x03, 0x80, 0x03, 0x00, 0x07, 0x00, 0x0E, 0x00, 0x38, 0x00, 

/* Symbol 0x3A, offset 1125 */
    2, 17, 10,
    0xC0, 0x00, 0x00, 0x00, 0x00, 0x00, 0xC0, 

/* Symbol 0x3B, offset 1135 */
    3, 23, 13,
    0x60, 0x00, 0x00, 0x00, 0x00, 0x00, 0x60, 0x60, 0x60, 0xE0, 

/* Symbol 0x3C, offset 1148 */
    8, 19, 12,
    0x07, 0x0E, 0x38, 0xE0, 0x38, 0x0E, 0x07, 

/* Symbol 0x3D, offset 1158 */
    8, 17, 13,
    0xFF, 0x00, 0x00, 0xFF, 

/* Symbol 0x3E, offset 1165 */
    8, 19, 12,
    0xE0, 0x78, 0x1E, 0x07, 0x1E, 0x78, 0xE0, 

/* Symbol 0x3F, offset 1175 */
    9, 21, 5,
    0x7E, 0x00, 0xE3, 0x00, 0x01, 0x80, 0x01, 0x80, 0x01, 0x80, 0x03, 0x80, 0x0F, 0x00, 0x1C, 0x00, 0x18, 0x00, 0x18, 0x00, 0x18, 0x00, 0x18, 0x00, 0x18, 0x00, 0x00, 0x00, 0x00, 0x00, 0x18, 0x00, 

/* Symbol 0x40, offset 1210 */
    17, 21, 5,
    0x07, 0xF0, 0x00, 0x1C, 0x1C, 0x00, 0x30, 0x06, 0x00, 0x63, 0xF3, 0x00,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 0x00, 

/* Symbol 0x41, offset 1261 */
    11, 21, 5,
    0x0C, 0x00, 0x0E, 0x00, 0x0E, 0x00, 0x1E, 0x00, 0x1F, 0x00, 0x1B, 0x00, 0x1B, 0x00, 0x33, 0x00, 0x31, 0x80, 0x31, 0x80, 0x3F, 0x80, 0x61, 0x80, 0x60, 0xC0, 0x60, 0xC0, 0xE0, 0xC0, 0xC0, 0xE0, 

/* Symbol 0x42, offset 1296 */
    10, 21, 5,
    0xFE, 0x00, 0xC3, 0x00, 0xC1, 0x80, 0xC1, 0x80, 0xC1, 0x80, 0xC1, 0x80, 0xC3, 0x80, 0xFF, 0x00, 0xC1, 0x80, 0xC0, 0xC0, 0xC0, 0xC0, 0xC0, 0xC0, 0xC0, 0xC0, 0xC0, 0xC0, 0xC1, 0x80, 0xFF, 0x00, 

/* Symbol 0x43, offset 1331 */
    8, 21, 5,
    0x3F, 0x60, 0xC0, 0xC0, 0xC0, 0xC0, 0xC0, 0xC0, 0xC0, 0xC0, 0xC0, 0xC0, 0xC0, 0xC0, 0x60, 0x3F, 

/* Symbol 0x44, offset 1350 */
    10, 21, 5,
    0xFF, 0x00, 0xC1, 0x80, 0xC0, 0xC0, 0xC0, 0xC0, 0xC0, 0xC0, 0xC0, 0xC0, 0xC0, 0xC0, 0xC0, 0xC0, 0xC0, 0xC0, 0xC0, 0xC0, 0xC0, 0xC0, 0xC0, 0xC0, 0xC0, 0xC0, 0xC0, 0xC0, 0xC1, 0x80, 0xFF, 0x00, 

/* Symbol 0x45, offset 1385 */
    8, 21, 5,
    0xFF, 0xC0, 0xC0, 0xC0, 0xC0, 0xC0, 0xC0, 0xFC, 0xC0, 0xC0, 0xC0, 0xC0, 0xC0, 0xC0, 0xC0, 0xFF, 

/* Symbol 0x46, offset 1404 */
    8, 21, 5,
    0xFF, 0xC0, 0xC0, 0xC0, 0xC0, 0xC0, 0xC0, 0xFF, 0xC0, 0xC0, 0xC0, 0xC0, 0xC0, 0xC0, 0xC0, 0xC0, 

/* Symbol 0x47, offset 1423 */
    10, 21, 5,
    0x3F, 0xC0, 0x60, 0x00, 0xC0, 0x00, 0xC0, 0x00, 0xC0, 0x00, 0xC0, 0x00, 0xC0, 0x00, 0xC3, 0xC0, 0xC0, 0xC0, 0xC0, 0xC0, 0xC0, 0xC0, 0xC0, 0xC0, 0xC0, 0xC0, 0xC0, 0xC0, 0x60, 0xC0, 0x3F, 0xC0, 

/* Symbol 0x48, offset 1458 */
    10, 21, 5,
    0xC0, 0xC0, 0xC0, 0xC0, 0xC0, 0xC0, 0xC0, 0xC0, 0xC0, 0xC0, 0xC0, 0xC0, 0xC0, 0xC0, 0xFF, 0xC0, 0xC0, 0xC0, 0xC0, 0xC0, 0xC0, 0xC0, 0xC0, 0xC0, 0xC0, 0xC0, 0xC0, 0xC0, 0xC0, 0xC0, 0xC0, 0xC0, 

/* Symbol 0x49, offset 1493 */
    2, 21, 5,
    0xC0, 0xC0, 0xC0, 0xC0, 0xC0, 0xC0, 0xC0, 0xC0, 0xC0, 0xC0, 0xC0, 0xC0, 0xC0, 0xC0, 0xC0, 0xC0, 

/* Symbol 0x4A, offset 1512 */
    7, 21, 5,
    0x06, 0x06, 0x06, 0x06, 0x06, 0x06, 0x06, 0x06, 0x06, 0x06, 0x06, 0x06, 0x06, 0x06, 0x0C, 0xF8, 

/* Symbol 0x4B, offset 1531 */
    9, 21, 5,
    0xC1, 0x80, 0xC3, 0x00, 0xC7, 0x00, 0xCE, 0x00, 0xCC, 0x00, 0xD8, 0x00, 0xF8, 0x00, 0xF8, 0x00, 0xFC, 0x00, 0xCC, 0x00, 0xCE, 0x00, 0xC6, 0x00, 0xC7, 0x00, 0xC3, 0x00, 0xC3, 0x80, 0xC1, 0x80, 

/* Symbol 0x4C, offset 1566 */
    7, 21, 5,
    0xC0, 0xC0, 0xC0, 0xC0, 0xC0, 0xC0, 0xC0, 0xC0, 0xC0, 0xC0, 0xC0, 0xC0, 0xC0, 0xC0, 0xC0, 0xFE, 

/* Symbol 0x4D, offset 1585 */
    12, 21, 5,
    0xC0, 0x30, 0xE0, 0x70, 0xE0, 0x70, 0xF0, 0xF0, 0xF9, 0xF0, 0xDF, 0xB0, 0xCF, 0x30, 0xCF, 0x30, 0xC6, 0x30, 0xC0, 0x30, 0xC0, 0x30, 0xC0, 0x30, 0xC0, 0x30, 0xC0, 0x30, 0xC0, 0x30, 0xC0, 0x30, 

/* Symbol 0x4E, offset 1620 */
    10, 21, 5,
    0xC0, 0xC0, 0xE0, 0xC0, 0xE0, 0xC0, 0xF0, 0xC0, 0xF0, 0xC0, 0xF8, 0xC0, 0xD8, 0xC0, 0xDC, 0xC0, 0xCE, 0xC0, 0xC6, 0xC0, 0xC7, 0xC0, 0xC3, 0xC0, 0xC3, 0xC0, 0xC1, 0xC0, 0xC1, 0xC0, 0xC0, 0xC0, 

/* Symbol 0x4F, offset 1655 */
    10, 21, 5,
    0x3F, 0x00, 0x61, 0x80, 0xC0, 0xC0, 0xC0, 0xC0, 0xC0, 0xC0, 0xC0, 0xC0, 0xC0, 0xC0, 0xC0, 0xC0, 0xC0, 0xC0, 0xC0, 0xC0, 0xC0, 0xC0, 0xC0, 0xC0, 0xC0, 0xC0, 0xC0, 0xC0, 0x61, 0x80, 0x3F, 0x00, 

/* Symbol 0x50, offset 1690 */
    10, 21, 5,
    0xFF, 0x00, 0xC1, 0x80, 0xC0, 0xC0, 0xC0, 0xC0, 0xC0, 0xC0, 0xC0, 0xC0, 0xC0, 0xC0, 0xC1, 0x80, 0xFF, 0x00, 0xC0, 0x00, 0xC0, 0x00, 0xC0, 0x00, 0xC0, 0x00, 0xC0, 0x00, 0xC0, 0x00, 0xC0, 0x00, 

/* Symbol 0x51, offset 1725 */
    11, 21, 5,
    0x3F, 0x00, 0x61, 0x80, 0xC0, 0xC0, 0xC0, 0xC0, 0xC0, 0xC0, 0xC0, 0xC0, 0xC0, 0xC0, 0xC0, 0xC0, 0xC0, 0xC0, 0xC0, 0xC0, 0xCC, 0xC0, 0xCE, 0xC0, 0xC3, 0xC0, 0xC1, 0xC0, 0x61, 0xC0, 0x3F, 0x60, 

/* Symbol 0x52, offset 1760 */
    10, 21, 5,
    0xFF, 0x00, 0xC1, 0x80, 0xC0, 0xC0, 0xC0, 0xC0, 0xC0, 0xC0, 0xC0, 0xC0, 0xC0, 0xC0, 0xC1, 0x80, 0xFF, 0x00, 0xCE, 0x00, 0xCE, 0x00, 0xC7, 0x00, 0xC3, 0x00, 0xC3, 0x80, 0xC1, 0xC0, 0xC0, 0xC0, 

/* Symbol 0x53, offset 1795 */
    9, 21, 5,
    0x3F, 0x80, 0x60, 0x00, 0xC0, 0x00, 0xC0, 0x00, 0xC0, 0x00, 0x60, 0x00, 0x30, 0x00, 0x18, 0x00, 0x0C, 0x00, 0x06, 0x00, 0x03, 0x00, 0x01, 0x80, 0x01, 0x80, 0x01, 0x80, 0xC3, 0x00, 0x7E, 0x00, 

/* Symbol 0x54, offset 1830 */
    10, 21, 5,
    0xFF, 0xC0, 0x0C, 0x00, 0x0C, 0x00, 0x0C, 0x00, 0x0C, 0x00, 0x0C, 0x00, 0x0C, 0x00, 0x0C, 0x00, 0x0C, 0x00, 0x0C, 0x00, 0x0C, 0x00, 0x0C, 0x00, 0x0C, 0x00, 0x0C, 0x00, 0x0C, 0x00, 0x0C, 0x00, 

/* Symbol 0x55, offset 1865 */
    10, 21, 5,
    0xC0, 0xC0, 0xC0, 0xC0, 0xC0, 0xC0, 0xC0, 0xC0, 0xC0, 0xC0, 0xC0, 0xC0, 0xC0, 0xC0, 0xC0, 0xC0, 0xC0, 0xC0, 0xC0, 0xC0, 0xC0, 0xC0, 0xC0, 0xC0, 0xC0, 0xC0, 0xC0, 0xC0, 0x61, 0x80, 0x3F, 0x00, 

/* Symbol 0x56, offset 1900 */
    11, 21, 5,
    0xC0, 0xE0, 0xE0, 0xC0, 0x60, 0xC0, 0x60, 0xC0, 0x61, 0x80, 0x31, 0x80, 0x31, 0x80, 0x33, 0x80, 0x3B, 0x00, 0x1B, 0x00, 0x1B, 0x00, 0x1F, 0x00, 0x1E, 0x00, 0x0E, 0x00, 0x0E, 0x00, 0x0C, 0x00, 

/* Symbol 0x57, offset 1935 */
    15, 21, 5,
    0xC0, 0x06, 0xE0, 0x06, 0x60, 0x06, 0x60, 0x0E, 0x61, 0x8C, 0x63, 0x8C, 0x73, 0x8C, 0x33, 0xCC, 0x37, 0xDC, 0x36, 0xD8, 0x36, 0xF8, 0x3E, 0x78, 0x1C, 0x78, 0x1C, 0x78, 0x1C, 0x30, 0x18, 0x30, 

/* Symbol 0x58, offset 1970 */
    11, 21, 5,
    0xC0, 0xE0, 0x60, 0xC0, 0x61, 0xC0, 0x31, 0x80, 0x3B, 0x00, 0x1B, 0x00, 0x1E, 0x00, 0x0E, 0x00, 0x0E, 0x00, 0x1E, 0x00, 0x1B, 0x00, 0x3B, 0x00, 0x31, 0x80, 0x61, 0xC0, 0x60, 0xC0, 0xC0, 0xE0, 

/* Symbol 0x59, offset 2005 */
    10, 21, 5,
    0xC0, 0xC0, 0xE1, 0xC0, 0x61, 0x80, 0x73, 0x80, 0x33, 0x00, 0x1E, 0x00, 0x1E, 0x00, 0x0C, 0x00, 0x0C, 0x00, 0x0C, 0x00, 0x0C, 0x00, 0x0C, 0x00, 0x0C, 0x00, 0x0C, 0x00, 0x0C, 0x00, 0x0C, 0x00, 

/* Symbol 0x5A, offset 2040 */
    9, 21, 5,
    0xFF, 0x80, 0x01, 0x80, 0x03, 0x80, 0x03, 0x00, 0x07, 0x00, 0x06, 0x00, 0x0E, 0x00, 0x0C, 0x00, 0x1C, 0x00, 0x18, 0x00, 0x38, 0x00, 0x30, 0x00, 0x30, 0x00, 0x60, 0x00, 0x60, 0x00, 0xFF, 0x80, 

/* Symbol 0x5B, offset 2075 */
    4, 22, 4,
    0xF0, 0xC0, 0xC0, 0xC0, 0xC0, 0xC0, 0xC0, 0xC0, 0xC0, 0xC0, 0xC0, 0xC0, 0xC0, 0xC0, 0xC0, 0xC0, 0xC0, 0xF0, 

/* Symbol 0x5C, offset 2096 */
    12, 23, 2,
    0xC0, 0x00, 0x60, 0x00, 0x60, 0x00, 0x70, 0x00, 0x30, 0x00, 0x38, 0x00,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 0x30, 

/* Symbol 0x5D, offset 2141 */
    4, 22, 4,
    0xF0, 0x30, 0x30, 0x30, 0x30, 0x30, 0x30, 0x30, 0x30, 0x30, 0x30, 0x30, 0x30, 0x30, 0x30, 0x30, 0x30, 0xF0, 

/* Symbol 0x5E, offset 2162 */
    7, 3, 1,
    0x7C, 0xEE, 

/* Symbol 0x5F, offset 2167 */
    10, 23, 22,
    0xFF, 0xC0, 

/* Symbol 0x60, offset 2172 */
    25, 1, 0,
    0x00, 0x00, 0x00, 0x00, 

/* Symbol 0x61, offset 2179 */
    9, 21, 9,
    0x7F, 0x00, 0xC3, 0x00, 0xC3, 0x00, 0xC3, 0x00, 0xC3, 0x00, 0xC3, 0x00, 0xC3, 0x00, 0xC3, 0x00, 0xC3, 0x00, 0xC3, 0x00, 0xC3, 0x00, 0x7F, 0x80, 

/* Symbol 0x62, offset 2206 */
    8, 21, 5,
    0xC0, 0xC0, 0xC0, 0xC0, 0xFE, 0xC3, 0xC3, 0xC3, 0xC3, 0xC3, 0xC3, 0xC3, 0xC3, 0xC3, 0xC3, 0xFE, 

/* Symbol 0x63, offset 2225 */
    8, 21, 9,
    0x7F, 0xC0, 0xC0, 0xC0, 0xC0, 0xC0, 0xC0, 0xC0, 0xC0, 0xC0, 0xC0, 0x7F, 

/* Symbol 0x64, offset 2240 */
    8, 21, 5,
    0x03, 0x03, 0x03, 0x03, 0x7F, 0xC3, 0xC3, 0xC3, 0xC3, 0xC3, 0xC3, 0xC3, 0xC3, 0xC3, 0xC3, 0x7F, 

/* Symbol 0x65, offset 2259 */
    8, 21, 9,
    0x7E, 0xC3, 0xC3, 0xC3, 0xC3, 0xC3, 0xFF, 0xC0, 0xC0, 0xC0, 0xC0, 0x7F, 

/* Symbol 0x66, offset 2274 */
    5, 21, 5,
    0x38, 0x60, 0x60, 0x60, 0xF8, 0x60, 0x60, 0x60, 0x60, 0x60, 0x60, 0x60, 0x60, 0x60, 0x60, 0x60, 

/* Symbol 0x67, offset 2293 */
    8, 25, 9,
    0x7F, 0xC3, 0xC3, 0xC3, 0xC3, 0xC3, 0xC3, 0xC3, 0xC3, 0xC3, 0xC3, 0x7F, 0x03, 0x03, 0x03, 0x03, 

/* Symbol 0x68, offset 2312 */
    8, 21, 5,
    0xC0, 0xC0, 0xC0, 0xC0, 0xFE, 0xC3, 0xC3, 0xC3, 0xC3, 0xC3, 0xC3, 0xC3, 0xC3, 0xC3, 0xC3, 0xC3, 

/* Symbol 0x69, offset 2331 */
    2, 21, 5,
    0xC0, 0x00, 0x00, 0x00, 0xC0, 0xC0, 0xC0, 0xC0, 0xC0, 0xC0, 0xC0, 0xC0, 0xC0, 0xC0, 0xC0, 0xC0, 

/* Symbol 0x6A, offset 2350 */
    2, 25, 5,
    0xC0, 0x00, 0x00, 0x00, 0xC0, 0xC0, 0xC0, 0xC0, 0xC0, 0xC0, 0xC0, 0xC0, 0xC0, 0xC0, 0xC0, 0xC0, 0xC0, 0xC0, 0xC0, 0xC0, 

/* Symbol 0x6B, offset 2373 */
    8, 21, 5,
    0xC0, 0xC0, 0xC0, 0xC0, 0xC3, 0xC7, 0xCE, 0xDC, 0xF8, 0xF0, 0xF8, 0xDC, 0xCC, 0xCE, 0xC7, 0xC3, 

/* Symbol 0x6C, offset 2392 */
    4, 21, 5,
    0xC0, 0xC0, 0xC0, 0xC0, 0xC0, 0xC0, 0xC0, 0xC0, 0xC0, 0xC0, 0xC0, 0xC0, 0xC0, 0xC0, 0xC0, 0x70, 

/* Symbol 0x6D, offset 2411 */
    11, 21, 9,
    0xFF, 0xC0, 0xCC, 0x60, 0xCC, 0x60, 0xCC, 0x60, 0xCC, 0x60, 0xCC, 0x60, 0xCC, 0x60, 0xCC, 0x60, 0xCC, 0x60, 0xCC, 0x60, 0xCC, 0x60, 0xCC, 0x60, 

/* Symbol 0x6E, offset 2438 */
    8, 21, 9,
    0xFE, 0xC3, 0xC3, 0xC3, 0xC3, 0xC3, 0xC3, 0xC3, 0xC3, 0xC3, 0xC3, 0xC3, 

/* Symbol 0x6F, offset 2453 */
    8, 21, 9,
    0x7E, 0xC3, 0xC3, 0xC3, 0xC3, 0xC3, 0xC3, 0xC3, 0xC3, 0xC3, 0xC3, 0x7E, 

/* Symbol 0x70, offset 2468 */
    8, 25, 9,
    0xFE, 0xC3, 0xC3, 0xC3, 0xC3, 0xC3, 0xC3, 0xC3, 0xC3, 0xC3, 0xC3, 0xFE, 0xC0, 0xC0, 0xC0, 0xC0, 

/* Symbol 0x71, offset 2487 */
    8, 25, 9,
    0x7F, 0xC3, 0xC3, 0xC3, 0xC3, 0xC3, 0xC3, 0xC3, 0xC3, 0xC3, 0xC3, 0x7F, 0x03, 0x03, 0x03, 0x03, 

/* Symbol 0x72, offset 2506 */
    7, 21, 9,
    0xFC, 0xCE, 0xC0, 0xC0, 0xC0, 0xC0, 0xC0, 0xC0, 0xC0, 0xC0, 0xC0, 0xC0, 

/* Symbol 0x73, offset 2521 */
    8, 21, 9,
    0x7E, 0xE7, 0xC3, 0xE0, 0x70, 0x38, 0x1C, 0x0F, 0x03, 0x03, 0xC3, 0x7E, 

/* Symbol 0x74, offset 2536 */
    5, 21, 5,
    0x60, 0x60, 0x60, 0x60, 0xF8, 0x60, 0x60, 0x60, 0x60, 0x60, 0x60, 0x60, 0x60, 0x60, 0x60, 0x60, 

/* Symbol 0x75, offset 2555 */
    8, 21, 9,
    0xC3, 0xC3, 0xC3, 0xC3, 0xC3, 0xC3, 0xC3, 0xC3, 0xC3, 0xC3, 0xC3, 0x7F, 

/* Symbol 0x76, offset 2570 */
    8, 21, 9,
    0xC3, 0xE3, 0x67, 0x66, 0x66, 0x76, 0x3E, 0x3C, 0x3C, 0x1C, 0x1C, 0x18, 

/* Symbol 0x77, offset 2585 */
    13, 21, 9,
    0xC0, 0x18, 0xE0, 0x38, 0x66, 0x30, 0x67, 0x30, 0x67, 0x30, 0x67, 0xB0, 0x7D, 0xF0, 0x3D, 0xE0, 0x3D, 0xE0, 0x38, 0xE0, 0x38, 0xE0, 0x18, 0xE0, 

/* Symbol 0x78, offset 2612 */
    8, 21, 9,
    0xC3, 0x67, 0x66, 0x3E, 0x3C, 0x1C, 0x1C, 0x3C, 0x3E, 0x66, 0x67, 0xC3, 

/* Symbol 0x79, offset 2627 */
    8, 25, 9,
    0xC3, 0xE3, 0x67, 0x66, 0x66, 0x76, 0x3E, 0x3C, 0x3C, 0x1C, 0x1C, 0x18, 0x18, 0x18, 0x38, 0x30, 

/* Symbol 0x7A, offset 2646 */
    8, 21, 9,
    0xFF, 0x07, 0x06, 0x0E, 0x0C, 0x1C, 0x18, 0x38, 0x30, 0x70, 0x60, 0xFF, 

/* Symbol 0x7B, offset 2661 */
    4, 22, 3,
    0x70, 0x60, 0x60, 0x60, 0x60, 0x60, 0x60, 0x60, 0x60, 0xC0, 0x60, 0x60, 0x60, 0x60, 0x60, 0x60, 0x60, 0x60, 0x70, 

/* Symbol 0x7C, offset 2683 */
    2, 21, 5,
    0xC0, 0xC0, 0xC0, 0xC0, 0xC0, 0xC0, 0xC0, 0xC0, 0xC0, 0xC0, 0xC0, 0xC0, 0xC0, 0xC0, 0xC0, 0xC0, 

/* Symbol 0x7D, offset 2702 */
    4, 22, 3,
    0xE0, 0x60, 0x60, 0x60, 0x60, 0x60, 0x60, 0x60, 0x60, 0x30, 0x60, 0x60, 0x60, 0x60, 0x60, 0x60, 0x60, 0x60, 0xE0, 

/* Symbol 0x7E, offset 2724 */
    9, 16, 14,
    0x79, 0x80, 0xCF, 0x80, 

/* Symbol 0x7F, offset 2731 */
    6, 20, 6,
    0xFC, 0xCC, 0xCC, 0xCC, 0xCC, 0xCC, 0xCC, 0xCC, 0xCC, 0xCC, 0xCC, 0xCC, 0xCC, 0xFC, 

/* Symbol 0x80, offset 2748 */
    7, 24, 12,
    0xFE, 0x06, 0x06, 0x06, 0x06, 0x06, 0x06, 0x06, 0x06, 0x06, 0x06, 0x06, 

/* Symbol 0x81, offset 2763 */
    7, 13, 2,
    0xC0, 0xC0, 0xC0, 0xC0, 0xC0, 0xC0, 0xC0, 0xC0, 0xC0, 0xC0, 0xFE, 

/* Symbol 0x82, offset 2777 */
    11, 15, 10,
    0x01, 0x80, 0x00, 0xC0, 0xFF, 0xE0, 0x00, 0xC0, 0x01, 0x80, 

/* Symbol 0x83, offset 2790 */
    9, 21, 5,
    0x3F, 0x80, 0x60, 0x00, 0xC0, 0x00, 0xC0, 0x00, 0xC0, 0x00, 0x60, 0x00, 0x30, 0x00, 0x18, 0x00, 0x0C, 0x00, 0x06, 0x00, 0x03, 0x00, 0x01, 0x80, 0x01, 0x80, 0x01, 0x80, 0xC3, 0x00, 0x7E, 0x00, 

/* Symbol 0xC0, offset 2825 */
    11, 21, 5,
    0x0C, 0x00, 0x0E, 0x00, 0x0E, 0x00, 0x1E, 0x00, 0x1F, 0x00, 0x1B, 0x00, 0x1B, 0x00, 0x33, 0x00, 0x31, 0x80, 0x31, 0x80, 0x3F, 0x80, 0x61, 0x80, 0x60, 0xC0, 0x60, 0xC0, 0xE0, 0xC0, 0xC0, 0xE0, 

/* Symbol 0xC1, offset 2860 */
    10, 21, 5,
    0xFF, 0xC0, 0xC0, 0x00, 0xC0, 0x00, 0xC0, 0x00, 0xC0, 0x00, 0xC0, 0x00, 0xC0, 0x00, 0xFF, 0x00, 0xC1, 0x80, 0xC0, 0xC0, 0xC0, 0xC0, 0xC0, 0xC0, 0xC0, 0xC0, 0xC0, 0xC0, 0xC1, 0x80, 0xFF, 0x00, 

/* Symbol 0xC2, offset 2895 */
    10, 21, 5,
    0xFE, 0x00, 0xC3, 0x00, 0xC1, 0x80, 0xC1, 0x80, 0xC1, 0x80, 0xC1, 0x80, 0xC3, 0x80, 0xFF, 0x00, 0xC1, 0x80, 0xC0, 0xC0, 0xC0, 0xC0, 0xC0, 0xC0, 0xC0, 0xC0, 0xC0, 0xC0, 0xC1, 0x80, 0xFF, 0x00, 

/* Symbol 0xC3, offset 2930 */
    8, 21, 5,
    0xFF, 0xC0, 0xC0, 0xC0, 0xC0, 0xC0, 0xC0, 0xC0, 0xC0, 0xC0, 0xC0, 0xC0, 0xC0, 0xC0, 0xC0, 0xC0, 

/* Symbol 0xC4, offset 2949 */
    10, 22, 5,
    0x3F, 0x80, 0x31, 0x80, 0x31, 0x80, 0x31, 0x80, 0x31, 0x80, 0x31, 0x80,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 0xC0, 

/* Symbol 0xC5, offset 2986 */
    8, 21, 5,
    0xFF, 0xC0, 0xC0, 0xC0, 0xC0, 0xC0, 0xC0, 0xFC, 0xC0, 0xC0, 0xC0, 0xC0, 0xC0, 0xC0, 0xC0, 0xFF, 

/* Symbol 0xC6, offset 3005 */
    12, 21, 5,
    0xE6, 0x70, 0x66, 0x60, 0x76, 0xE0, 0x36, 0xC0, 0x3F, 0xC0, 0x1F, 0x80, 0x0F, 0x00, 0x0F, 0x00, 0x0F, 0x00, 0x1F, 0x80, 0x1F, 0x80, 0x36, 0xC0, 0x36, 0xC0, 0x66, 0x60, 0x66, 0x60, 0xE6, 0x30, 

/* Symbol 0xC7, offset 3040 */
    9, 21, 5,
    0x3E, 0x00, 0x63, 0x00, 0x61, 0x80, 0x01, 0x80, 0x01, 0x80, 0x01, 0x80, 0x03, 0x00, 0x3E, 0x00, 0x03, 0x00, 0x01, 0x80, 0x01, 0x80, 0x01, 0x80, 0x01, 0x80, 0xC1, 0x80, 0x63, 0x00, 0x3E, 0x00, 

/* Symbol 0xC8, offset 3075 */
    10, 21, 4,
    0xC0, 0xC0, 0xC1, 0xC0, 0xC1, 0xC0, 0xC3, 0xC0, 0xC3, 0xC0, 0xC7, 0xC0,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 0xC0, 

/* Symbol 0xC9, offset 3112 */
    10, 21, 2,
    0x1E, 0x00, 0x00, 0x00, 0x00, 0x00, 0xC0, 0xC0, 0xC1, 0xC0, 0xC1, 0xC0,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 0xC0, 

/* Symbol 0xCA, offset 3153 */
    9, 21, 5,
    0xC1, 0x80, 0xC3, 0x00, 0xC7, 0x00, 0xCE, 0x00, 0xCC, 0x00, 0xD8, 0x00, 0xF8, 0x00, 0xF8, 0x00, 0xFC, 0x00, 0xCC, 0x00, 0xCE, 0x00, 0xC6, 0x00, 0xC7, 0x00, 0xC3, 0x00, 0xC3, 0x80, 0xC1, 0x80, 

/* Symbol 0xCB, offset 3188 */
    10, 21, 5,
    0x0F, 0xC0, 0x0C, 0xC0, 0x0C, 0xC0, 0x0C, 0xC0, 0x18, 0xC0, 0x18, 0xC0, 0x18, 0xC0, 0x30, 0xC0, 0x30, 0xC0, 0x30, 0xC0, 0x70, 0xC0, 0x60, 0xC0, 0x60, 0xC0, 0xE0, 0xC0, 0xC0, 0xC0, 0xC0, 0xC0, 

/* Symbol 0xCC, offset 3223 */
    12, 21, 5,
    0xC0, 0x30, 0xE0, 0x70, 0xE0, 0x70, 0xF0, 0xF0, 0xF9, 0xF0, 0xDF, 0xB0, 0xCF, 0x30, 0xCF, 0x30, 0xC6, 0x30, 0xC0, 0x30, 0xC0, 0x30, 0xC0, 0x30, 0xC0, 0x30, 0xC0, 0x30, 0xC0, 0x30, 0xC0, 0x30, 

/* Symbol 0xCD, offset 3258 */
    10, 21, 5,
    0xC0, 0xC0, 0xC0, 0xC0, 0xC0, 0xC0, 0xC0, 0xC0, 0xC0, 0xC0, 0xC0, 0xC0, 0xC0, 0xC0, 0xFF, 0xC0, 0xC0, 0xC0, 0xC0, 0xC0, 0xC0, 0xC0, 0xC0, 0xC0, 0xC0, 0xC0, 0xC0, 0xC0, 0xC0, 0xC0, 0xC0, 0xC0, 

/* Symbol 0xCE, offset 3293 */
    10, 21, 5,
    0x3F, 0x00, 0x61, 0x80, 0xC0, 0xC0, 0xC0, 0xC0, 0xC0, 0xC0, 0xC0, 0xC0, 0xC0, 0xC0, 0xC0, 0xC0, 0xC0, 0xC0, 0xC0, 0xC0, 0xC0, 0xC0, 0xC0, 0xC0, 0xC0, 0xC0, 0xC0, 0xC0, 0x61, 0x80, 0x3F, 0x00, 

/* Symbol 0xCF, offset 3328 */
    10, 21, 5,
    0xFF, 0xC0, 0xC0, 0xC0, 0xC0, 0xC0, 0xC0, 0xC0, 0xC0, 0xC0, 0xC0, 0xC0, 0xC0, 0xC0, 0xC0, 0xC0, 0xC0, 0xC0, 0xC0, 0xC0, 0xC0, 0xC0, 0xC0, 0xC0, 0xC0, 0xC0, 0xC0, 0xC0, 0xC0, 0xC0, 0xC0, 0xC0, 

/* Symbol 0xD0, offset 3363 */
    10, 21, 5,
    0xFF, 0x00, 0xC1, 0x80, 0xC0, 0xC0, 0xC0, 0xC0, 0xC0, 0xC0, 0xC0, 0xC0, 0xC0, 0xC0, 0xC1, 0x80, 0xFF, 0x00, 0xC0, 0x00, 0xC0, 0x00, 0xC0, 0x00, 0xC0, 0x00, 0xC0, 0x00, 0xC0, 0x00, 0xC0, 0x00, 

/* Symbol 0xD1, offset 3398 */
    8, 21, 5,
    0x3F, 0x60, 0xC0, 0xC0, 0xC0, 0xC0, 0xC0, 0xC0, 0xC0, 0xC0, 0xC0, 0xC0, 0xC0, 0xC0, 0x60, 0x3F, 

/* Symbol 0xD2, offset 3417 */
    10, 21, 5,
    0xFF, 0xC0, 0x0C, 0x00, 0x0C, 0x00, 0x0C, 0x00, 0x0C, 0x00, 0x0C, 0x00, 0x0C, 0x00, 0x0C, 0x00, 0x0C, 0x00, 0x0C, 0x00, 0x0C, 0x00, 0x0C, 0x00, 0x0C, 0x00, 0x0C, 0x00, 0x0C, 0x00, 0x0C, 0x00, 

/* Symbol 0xD3, offset 3452 */
    10, 21, 5,
    0xC0, 0xC0, 0xC0, 0xC0, 0xC0, 0xC0, 0xC0, 0xC0, 0xC0, 0xC0, 0xC0, 0xC0, 0xC0, 0xC0, 0x60, 0xC0, 0x3F, 0xC0, 0x00, 0xC0, 0x00, 0xC0, 0x00, 0xC0, 0x00, 0xC0, 0x00, 0xC0, 0x01, 0x80, 0x7F, 0x00, 

/* Symbol 0xD4, offset 3487 */
    14, 21, 5,
    0x03, 0x00, 0x03, 0x00, 0x1F, 0xE0, 0x73, 0x38, 0xE3, 0x1C, 0xC3, 0x0C, 0xC3, 0x0C, 0xC3, 0x0C, 0xC3, 0x0C, 0xE3, 0x1C, 0x73, 0x38, 0x1F, 0xE0, 0x03, 0x00, 0x03, 0x00, 0x03, 0x00, 0x03, 0x00, 

/* Symbol 0xD5, offset 3522 */
    11, 21, 5,
    0xC0, 0xE0, 0x60, 0xC0, 0x61, 0xC0, 0x31, 0x80, 0x3B, 0x00, 0x1B, 0x00, 0x1E, 0x00, 0x0E, 0x00, 0x0E, 0x00, 0x1E, 0x00, 0x1B, 0x00, 0x3B, 0x00, 0x31, 0x80, 0x61, 0xC0, 0x60, 0xC0, 0xC0, 0xE0, 

/* Symbol 0xD6, offset 3557 */
    10, 23, 5,
    0xC1, 0x80, 0xC1, 0x80, 0xC1, 0x80, 0xC1, 0x80, 0xC1, 0x80, 0xC1, 0x80,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 0xC0, 

/* Symbol 0xD7, offset 3596 */
    10, 21, 5,
    0xC0, 0xC0, 0xC0, 0xC0, 0xC0, 0xC0, 0xC0, 0xC0, 0xC0, 0xC0, 0xC0, 0xC0, 0xC0, 0xC0, 0x60, 0xC0, 0x3F, 0xC0, 0x00, 0xC0, 0x00, 0xC0, 0x00, 0xC0, 0x00, 0xC0, 0x00, 0xC0, 0x00, 0xC0, 0x00, 0xC0, 

/* Symbol 0xD8, offset 3631 */
    12, 21, 5,
    0xC6, 0x30, 0xC6, 0x30, 0xC6, 0x30, 0xC6, 0x30, 0xC6, 0x30, 0xC6, 0x30, 0xC6, 0x30, 0xC6, 0x30, 0xC6, 0x30, 0xC6, 0x30, 0xC6, 0x30, 0xC6, 0x30, 0xC6, 0x30, 0xC6, 0x30, 0xC6, 0x30, 0xFF, 0xF0, 

/* Symbol 0xD9, offset 3666 */
    13, 23, 5,
    0xC6, 0x30, 0xC6, 0x30, 0xC6, 0x30, 0xC6, 0x30, 0xC6, 0x30, 0xC6, 0x30,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 0x18, 

/* Symbol 0xDA, offset 3705 */
    11, 21, 5,
    0xF0, 0x00, 0x30, 0x00, 0x30, 0x00, 0x30, 0x00, 0x30, 0x00, 0x30, 0x00, 0x30, 0x00, 0x3F, 0x80, 0x30, 0xC0, 0x30, 0x60, 0x30, 0x60, 0x30, 0x60, 0x30, 0x60, 0x30, 0x60, 0x30, 0xC0, 0x3F, 0x80, 

/* Symbol 0xDB, offset 3740 */
    10, 21, 5,
    0xC0, 0xC0, 0xC0, 0xC0, 0xC0, 0xC0, 0xC0, 0xC0, 0xC0, 0xC0, 0xC0, 0xC0, 0xC0, 0xC0, 0xFC, 0xC0, 0xC6, 0xC0, 0xC3, 0xC0, 0xC3, 0xC0, 0xC3, 0xC0, 0xC3, 0xC0, 0xC3, 0xC0, 0xC6, 0xC0, 0xFC, 0xC0, 

/* Symbol 0xDC, offset 3775 */
    10, 21, 5,
    0xC0, 0x00, 0xC0, 0x00, 0xC0, 0x00, 0xC0, 0x00, 0xC0, 0x00, 0xC0, 0x00, 0xC0, 0x00, 0xFF, 0x00, 0xC1, 0x80, 0xC0, 0xC0, 0xC0, 0xC0, 0xC0, 0xC0, 0xC0, 0xC0, 0xC0, 0xC0, 0xC1, 0x80, 0xFF, 0x00, 

/* Symbol 0xDD, offset 3810 */
    9, 21, 5,
    0xFE, 0x00, 0x03, 0x00, 0x01, 0x80, 0x01, 0x80, 0x01, 0x80, 0x01, 0x80, 0x01, 0x80, 0x3F, 0x80, 0x01, 0x80, 0x01, 0x80, 0x01, 0x80, 0x01, 0x80, 0x01, 0x80, 0x01, 0x80, 0x03, 0x00, 0xFE, 0x00, 

/* Symbol 0xDE, offset 3845 */
    10, 21, 5,
    0xCF, 0x80, 0xD8, 0xC0, 0xD8, 0xC0, 0xD8, 0xC0, 0xD8, 0xC0, 0xD8, 0xC0, 0xD8, 0xC0, 0xF8, 0xC0, 0xD8, 0xC0, 0xD8, 0xC0, 0xD8, 0xC0, 0xD8, 0xC0, 0xD8, 0xC0, 0xD8, 0xC0, 0xDD, 0xC0, 0xCF, 0x80, 

/* Symbol 0xDF, offset 3880 */
    10, 21, 5,
    0x3F, 0xC0, 0x60, 0xC0, 0xC0, 0xC0, 0xC0, 0xC0, 0xC0, 0xC0, 0xC0, 0xC0, 0xC0, 0xC0, 0x60, 0xC0, 0x3F, 0xC0, 0x1C, 0xC0, 0x38, 0xC0, 0x38, 0xC0, 0x70, 0xC0, 0x60, 0xC0, 0xE0, 0xC0, 0xC0, 0xC0, 

/* Symbol 0xE0, offset 3915 */
    9, 21, 9,
    0x7F, 0x00, 0xC3, 0x00, 0xC3, 0x00, 0xC3, 0x00, 0xC3, 0x00, 0xC3, 0x00, 0xC3, 0x00, 0xC3, 0x00, 0xC3, 0x00, 0xC3, 0x00, 0xC3, 0x00, 0x7F, 0x80, 

/* Symbol 0xE1, offset 3942 */
    8, 21, 5,
    0xFF, 0x70, 0x38, 0x1C, 0x7E, 0xC3, 0xC3, 0xC3, 0xC3, 0xC3, 0xC3, 0xC3, 0xC3, 0xC3, 0xC3, 0x7E, 

/* Symbol 0xE2, offset 3961 */
    8, 21, 5,
    0x78, 0xDC, 0xDC, 0xF8, 0xFE, 0xC3, 0xC3, 0xC3, 0xC3, 0xC3, 0xC3, 0xC3, 0xC3, 0xC3, 0xC3, 0x7E, 

/* Symbol 0xE3, offset 3980 */
    8, 21, 9,
    0x7E, 0xC3, 0x03, 0x07, 0x0E, 0x1C, 0x38, 0x70, 0xE0, 0xC0, 0xE3, 0x7F, 

/* Symbol 0xE4, offset 3995 */
    8, 21, 5,
    0xFE, 0x03, 0x03, 0x03, 0x7F, 0xC3, 0xC3, 0xC3, 0xC3, 0xC3, 0xC3, 0xC3, 0xC3, 0xC3, 0xC3, 0x7E, 

/* Symbol 0xE5, offset 4014 */
    8, 21, 9,
    0x7E, 0xC3, 0xC3, 0xC3, 0xC3, 0xC3, 0xFF, 0xC0, 0xC0, 0xC0, 0xC0, 0x7F, 

/* Symbol 0xE6, offset 4029 */
    10, 21, 9,
    0xCC, 0xC0, 0xED, 0xC0, 0x6D, 0x80, 0x3F, 0x00, 0x3F, 0x00, 0x1E, 0x00, 0x1E, 0x00, 0x3F, 0x00, 0x3F, 0x00, 0x6D, 0x80, 0xED, 0xC0, 0xCC, 0xC0, 

/* Symbol 0xE7, offset 4056 */
    7, 21, 9,
    0x7C, 0xE6, 0x06, 0x06, 0x06, 0x06, 0x3E, 0x06, 0x06, 0x06, 0xC6, 0xFC, 

/* Symbol 0xE8, offset 4071 */
    8, 21, 9,
    0xC3, 0xC3, 0xC3, 0xC3, 0xC3, 0xC3, 0xC3, 0xC3, 0xC3, 0xC3, 0xC3, 0x7F, 

/* Symbol 0xE9, offset 4086 */
    8, 21, 5,
    0x3C, 0x00, 0x00, 0x00, 0xC3, 0xC3, 0xC3, 0xC3, 0xC3, 0xC3, 0xC3, 0xC3, 0xC3, 0xC3, 0xC3, 0x7F, 

/* Symbol 0xEA, offset 4105 */
    8, 21, 9,
    0xC3, 0xC6, 0xCC, 0xDC, 0xF8, 0xF0, 0xF8, 0xDC, 0xCC, 0xCE, 0xC6, 0xC3, 

/* Symbol 0xEB, offset 4120 */
    8, 21, 9,
    0x3F, 0x33, 0x33, 0x33, 0x33, 0x73, 0x63, 0x63, 0x63, 0x63, 0xE3, 0xC3, 

/* Symbol 0xEC, offset 4135 */
    10, 21, 9,
    0xC0, 0xC0, 0xE1, 0xC0, 0xF3, 0xC0, 0xF3, 0xC0, 0xDE, 0xC0, 0xDE, 0xC0, 0xCC, 0xC0, 0xC0, 0xC0, 0xC0, 0xC0, 0xC0, 0xC0, 0xC0, 0xC0, 0xC0, 0xC0, 

/* Symbol 0xED, offset 4162 */
    8, 21, 9,
    0xC3, 0xC3, 0xC3, 0xC3, 0xC3, 0xC3, 0xFF, 0xC3, 0xC3, 0xC3, 0xC3, 0xC3, 

/* Symbol 0xEE, offset 4177 */
    8, 21, 9,
    0x7E, 0xC3, 0xC3, 0xC3, 0xC3, 0xC3, 0xC3, 0xC3, 0xC3, 0xC3, 0xC3, 0x7E, 

/* Symbol 0xEF, offset 4192 */
    8, 21, 9,
    0xFE, 0xC3, 0xC3, 0xC3, 0xC3, 0xC3, 0xC3, 0xC3, 0xC3, 0xC3, 0xC3, 0xC3, 

/* Symbol 0xF0, offset 4207 */
    8, 25, 9,
    0xFE, 0xC3, 0xC3, 0xC3, 0xC3, 0xC3, 0xC3, 0xC3, 0xC3, 0xC3, 0xC3, 0xFE, 0xC0, 0xC0, 0xC0, 0xC0, 

/* Symbol 0xF1, offset 4226 */
    8, 21, 9,
    0x7F, 0xC0, 0xC0, 0xC0, 0xC0, 0xC0, 0xC0, 0xC0, 0xC0, 0xC0, 0xC0, 0x7F, 

/* Symbol 0xF2, offset 4241 */
    12, 21, 9,
    0xFF, 0xE0, 0xC6, 0x30, 0xC6, 0x30, 0xC6, 0x30, 0xC6, 0x30, 0xC6, 0x30, 0xC6, 0x30, 0xC6, 0x30, 0xC6, 0x30, 0xC6, 0x30, 0xC6, 0x30, 0xC6, 0x30, 

/* Symbol 0xF3, offset 4268 */
    8, 25, 9,
    0xC3, 0xC3, 0xC3, 0xC3, 0xC3, 0xC3, 0xC3, 0xC3, 0xC3, 0xC3, 0xC3, 0x7F, 0x03, 0x03, 0x03, 0x03, 

/* Symbol 0xF4, offset 4287 */
    12, 25, 7,
    0x06, 0x00, 0x06, 0x00, 0x3F, 0xC0, 0x66, 0x60, 0xC6, 0x30, 0xC6, 0x30,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 0x00, 

/* Symbol 0xF5, offset 4326 */
    8, 21, 9,
    0xC3, 0x67, 0x66, 0x3E, 0x3C, 0x1C, 0x1C, 0x3C, 0x3E, 0x66, 0x67, 0xC3, 

/* Symbol 0xF6, offset 4341 */
    9, 23, 9,
    0xC3, 0x00, 0xC3, 0x00, 0xC3, 0x00, 0xC3, 0x00, 0xC3, 0x00, 0xC3, 0x00, 0xC3, 0x00, 0xC3, 0x00, 0xC3, 0x00, 0xC3, 0x00, 0xC3, 0x00, 0x7F, 0x80, 0x01, 0x80, 0x01, 0x80, 

/* Symbol 0xF7, offset 4372 */
    8, 21, 9,
    0xC3, 0xC3, 0xC3, 0xC3, 0xC3, 0xC3, 0x7F, 0x03, 0x03, 0x03, 0x03, 0x03, 

/* Symbol 0xF8, offset 4387 */
    12, 21, 9,
    0xC6, 0x30, 0xC6, 0x30, 0xC6, 0x30, 0xC6, 0x30, 0xC6, 0x30, 0xC6, 0x30, 0xC6, 0x30, 0xC6, 0x30, 0xC6, 0x30, 0xC6, 0x30, 0xC6, 0x30, 0x7F, 0xF0, 

/* Symbol 0xF9, offset 4414 */
    13, 23, 9,
    0xC6, 0x30, 0xC6, 0x30, 0xC6, 0x30, 0xC6, 0x30, 0xC6, 0x30, 0xC6, 0x30, 0xC6, 0x30, 0xC6, 0x30, 0xC6, 0x30, 0xC6, 0x30, 0xC6, 0x30, 0x7F, 0xF8, 0x00, 0x18, 0x00, 0x18, 

/* Symbol 0xFA, offset 4445 */
    10, 21, 9,
    0xF0, 0x00, 0x30, 0x00, 0x30, 0x00, 0x30, 0x00, 0x30, 0x00, 0x30, 0x00, 0x3F, 0x80, 0x30, 0xC0, 0x30, 0xC0, 0x30, 0xC0, 0x30, 0xC0, 0x3F, 0x80, 

/* Symbol 0xFB, offset 4472 */
    9, 21, 9,
    0xC1, 0x80, 0xC1, 0x80, 0xC1, 0x80, 0xC1, 0x80, 0xC1, 0x80, 0xC1, 0x80, 0xFD, 0x80, 0xC7, 0x80, 0xC7, 0x80, 0xC7, 0x80, 0xC7, 0x80, 0xFD, 0x80, 

/* Symbol 0xFC, offset 4499 */
    8, 21, 9,
    0xC0, 0xC0, 0xC0, 0xC0, 0xC0, 0xC0, 0xFE, 0xC3, 0xC3, 0xC3, 0xC3, 0xFE, 

/* Symbol 0xFD, offset 4514 */
    8, 21, 9,
    0xFE, 0x03, 0x03, 0x03, 0x03, 0x03, 0x1F, 0x03, 0x03, 0x03, 0x03, 0xFE, 

/* Symbol 0xFE, offset 4529 */
    9, 21, 9,
    0xCF, 0x00, 0xD9, 0x80, 0xD9, 0x80, 0xD9, 0x80, 0xD9, 0x80, 0xF9, 0x80, 0xF9, 0x80, 0xD9, 0x80, 0xD9, 0x80, 0xD9, 0x80, 0xD9, 0x80, 0xCF, 0x00, 

/* Symbol 0xFF, offset 4556 */
    8, 21, 9,
    0x7F, 0xC3, 0xC3, 0xC3, 0xC3, 0xC3, 0x7F, 0x3B, 0x33, 0x63, 0xE3, 0xC3
};
