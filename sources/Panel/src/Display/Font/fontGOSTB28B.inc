/*
    FaceName - GOST type B
    PointSize - 28
    FontWeight - bold
    Style - normal
    Family - default
    Cell width - 30
    Cell height - 30
    Offset x - -3
    Offset y - -8
*/
const unsigned char fontGOSTB28B[8398] =
{
/* 0x00 */   0x00, 0x00,
/* 0x01 */   0x00, 0x00,
/* 0x02 */   0x00, 0x00,
/* 0x03 */   0x00, 0x00,
/* 0x04 */   0x00, 0x00,
/* 0x05 */   0x00, 0x00,
/* 0x06 */   0x00, 0x00,
/* 0x07 */   0x00, 0x00,
/* 0x08 */   0x00, 0x00,
/* 0x09 */   0x00, 0x00,
/* 0x0A */   0x00, 0x00,
/* 0x0B */   0x00, 0x00,
/* 0x0C */   0x00, 0x00,
/* 0x0D */   0x00, 0x00,
/* 0x0E */   0x00, 0x00,
/* 0x0F */   0x00, 0x00,
/* 0x10 */   0x00, 0x00,
/* 0x11 */   0x00, 0x00,
/* 0x12 */   0x00, 0x00,
/* 0x13 */   0x00, 0x00,
/* 0x14 */   0x00, 0x00,
/* 0x15 */   0x00, 0x00,
/* 0x16 */   0x00, 0x00,
/* 0x17 */   0x00, 0x00,
/* 0x18 */   0x00, 0x00,
/* 0x19 */   0x00, 0x00,
/* 0x1A */   0x00, 0x00,
/* 0x1B */   0x00, 0x00,
/* 0x1C */   0x00, 0x00,
/* 0x1D */   0x00, 0x00,
/* 0x1E */   0x00, 0x00,
/* 0x1F */   0x00, 0x00,
/* 0x20 */   0x00, 0x02,
/* 0x21 */   0x07, 0x02,
/* 0x22 */   0x23, 0x02,
/* 0x23 */   0x2D, 0x02,
/* 0x24 */   0x7B, 0x02,
/* 0x25 */   0xBA, 0x02,
/* 0x26 */   0x21, 0x03,
/* 0x27 */   0x6F, 0x03,
/* 0x28 */   0x79, 0x03,
/* 0x29 */   0x99, 0x03,
/* 0x2A */   0xB9, 0x03,
/* 0x2B */   0xD0, 0x03,
/* 0x2C */   0xEB, 0x03,
/* 0x2D */   0xF7, 0x03,
/* 0x2E */   0xFE, 0x03,
/* 0x2F */   0x04, 0x04,
/* 0x30 */   0x43, 0x04,
/* 0x31 */   0x78, 0x04,
/* 0x32 */   0x94, 0x04,
/* 0x33 */   0xC9, 0x04,
/* 0x34 */   0xFE, 0x04,
/* 0x35 */   0x33, 0x05,
/* 0x36 */   0x68, 0x05,
/* 0x37 */   0x9D, 0x05,
/* 0x38 */   0xD2, 0x05,
/* 0x39 */   0x07, 0x06,
/* 0x3A */   0x3C, 0x06,
/* 0x3B */   0x4C, 0x06,
/* 0x3C */   0x61, 0x06,
/* 0x3D */   0x7C, 0x06,
/* 0x3E */   0x91, 0x06,
/* 0x3F */   0xAC, 0x06,
/* 0x40 */   0xE1, 0x06,
/* 0x41 */   0x48, 0x07,
/* 0x42 */   0x96, 0x07,
/* 0x43 */   0xCB, 0x07,
/* 0x44 */   0x00, 0x08,
/* 0x45 */   0x35, 0x08,
/* 0x46 */   0x6A, 0x08,
/* 0x47 */   0x9F, 0x08,
/* 0x48 */   0xD4, 0x08,
/* 0x49 */   0x09, 0x09,
/* 0x4A */   0x25, 0x09,
/* 0x4B */   0x5A, 0x09,
/* 0x4C */   0x8F, 0x09,
/* 0x4D */   0xC4, 0x09,
/* 0x4E */   0x12, 0x0A,
/* 0x4F */   0x47, 0x0A,
/* 0x50 */   0x7C, 0x0A,
/* 0x51 */   0xB1, 0x0A,
/* 0x52 */   0xFF, 0x0A,
/* 0x53 */   0x34, 0x0B,
/* 0x54 */   0x69, 0x0B,
/* 0x55 */   0x9E, 0x0B,
/* 0x56 */   0xD3, 0x0B,
/* 0x57 */   0x21, 0x0C,
/* 0x58 */   0x6F, 0x0C,
/* 0x59 */   0xBD, 0x0C,
/* 0x5A */   0x0B, 0x0D,
/* 0x5B */   0x59, 0x0D,
/* 0x5C */   0x78, 0x0D,
/* 0x5D */   0xB7, 0x0D,
/* 0x5E */   0xD6, 0x0D,
/* 0x5F */   0xDD, 0x0D,
/* 0x60 */   0xE6, 0x0D,
/* 0x61 */   0x1B, 0x0E,
/* 0x62 */   0x42, 0x0E,
/* 0x63 */   0x77, 0x0E,
/* 0x64 */   0x9E, 0x0E,
/* 0x65 */   0xD3, 0x0E,
/* 0x66 */   0xFA, 0x0E,
/* 0x67 */   0x2F, 0x0F,
/* 0x68 */   0x60, 0x0F,
/* 0x69 */   0x95, 0x0F,
/* 0x6A */   0xB1, 0x0F,
/* 0x6B */   0xD2, 0x0F,
/* 0x6C */   0x07, 0x10,
/* 0x6D */   0x23, 0x10,
/* 0x6E */   0x5C, 0x10,
/* 0x6F */   0x83, 0x10,
/* 0x70 */   0xAA, 0x10,
/* 0x71 */   0xDB, 0x10,
/* 0x72 */   0x0C, 0x11,
/* 0x73 */   0x33, 0x11,
/* 0x74 */   0x5A, 0x11,
/* 0x75 */   0x8F, 0x11,
/* 0x76 */   0xB6, 0x11,
/* 0x77 */   0xDD, 0x11,
/* 0x78 */   0x16, 0x12,
/* 0x79 */   0x3D, 0x12,
/* 0x7A */   0x6E, 0x12,
/* 0x7B */   0x95, 0x12,
/* 0x7C */   0xB4, 0x12,
/* 0x7D */   0xE9, 0x12,
/* 0x7E */   0x08, 0x13,
/* 0x7F */   0x15, 0x13,
/* 0x80 */   0x00, 0x00,
/* 0x81 */   0x00, 0x00,
/* 0x82 */   0x00, 0x00,
/* 0x83 */   0x00, 0x00,
/* 0x84 */   0x00, 0x00,
/* 0x85 */   0x00, 0x00,
/* 0x86 */   0x00, 0x00,
/* 0x87 */   0x00, 0x00,
/* 0x88 */   0x00, 0x00,
/* 0x89 */   0x00, 0x00,
/* 0x8A */   0x00, 0x00,
/* 0x8B */   0x00, 0x00,
/* 0x8C */   0x00, 0x00,
/* 0x8D */   0x00, 0x00,
/* 0x8E */   0x00, 0x00,
/* 0x8F */   0x00, 0x00,
/* 0x90 */   0x00, 0x00,
/* 0x91 */   0x00, 0x00,
/* 0x92 */   0x00, 0x00,
/* 0x93 */   0x00, 0x00,
/* 0x94 */   0x00, 0x00,
/* 0x95 */   0x00, 0x00,
/* 0x96 */   0x00, 0x00,
/* 0x97 */   0x00, 0x00,
/* 0x98 */   0x00, 0x00,
/* 0x99 */   0x00, 0x00,
/* 0x9A */   0x00, 0x00,
/* 0x9B */   0x00, 0x00,
/* 0x9C */   0x00, 0x00,
/* 0x9D */   0x00, 0x00,
/* 0x9E */   0x00, 0x00,
/* 0x9F */   0x00, 0x00,
/* 0xA0 */   0x00, 0x00,
/* 0xA1 */   0x00, 0x00,
/* 0xA2 */   0x00, 0x00,
/* 0xA3 */   0x00, 0x00,
/* 0xA4 */   0x00, 0x00,
/* 0xA5 */   0x00, 0x00,
/* 0xA6 */   0x00, 0x00,
/* 0xA7 */   0x00, 0x00,
/* 0xA8 */   0x00, 0x00,
/* 0xA9 */   0x00, 0x00,
/* 0xAA */   0x00, 0x00,
/* 0xAB */   0x00, 0x00,
/* 0xAC */   0x00, 0x00,
/* 0xAD */   0x00, 0x00,
/* 0xAE */   0x00, 0x00,
/* 0xAF */   0x00, 0x00,
/* 0xB0 */   0x00, 0x00,
/* 0xB1 */   0x00, 0x00,
/* 0xB2 */   0x00, 0x00,
/* 0xB3 */   0x00, 0x00,
/* 0xB4 */   0x00, 0x00,
/* 0xB5 */   0x00, 0x00,
/* 0xB6 */   0x00, 0x00,
/* 0xB7 */   0x00, 0x00,
/* 0xB8 */   0x00, 0x00,
/* 0xB9 */   0x00, 0x00,
/* 0xBA */   0x00, 0x00,
/* 0xBB */   0x00, 0x00,
/* 0xBC */   0x00, 0x00,
/* 0xBD */   0x00, 0x00,
/* 0xBE */   0x00, 0x00,
/* 0xBF */   0x00, 0x00,
/* 0xC0 */   0x30, 0x13,
/* 0xC1 */   0x7E, 0x13,
/* 0xC2 */   0xB3, 0x13,
/* 0xC3 */   0xE8, 0x13,
/* 0xC4 */   0x1D, 0x14,
/* 0xC5 */   0x74, 0x14,
/* 0xC6 */   0xA9, 0x14,
/* 0xC7 */   0xF7, 0x14,
/* 0xC8 */   0x2C, 0x15,
/* 0xC9 */   0x61, 0x15,
/* 0xCA */   0x96, 0x15,
/* 0xCB */   0xCB, 0x15,
/* 0xCC */   0x00, 0x16,
/* 0xCD */   0x4E, 0x16,
/* 0xCE */   0x83, 0x16,
/* 0xCF */   0xB8, 0x16,
/* 0xD0 */   0xED, 0x16,
/* 0xD1 */   0x22, 0x17,
/* 0xD2 */   0x57, 0x17,
/* 0xD3 */   0x8C, 0x17,
/* 0xD4 */   0xC1, 0x17,
/* 0xD5 */   0x0F, 0x18,
/* 0xD6 */   0x5D, 0x18,
/* 0xD7 */   0xB7, 0x18,
/* 0xD8 */   0xEC, 0x18,
/* 0xD9 */   0x3A, 0x19,
/* 0xDA */   0x94, 0x19,
/* 0xDB */   0xE2, 0x19,
/* 0xDC */   0x30, 0x1A,
/* 0xDD */   0x65, 0x1A,
/* 0xDE */   0x9A, 0x1A,
/* 0xDF */   0xE8, 0x1A,
/* 0xE0 */   0x1D, 0x1B,
/* 0xE1 */   0x44, 0x1B,
/* 0xE2 */   0x79, 0x1B,
/* 0xE3 */   0xAE, 0x1B,
/* 0xE4 */   0xD5, 0x1B,
/* 0xE5 */   0x0A, 0x1C,
/* 0xE6 */   0x31, 0x1C,
/* 0xE7 */   0x6A, 0x1C,
/* 0xE8 */   0x91, 0x1C,
/* 0xE9 */   0xB8, 0x1C,
/* 0xEA */   0xED, 0x1C,
/* 0xEB */   0x14, 0x1D,
/* 0xEC */   0x3B, 0x1D,
/* 0xED */   0x62, 0x1D,
/* 0xEE */   0x89, 0x1D,
/* 0xEF */   0xB0, 0x1D,
/* 0xF0 */   0xD7, 0x1D,
/* 0xF1 */   0x08, 0x1E,
/* 0xF2 */   0x2F, 0x1E,
/* 0xF3 */   0x68, 0x1E,
/* 0xF4 */   0x99, 0x1E,
/* 0xF5 */   0xF0, 0x1E,
/* 0xF6 */   0x17, 0x1F,
/* 0xF7 */   0x42, 0x1F,
/* 0xF8 */   0x69, 0x1F,
/* 0xF9 */   0xA2, 0x1F,
/* 0xFA */   0xE4, 0x1F,
/* 0xFB */   0x0B, 0x20,
/* 0xFC */   0x32, 0x20,
/* 0xFD */   0x59, 0x20,
/* 0xFE */   0x80, 0x20,
/* 0xFF */   0xA7, 0x20,

/* Symbol 0x20, offset 512 */
    30, 1, 0,
    0x00, 0x00, 0x00, 0x00, 

/* Symbol 0x21, offset 519 */
    3, 25, 0,
    0xE0, 0xE0, 0xE0, 0xE0, 0xE0, 0xE0, 0xE0, 0xE0, 0xE0, 0xE0, 0xE0, 0xE0, 0xE0, 0xE0, 0xE0, 0xE0, 0xE0, 0xE0, 0xE0, 0xE0, 0x00, 0x00, 0xC0, 0xE0, 0xE0, 

/* Symbol 0x22, offset 547 */
    8, 7, 0,
    0xE7, 0xEF, 0xEF, 0xCF, 0xCE, 0xDE, 0xDE, 

/* Symbol 0x23, offset 557 */
    20, 25, 0,
    0x01, 0xC1, 0xC0, 0x01, 0xC1, 0xC0, 0x03, 0xC3, 0xC0, 0x03, 0xC3, 0xC0,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 0x00, 

/* Symbol 0x24, offset 635 */
    16, 30, 0,
    0x1F, 0xF0, 0x7F, 0xFC, 0x7F, 0xFE, 0xF3, 0x8E, 0xE3, 0x80, 0xE3, 0x80,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 0x80, 

/* Symbol 0x25, offset 698 */
    30, 25, 0,
    0x3F, 0x80, 0x03, 0xC0, 0x7F, 0xE0, 0x03, 0xC0, 0xF9, 0xE0, 0x07, 0x80,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 0xFC, 

/* Symbol 0x26, offset 801 */
    19, 25, 0,
    0x07, 0xE0, 0x00, 0x0F, 0xF0, 0x00, 0x1E, 0x78, 0x00, 0x1C, 0x38, 0x00,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 0xE0, 

/* Symbol 0x27, offset 879 */
    3, 7, 0,
    0xE0, 0xE0, 0xE0, 0xE0, 0xE0, 0xC0, 0xC0, 

/* Symbol 0x28, offset 889 */
    7, 29, 0,
    0x1E, 0x3C, 0x3C, 0x38, 0x78, 0x78, 0x70, 0xF0, 0xF0, 0xF0, 0xE0, 0xE0, 0xE0, 0xE0, 0xE0, 0xE0, 0xE0, 0xF0, 0xF0, 0xF0, 0x70, 0x70, 0x78, 0x78, 0x38, 0x3C, 0x1C, 0x1E, 0x0E, 

/* Symbol 0x29, offset 921 */
    7, 29, 0,
    0xE0, 0xF0, 0x70, 0x78, 0x78, 0x38, 0x3C, 0x3C, 0x1C, 0x1C, 0x1C, 0x1C, 0x1E, 0x1E, 0x1E, 0x1C, 0x1C, 0x1C, 0x1C, 0x3C, 0x3C, 0x3C, 0x38, 0x78, 0x78, 0xF0, 0xF0, 0xE0, 0xE0, 

/* Symbol 0x2A, offset 953 */
    12, 10, 0,
    0x39, 0xC0, 0x3F, 0xC0, 0x3F, 0xC0, 0x1F, 0x80, 0xFF, 0xF0, 0xFF, 0xF0, 0x1F, 0x80, 0x3F, 0xC0, 0x3F, 0xC0, 0x39, 0xC0, 

/* Symbol 0x2B, offset 976 */
    13, 22, 10,
    0x07, 0x00, 0x07, 0x00, 0x07, 0x00, 0x07, 0x00, 0x07, 0x00, 0xFF, 0xF8, 0xFF, 0xF8, 0x07, 0x00, 0x07, 0x00, 0x07, 0x00, 0x07, 0x00, 0x07, 0x00, 

/* Symbol 0x2C, offset 1003 */
    3, 30, 21,
    0xE0, 0xE0, 0xE0, 0xE0, 0xE0, 0xE0, 0xC0, 0xC0, 0xC0, 

/* Symbol 0x2D, offset 1015 */
    13, 17, 15,
    0xFF, 0xF8, 0xFF, 0xF8, 

/* Symbol 0x2E, offset 1022 */
    3, 25, 22,
    0xC0, 0xE0, 0xE0, 

/* Symbol 0x2F, offset 1028 */
    14, 30, 0,
    0x00, 0x1C, 0x00, 0x3C, 0x00, 0x3C, 0x00, 0x78, 0x00, 0x78, 0x00, 0x70,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 0x00, 

/* Symbol 0x30, offset 1091 */
    13, 25, 0,
    0x3F, 0xE0, 0x7F, 0xF0, 0xF8, 0xF0, 0xF0, 0x78, 0xE0, 0x38, 0xE0, 0x38,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 0xC0, 

/* Symbol 0x31, offset 1144 */
    8, 25, 0,
    0x07, 0x0F, 0x1F, 0x3F, 0x7F, 0xF7, 0xE7, 0x07, 0x07, 0x07, 0x07, 0x07, 0x07, 0x07, 0x07, 0x07, 0x07, 0x07, 0x07, 0x07, 0x07, 0x07, 0x07, 0x07, 0x07, 

/* Symbol 0x32, offset 1172 */
    13, 25, 0,
    0x3F, 0x80, 0x7F, 0xE0, 0xF9, 0xF0, 0xE0, 0xF0, 0xE0, 0x78, 0x00, 0x78,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 0xF8, 

/* Symbol 0x33, offset 1225 */
    13, 25, 0,
    0xFF, 0xC0, 0xFF, 0xE0, 0x01, 0xF0, 0x00, 0x78, 0x00, 0x78, 0x00, 0x78,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 0x80, 

/* Symbol 0x34, offset 1278 */
    16, 25, 0,
    0x07, 0x00, 0x0F, 0x00, 0x0F, 0x00, 0x0E, 0x00, 0x0E, 0x00, 0x1E, 0x00,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 0x70, 

/* Symbol 0x35, offset 1331 */
    13, 25, 0,
    0xFF, 0xF8, 0xFF, 0xF8, 0xE0, 0x00, 0xE0, 0x00, 0xE0, 0x00, 0xE0, 0x00,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 0x80, 

/* Symbol 0x36, offset 1384 */
    13, 25, 0,
    0x03, 0xE0, 0x07, 0xE0, 0x0F, 0x80, 0x1E, 0x00, 0x3C, 0x00, 0x3C, 0x00,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 0xC0, 

/* Symbol 0x37, offset 1437 */
    13, 25, 0,
    0xFF, 0xF8, 0xFF, 0xF8, 0xE0, 0x78, 0xE0, 0x78, 0xE0, 0x70, 0x00, 0xF0,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 0x00, 

/* Symbol 0x38, offset 1490 */
    16, 25, 0,
    0x0F, 0xE0, 0x1F, 0xF8, 0x3E, 0x78, 0x78, 0x3C, 0x78, 0x1C, 0x70, 0x1C,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 0xE0, 

/* Symbol 0x39, offset 1543 */
    13, 25, 0,
    0x3F, 0xE0, 0x7F, 0xF0, 0xF0, 0xF8, 0xE0, 0x78, 0xE0, 0x38, 0xE0, 0x38,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 0x00, 

/* Symbol 0x3A, offset 1596 */
    3, 25, 12,
    0xE0, 0xE0, 0xE0, 0x00, 0x00, 0x00, 0x00, 0x00, 0x00, 0x00, 0xC0, 0xE0, 0xE0, 

/* Symbol 0x3B, offset 1612 */
    3, 30, 12,
    0xE0, 0xE0, 0xE0, 0x00, 0x00, 0x00, 0x00, 0x00, 0x00, 0x00, 0xC0, 0xE0, 0xE0, 0xE0, 0xC0, 0xC0, 0xC0, 0xC0, 

/* Symbol 0x3C, offset 1633 */
    13, 22, 10,
    0x00, 0x78, 0x01, 0xF8, 0x07, 0xF0, 0x1F, 0xC0, 0x7F, 0x00, 0xFC, 0x00, 0xF8, 0x00, 0x7E, 0x00, 0x1F, 0x80, 0x07, 0xE0, 0x01, 0xF8, 0x00, 0x78, 

/* Symbol 0x3D, offset 1660 */
    13, 20, 11,
    0xFF, 0xF8, 0xFF, 0xF8, 0xFF, 0xF0, 0x00, 0x00, 0x00, 0x00, 0x00, 0x00, 0xFF, 0xF0, 0xFF, 0xF8, 0xFF, 0xF8, 

/* Symbol 0x3E, offset 1681 */
    13, 22, 10,
    0xE0, 0x00, 0xF8, 0x00, 0x7E, 0x00, 0x1F, 0x80, 0x07, 0xE0, 0x01, 0xF8, 0x01, 0xF8, 0x07, 0xF0, 0x1F, 0xC0, 0x7F, 0x00, 0xFC, 0x00, 0xF0, 0x00, 

/* Symbol 0x3F, offset 1708 */
    13, 25, 0,
    0x3F, 0xC0, 0x7F, 0xE0, 0xF9, 0xF0, 0xF0, 0x70, 0xE0, 0x78, 0x00, 0x78,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 0x00, 

/* Symbol 0x40, offset 1761 */
    26, 25, 0,
    0x00, 0xFF, 0xC0, 0x00, 0x03, 0xFF, 0xF0, 0x00, 0x0F, 0xE1, 0xF8, 0x00,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 0x00, 

/* Symbol 0x41, offset 1864 */
    18, 25, 0,
    0x01, 0xE0, 0x00, 0x01, 0xE0, 0x00, 0x01, 0xE0, 0x00, 0x03, 0xF0, 0x00,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 0xC0, 

/* Symbol 0x42, offset 1942 */
    16, 25, 0,
    0xFF, 0xF0, 0xFF, 0xF8, 0xE0, 0x3C, 0xE0, 0x1C, 0xE0, 0x1C, 0xE0, 0x1C,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 0xF8, 

/* Symbol 0x43, offset 1995 */
    13, 25, 0,
    0x3F, 0xF8, 0x7F, 0xF8, 0xF0, 0x00, 0xE0, 0x00, 0xE0, 0x00, 0xE0, 0x00,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 0xF8, 

/* Symbol 0x44, offset 2048 */
    16, 25, 0,
    0xFF, 0xF8, 0xFF, 0xFE, 0xE0, 0x1E, 0xE0, 0x0F, 0xE0, 0x0F, 0xE0, 0x0F,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 0xF8, 

/* Symbol 0x45, offset 2101 */
    13, 25, 0,
    0xFF, 0xF8, 0xFF, 0xF8, 0xE0, 0x00, 0xE0, 0x00, 0xE0, 0x00, 0xE0, 0x00,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 0xF8, 

/* Symbol 0x46, offset 2154 */
    13, 25, 0,
    0xFF, 0xF8, 0xFF, 0xF8, 0xE0, 0x00, 0xE0, 0x00, 0xE0, 0x00, 0xE0, 0x00,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 0x00, 

/* Symbol 0x47, offset 2207 */
    16, 25, 0,
    0x3F, 0xFF, 0x7F, 0xFF, 0xF0, 0x00, 0xE0, 0x00, 0xE0, 0x00, 0xE0, 0x00,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 0xFF, 

/* Symbol 0x48, offset 2260 */
    16, 25, 0,
    0xE0, 0x0F, 0xE0, 0x0F, 0xE0, 0x0F, 0xE0, 0x0F, 0xE0, 0x0F, 0xE0, 0x0F,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 0x0E, 

/* Symbol 0x49, offset 2313 */
    3, 25, 0,
    0xE0, 0xE0, 0xE0, 0xE0, 0xE0, 0xE0, 0xE0, 0xE0, 0xE0, 0xE0, 0xE0, 0xE0, 0xE0, 0xE0, 0xE0, 0xE0, 0xE0, 0xE0, 0xE0, 0xE0, 0xE0, 0xE0, 0xE0, 0xE0, 0xE0, 

/* Symbol 0x4A, offset 2341 */
    11, 25, 0,
    0x01, 0xE0, 0x01, 0xE0, 0x01, 0xE0, 0x01, 0xE0, 0x01, 0xE0, 0x01, 0xE0,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 0x00, 

/* Symbol 0x4B, offset 2394 */
    16, 25, 0,
    0xE0, 0x0F, 0xE0, 0x1F, 0xE0, 0x3E, 0xE0, 0x7C, 0xE0, 0xF8, 0xE1, 0xF0,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 0x07, 

/* Symbol 0x4C, offset 2447 */
    13, 25, 0,
    0xE0, 0x00, 0xE0, 0x00, 0xE0, 0x00, 0xE0, 0x00, 0xE0, 0x00, 0xE0, 0x00,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 0xF8, 

/* Symbol 0x4D, offset 2500 */
    18, 25, 0,
    0xE0, 0x01, 0xC0, 0xF0, 0x03, 0xC0, 0xF0, 0x03, 0xC0, 0xF8, 0x07, 0xC0,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 0xC0, 

/* Symbol 0x4E, offset 2578 */
    16, 25, 0,
    0xE0, 0x0F, 0xE0, 0x0F, 0xF0, 0x0F, 0xF8, 0x0F, 0xF8, 0x0F, 0xFC, 0x0F,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 0x0E, 

/* Symbol 0x4F, offset 2631 */
    16, 25, 0,
    0x3F, 0xF8, 0x7F, 0xFE, 0xF0, 0x1E, 0xE0, 0x0F, 0xE0, 0x0F, 0xE0, 0x0F,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 0xF8, 

/* Symbol 0x50, offset 2684 */
    16, 25, 0,
    0xFF, 0xF8, 0xFF, 0xFE, 0xE0, 0x1E, 0xE0, 0x0F, 0xE0, 0x0F, 0xE0, 0x0F,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 0x00, 

/* Symbol 0x51, offset 2737 */
    18, 25, 0,
    0x3F, 0xF8, 0x00, 0x7F, 0xFE, 0x00, 0xF0, 0x1E, 0x00, 0xE0, 0x0F, 0x00,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 0xC0, 

/* Symbol 0x52, offset 2815 */
    16, 25, 0,
    0xFF, 0xF8, 0xFF, 0xFE, 0xE0, 0x1E, 0xE0, 0x0F, 0xE0, 0x0F, 0xE0, 0x0F,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 0x0E, 

/* Symbol 0x53, offset 2868 */
    16, 25, 0,
    0x1F, 0xF0, 0x7F, 0xFC, 0x7C, 0x3E, 0xF0, 0x0E, 0xE0, 0x00, 0xE0, 0x00,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 0xE0, 

/* Symbol 0x54, offset 2921 */
    16, 25, 0,
    0xFF, 0xFF, 0xFF, 0xFF, 0x03, 0x80, 0x03, 0x80, 0x03, 0x80, 0x03, 0x80,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 0x80, 

/* Symbol 0x55, offset 2974 */
    16, 25, 0,
    0xE0, 0x0F, 0xE0, 0x0F, 0xE0, 0x0F, 0xE0, 0x0F, 0xE0, 0x0F, 0xE0, 0x0F,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 0xF8, 

/* Symbol 0x56, offset 3027 */
    18, 25, 0,
    0xE0, 0x01, 0xC0, 0xE0, 0x03, 0xC0, 0xF0, 0x03, 0xC0, 0xF0, 0x03, 0x80,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 0x00, 

/* Symbol 0x57, offset 3105 */
    23, 25, 0,
    0xE0, 0x00, 0x0E, 0xE0, 0x00, 0x0E, 0xE0, 0x00, 0x1E, 0xF0, 0x00, 0x1E,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 0xC0, 

/* Symbol 0x58, offset 3183 */
    18, 25, 0,
    0xE0, 0x01, 0xC0, 0xF0, 0x03, 0xC0, 0xF0, 0x07, 0x80, 0x78, 0x07, 0x80,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 0xC0, 

/* Symbol 0x59, offset 3261 */
    18, 25, 0,
    0xE0, 0x01, 0xC0, 0xF0, 0x03, 0xC0, 0xF0, 0x03, 0xC0, 0x78, 0x07, 0x80,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 0x00, 

/* Symbol 0x5A, offset 3339 */
    19, 25, 0,
    0xFF, 0xFF, 0xC0, 0xFF, 0xFF, 0xE0, 0x00, 0x03, 0xC0, 0x00, 0x07, 0x80,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 0xC0, 

/* Symbol 0x5B, offset 3417 */
    6, 28, 0,
    0xE0, 0xE0, 0xE0, 0xE0, 0xE0, 0xE0, 0xE0, 0xE0, 0xE0, 0xE0, 0xE0, 0xE0, 0xE0, 0xE0, 0xE0, 0xE0, 0xE0, 0xE0, 0xE0, 0xE0, 0xE0, 0xE0, 0xE0, 0xE0, 0xE0, 0xFC, 0xFC, 0x78, 

/* Symbol 0x5C, offset 3448 */
    15, 30, 0,
    0xF0, 0x00, 0x70, 0x00, 0x78, 0x00, 0x78, 0x00, 0x3C, 0x00, 0x3C, 0x00,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 0x0E, 

/* Symbol 0x5D, offset 3511 */
    5, 28, 0,
    0x38, 0x38, 0x38, 0x38, 0x38, 0x38, 0x38, 0x38, 0x38, 0x38, 0x38, 0x38, 0x38, 0x38, 0x38, 0x38, 0x38, 0x38, 0x38, 0x38, 0x38, 0x38, 0x38, 0x38, 0x38, 0xF8, 0xF8, 0xF0, 

/* Symbol 0x5E, offset 3542 */
    30, 1, 0,
    0x00, 0x00, 0x00, 0x00, 

/* Symbol 0x5F, offset 3549 */
    13, 29, 26,
    0xFF, 0xF8, 0xFF, 0xF8, 0xFF, 0xF8, 

/* Symbol 0x60, offset 3558 */
    15, 25, 0,
    0x00, 0x06, 0x00, 0x06, 0x00, 0x06, 0x00, 0x06, 0x00, 0x06, 0x00, 0x06,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 0xFE, 

/* Symbol 0x61, offset 3611 */
    16, 25, 7,
    0x1F, 0xF8, 0x7F, 0xF8, 0xFF, 0xF8, 0xF0, 0x38, 0xE0, 0x38, 0xE0, 0x38,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 0xCE, 

/* Symbol 0x62, offset 3650 */
    13, 25, 0,
    0xE0, 0x00, 0xE0, 0x00, 0xE0, 0x00, 0xE0, 0x00, 0xE0, 0x00, 0xE0, 0x00,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 0xC0, 

/* Symbol 0x63, offset 3703 */
    11, 25, 7,
    0x1F, 0xC0, 0x7F, 0xE0, 0xFF, 0xC0, 0xF0, 0x00, 0xE0, 0x00, 0xE0, 0x00,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 0xC0, 

/* Symbol 0x64, offset 3742 */
    13, 25, 0,
    0x00, 0x38, 0x00, 0x38, 0x00, 0x38, 0x00, 0x38, 0x00, 0x38, 0x00, 0x38,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 0xF8, 

/* Symbol 0x65, offset 3795 */
    13, 25, 7,
    0x1F, 0xC0, 0x7F, 0xE0, 0xFF, 0xF0, 0xF0, 0x78, 0xE0, 0x38, 0xE0, 0x38,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 0xF8, 

/* Symbol 0x66, offset 3834 */
    9, 25, 0,
    0x1F, 0x80, 0x3F, 0x80, 0x7C, 0x00, 0x78, 0x00, 0x70, 0x00, 0x70, 0x00,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 0x00, 

/* Symbol 0x67, offset 3887 */
    13, 30, 7,
    0x1F, 0xF8, 0x7F, 0xF8, 0xFF, 0xF8, 0xF0, 0x38, 0xE0, 0x38, 0xE0, 0x38,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 0x78, 

/* Symbol 0x68, offset 3936 */
    13, 25, 0,
    0xE0, 0x00, 0xE0, 0x00, 0xE0, 0x00, 0xE0, 0x00, 0xE0, 0x00, 0xE0, 0x00,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 0x38, 

/* Symbol 0x69, offset 3989 */
    3, 25, 0,
    0xE0, 0xE0, 0x00, 0x00, 0x00, 0x00, 0x00, 0xE0, 0xE0, 0xE0, 0xE0, 0xE0, 0xE0, 0xE0, 0xE0, 0xE0, 0xE0, 0xE0, 0xE0, 0xE0, 0xE0, 0xE0, 0xE0, 0xE0, 0xE0, 

/* Symbol 0x6A, offset 4017 */
    3, 30, 0,
    0xE0, 0xE0, 0x00, 0x00, 0x00, 0x00, 0x00, 0xE0, 0xE0, 0xE0, 0xE0, 0xE0, 0xE0, 0xE0, 0xE0, 0xE0, 0xE0, 0xE0, 0xE0, 0xE0, 0xE0, 0xE0, 0xE0, 0xE0, 0xE0, 0xE0, 0xE0, 0xE0, 0xE0, 0xE0, 

/* Symbol 0x6B, offset 4050 */
    13, 25, 0,
    0xE0, 0x00, 0xE0, 0x00, 0xE0, 0x00, 0xE0, 0x00, 0xE0, 0x00, 0xE0, 0x00,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 0x38, 

/* Symbol 0x6C, offset 4103 */
    6, 25, 0,
    0xE0, 0xE0, 0xE0, 0xE0, 0xE0, 0xE0, 0xE0, 0xE0, 0xE0, 0xE0, 0xE0, 0xE0, 0xE0, 0xE0, 0xE0, 0xE0, 0xE0, 0xE0, 0xE0, 0xE0, 0xE0, 0xE0, 0xF8, 0xFC, 0x78, 

/* Symbol 0x6D, offset 4131 */
    18, 25, 7,
    0xFF, 0xFE, 0x00, 0xFF, 0xFF, 0x00, 0xFF, 0xFF, 0x80, 0xE1, 0xE3, 0xC0,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 0xC0, 

/* Symbol 0x6E, offset 4188 */
    13, 25, 7,
    0xFF, 0xC0, 0xFF, 0xE0, 0xFF, 0xF0, 0xE0, 0x78, 0xE0, 0x38, 0xE0, 0x38,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 0x38, 

/* Symbol 0x6F, offset 4227 */
    13, 25, 7,
    0x0F, 0x80, 0x3F, 0xE0, 0x7F, 0xF0, 0xF0, 0x78, 0xE0, 0x78, 0xE0, 0x38,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 0xC0, 

/* Symbol 0x70, offset 4266 */
    13, 30, 7,
    0xFF, 0xC0, 0xFF, 0xE0, 0xFF, 0xF0, 0xE0, 0x78, 0xE0, 0x38, 0xE0, 0x38,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 0x00, 

/* Symbol 0x71, offset 4315 */
    13, 30, 7,
    0x1F, 0xF8, 0x7F, 0xF8, 0xFF, 0xF8, 0xF0, 0x38, 0xE0, 0x38, 0xE0, 0x38,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 0x38, 

/* Symbol 0x72, offset 4364 */
    11, 25, 7,
    0xFF, 0x00, 0xFF, 0xC0, 0xFF, 0xC0, 0xE1, 0xE0, 0xE1, 0xE0, 0xE0, 0x00,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 0x00, 

/* Symbol 0x73, offset 4403 */
    13, 25, 7,
    0x0F, 0x80, 0x7F, 0xF0, 0xFF, 0xF8, 0xF0, 0x78, 0xE0, 0x00, 0xF0, 0x00,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 0xC0, 

/* Symbol 0x74, offset 4442 */
    11, 25, 0,
    0x3C, 0x00, 0x3C, 0x00, 0x3C, 0x00, 0x3C, 0x00, 0x3C, 0x00, 0x3C, 0x00,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 0x00, 

/* Symbol 0x75, offset 4495 */
    13, 25, 7,
    0xE0, 0x38, 0xE0, 0x38, 0xE0, 0x38, 0xE0, 0x38, 0xE0, 0x38, 0xE0, 0x38,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 0xF8, 

/* Symbol 0x76, offset 4534 */
    13, 25, 7,
    0xE0, 0x38, 0xE0, 0x38, 0xE0, 0x78, 0xF0, 0x78, 0xF0, 0x70, 0x70, 0xF0,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 0x00, 

/* Symbol 0x77, offset 4573 */
    18, 25, 7,
    0xE0, 0x01, 0xC0, 0xE0, 0x01, 0xC0, 0xE0, 0x03, 0xC0, 0xF0, 0x03, 0xC0,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 0x00, 

/* Symbol 0x78, offset 4630 */
    13, 25, 7,
    0xC0, 0x38, 0xE0, 0x78, 0xF0, 0x78, 0x78, 0xF0, 0x79, 0xF0, 0x3D, 0xE0,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 0x38, 

/* Symbol 0x79, offset 4669 */
    13, 30, 7,
    0xC0, 0x30, 0xE0, 0x78, 0xE0, 0x78, 0xE0, 0x70, 0xF0, 0xF0, 0xF0, 0xF0,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 0x00, 

/* Symbol 0x7A, offset 4718 */
    13, 25, 7,
    0xFF, 0xF8, 0xFF, 0xF8, 0xFF, 0xF8, 0x00, 0xF0, 0x01, 0xF0, 0x01, 0xE0,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 0xF8, 

/* Symbol 0x7B, offset 4757 */
    8, 28, 0,
    0x3C, 0x3C, 0x3C, 0x3C, 0x3C, 0x3C, 0x3C, 0x3C, 0x3C, 0x3C, 0x3C, 0xF8, 0xF8, 0xFC, 0x3C, 0x3C, 0x3C, 0x3C, 0x3C, 0x3C, 0x3C, 0x3C, 0x3C, 0x3C, 0x3C, 0x1F, 0x1F, 0x06, 

/* Symbol 0x7C, offset 4788 */
    9, 25, 0,
    0xE3, 0x80, 0xE3, 0x80, 0xE3, 0x80, 0xE3, 0x80, 0xE3, 0x80, 0xE3, 0x80,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 0x80, 

/* Symbol 0x7D, offset 4841 */
    8, 28, 0,
    0x3C, 0x3C, 0x3C, 0x3C, 0x3C, 0x3C, 0x3C, 0x3C, 0x3C, 0x3C, 0x3C, 0x3F, 0x1F, 0x3E, 0x3C, 0x3C, 0x3C, 0x3C, 0x3C, 0x3C, 0x3C, 0x3C, 0x3C, 0x3C, 0x3C, 0xF8, 0xF0, 0xC0, 

/* Symbol 0x7E, offset 4872 */
    16, 19, 14,
    0x7F, 0x00, 0xFF, 0x8F, 0xE3, 0xFF, 0x01, 0xFE, 0x00, 0x78, 

/* Symbol 0x7F, offset 4885 */
    7, 24, 0,
    0x86, 0x86, 0x86, 0x86, 0x86, 0x86, 0x86, 0x86, 0x86, 0x86, 0x86, 0x86, 0x86, 0x86, 0x86, 0x86, 0x86, 0x86, 0x86, 0x86, 0x86, 0x86, 0xFE, 0xFE, 

/* Symbol 0xC0, offset 4912 */
    18, 25, 0,
    0x01, 0xE0, 0x00, 0x01, 0xE0, 0x00, 0x01, 0xE0, 0x00, 0x03, 0xF0, 0x00,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 0xC0, 

/* Symbol 0xC1, offset 4990 */
    16, 25, 0,
    0xFF, 0xF8, 0xFF, 0xF8, 0xE0, 0x00, 0xE0, 0x00, 0xE0, 0x00, 0xE0, 0x00,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 0xF8, 

/* Symbol 0xC2, offset 5043 */
    16, 25, 0,
    0xFF, 0xF0, 0xFF, 0xF8, 0xE0, 0x3C, 0xE0, 0x1C, 0xE0, 0x1C, 0xE0, 0x1C,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 0xF8, 

/* Symbol 0xC3, offset 5096 */
    13, 25, 0,
    0xFF, 0xF8, 0xFF, 0xF8, 0xE0, 0x00, 0xE0, 0x00, 0xE0, 0x00, 0xE0, 0x00,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 0x00, 

/* Symbol 0xC4, offset 5149 */
    18, 28, 0,
    0x07, 0xFF, 0x00, 0x07, 0xFF, 0x00, 0x0F, 0x0F, 0x00, 0x0F, 0x0F, 0x00,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 0x80, 

/* Symbol 0xC5, offset 5236 */
    13, 25, 0,
    0xFF, 0xF8, 0xFF, 0xF8, 0xE0, 0x00, 0xE0, 0x00, 0xE0, 0x00, 0xE0, 0x00,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 0xF8, 

/* Symbol 0xC6, offset 5289 */
    21, 25, 0,
    0xE0, 0xF0, 0x78, 0xF0, 0xF0, 0x78, 0xF0, 0xF0, 0xF0, 0x78, 0xF1, 0xE0,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 0x78, 

/* Symbol 0xC7, offset 5367 */
    13, 25, 0,
    0x3F, 0xE0, 0x7F, 0xF0, 0xF0, 0xF8, 0xE0, 0x78, 0xE0, 0x38, 0x00, 0x38,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 0xC0, 

/* Symbol 0xC8, offset 5420 */
    16, 25, 0,
    0xE0, 0x0F, 0xE0, 0x0F, 0xE0, 0x1F, 0xE0, 0x1F, 0xE0, 0x3F, 0xE0, 0x7F,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 0x0F, 

/* Symbol 0xC9, offset 5473 */
    16, 25, 0,
    0xE0, 0x0F, 0xE0, 0x0F, 0xE0, 0x1F, 0xE0, 0x1F, 0xE0, 0x3F, 0xE0, 0x7F,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 0x0F, 

/* Symbol 0xCA, offset 5526 */
    16, 25, 0,
    0xE0, 0x0F, 0xE0, 0x1F, 0xE0, 0x3E, 0xE0, 0x7C, 0xE0, 0xF8, 0xE1, 0xF0,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 0x07, 

/* Symbol 0xCB, offset 5579 */
    16, 25, 0,
    0x03, 0xFF, 0x03, 0xFF, 0x07, 0x8F, 0x07, 0x8F, 0x07, 0x0F, 0x07, 0x0F,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 0x0F, 

/* Symbol 0xCC, offset 5632 */
    18, 25, 0,
    0xE0, 0x01, 0xC0, 0xF0, 0x03, 0xC0, 0xF0, 0x03, 0xC0, 0xF8, 0x07, 0xC0,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 0xC0, 

/* Symbol 0xCD, offset 5710 */
    16, 25, 0,
    0xE0, 0x0F, 0xE0, 0x0F, 0xE0, 0x0F, 0xE0, 0x0F, 0xE0, 0x0F, 0xE0, 0x0F,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 0x0E, 

/* Symbol 0xCE, offset 5763 */
    16, 25, 0,
    0x3F, 0xF8, 0x7F, 0xFE, 0xF0, 0x1E, 0xE0, 0x0F, 0xE0, 0x0F, 0xE0, 0x0F,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 0xF8, 

/* Symbol 0xCF, offset 5816 */
    16, 25, 0,
    0xFF, 0xFF, 0xFF, 0xFF, 0xE0, 0x0F, 0xE0, 0x0F, 0xE0, 0x0F, 0xE0, 0x0F,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 0x0F, 

/* Symbol 0xD0, offset 5869 */
    16, 25, 0,
    0xFF, 0xF8, 0xFF, 0xFE, 0xE0, 0x1E, 0xE0, 0x0F, 0xE0, 0x0F, 0xE0, 0x0F,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 0x00, 

/* Symbol 0xD1, offset 5922 */
    13, 25, 0,
    0x3F, 0xF8, 0x7F, 0xF8, 0xF0, 0x00, 0xE0, 0x00, 0xE0, 0x00, 0xE0, 0x00,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 0xF8, 

/* Symbol 0xD2, offset 5975 */
    16, 25, 0,
    0xFF, 0xFF, 0xFF, 0xFF, 0x03, 0x80, 0x03, 0x80, 0x03, 0x80, 0x03, 0x80,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 0x80, 

/* Symbol 0xD3, offset 6028 */
    16, 25, 0,
    0xE0, 0x0F, 0xE0, 0x0F, 0xE0, 0x0F, 0xE0, 0x0F, 0xE0, 0x0F, 0xE0, 0x0F,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 0xF8, 

/* Symbol 0xD4, offset 6081 */
    21, 25, 0,
    0x00, 0xF0, 0x00, 0x00, 0xF0, 0x00, 0x00, 0xF0, 0x00, 0x00, 0xF0, 0x00,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 0x00, 

/* Symbol 0xD5, offset 6159 */
    18, 25, 0,
    0xE0, 0x01, 0xC0, 0xF0, 0x03, 0xC0, 0xF0, 0x07, 0x80, 0x78, 0x07, 0x80,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 0xC0, 

/* Symbol 0xD6, offset 6237 */
    18, 29, 0,
    0xE0, 0x0F, 0x00, 0xE0, 0x0F, 0x00, 0xE0, 0x0F, 0x00, 0xE0, 0x0F, 0x00,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 0xC0, 

/* Symbol 0xD7, offset 6327 */
    16, 25, 0,
    0xE0, 0x0F, 0xE0, 0x0F, 0xE0, 0x0F, 0xE0, 0x0F, 0xE0, 0x0F, 0xE0, 0x0F,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 0x0F, 

/* Symbol 0xD8, offset 6380 */
    21, 25, 0,
    0xE0, 0xF0, 0x78, 0xE0, 0xF0, 0x78, 0xE0, 0xF0, 0x78, 0xE0, 0xF0, 0x78,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 0xF8, 

/* Symbol 0xD9, offset 6458 */
    23, 29, 0,
    0xE0, 0xF0, 0x78, 0xE0, 0xF0, 0x78, 0xE0, 0xF0, 0x78, 0xE0, 0xF0, 0x78,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 0x0E, 

/* Symbol 0xDA, offset 6548 */
    21, 25, 0,
    0xFF, 0x00, 0x00, 0xFF, 0x00, 0x00, 0x07, 0x00, 0x00, 0x07, 0x00, 0x00,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 0xC0, 

/* Symbol 0xDB, offset 6626 */
    18, 25, 0,
    0xE0, 0x01, 0xC0, 0xE0, 0x01, 0xC0, 0xE0, 0x01, 0xC0, 0xE0, 0x01, 0xC0,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 0xC0, 

/* Symbol 0xDC, offset 6704 */
    16, 25, 0,
    0xE0, 0x00, 0xE0, 0x00, 0xE0, 0x00, 0xE0, 0x00, 0xE0, 0x00, 0xE0, 0x00,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 0xF8, 

/* Symbol 0xDD, offset 6757 */
    16, 25, 0,
    0xFF, 0xF8, 0xFF, 0xFE, 0x00, 0x1E, 0x00, 0x0F, 0x00, 0x0F, 0x00, 0x0F,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 0xF8, 

/* Symbol 0xDE, offset 6810 */
    18, 25, 0,
    0xE1, 0xFF, 0x00, 0xE3, 0xFF, 0x80, 0xE7, 0xC7, 0xC0, 0xE7, 0x03, 0xC0,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 0x00, 

/* Symbol 0xDF, offset 6888 */
    16, 25, 0,
    0x3F, 0xFF, 0x7F, 0xFF, 0xF0, 0x0F, 0xE0, 0x0F, 0xE0, 0x0F, 0xE0, 0x0F,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 0x0F, 

/* Symbol 0xE0, offset 6941 */
    16, 25, 7,
    0x1F, 0xF8, 0x7F, 0xF8, 0xFF, 0xF8, 0xF0, 0x38, 0xE0, 0x38, 0xE0, 0x38,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 0xCE, 

/* Symbol 0xE1, offset 6980 */
    13, 25, 0,
    0xFF, 0xF8, 0xFF, 0xF8, 0x78, 0x00, 0x3C, 0x00, 0x1E, 0x00, 0x0F, 0x00,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 0xC0, 

/* Symbol 0xE2, offset 7033 */
    13, 25, 0,
    0x7F, 0x00, 0xFF, 0x80, 0xF7, 0x80, 0xE3, 0xC0, 0xE3, 0xC0, 0xE3, 0x80,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 0xC0, 

/* Symbol 0xE3, offset 7086 */
    13, 25, 7,
    0x0F, 0x00, 0x7F, 0xE0, 0xFF, 0xF0, 0xE0, 0x78, 0x00, 0x78, 0x00, 0x78,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 0xE0, 

/* Symbol 0xE4, offset 7125 */
    13, 25, 0,
    0x7F, 0xE0, 0x7F, 0xF0, 0x00, 0xF8, 0x00, 0x78, 0x00, 0x38, 0x00, 0x38,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 0xC0, 

/* Symbol 0xE5, offset 7178 */
    13, 25, 7,
    0x1F, 0xC0, 0x7F, 0xE0, 0xFF, 0xF0, 0xF0, 0x78, 0xE0, 0x38, 0xE0, 0x38,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 0xF8, 

/* Symbol 0xE6, offset 7217 */
    18, 25, 7,
    0xC1, 0xC1, 0x80, 0xE1, 0xC3, 0xC0, 0xF1, 0xC3, 0xC0, 0xF1, 0xC7, 0x80,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 0xC0, 

/* Symbol 0xE7, offset 7274 */
    12, 25, 7,
    0x1F, 0x00, 0xFF, 0xC0, 0xFF, 0xE0, 0xE0, 0xF0, 0x00, 0xF0, 0x00, 0xF0,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 0x80, 

/* Symbol 0xE8, offset 7313 */
    13, 25, 7,
    0xE0, 0x38, 0xE0, 0x38, 0xE0, 0x38, 0xE0, 0x38, 0xE0, 0x38, 0xE0, 0x38,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 0xF8, 

/* Symbol 0xE9, offset 7352 */
    13, 25, 0,
    0x3F, 0xE0, 0x3F, 0xE0, 0x00, 0x00, 0x00, 0x00, 0x00, 0x00, 0x00, 0x00,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 0xF8, 

/* Symbol 0xEA, offset 7405 */
    13, 25, 7,
    0xC0, 0x30, 0xE0, 0x78, 0xE0, 0xF8, 0xE1, 0xF0, 0xE3, 0xE0, 0xE7, 0xC0,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 0x38, 

/* Symbol 0xEB, offset 7444 */
    13, 25, 7,
    0x07, 0xF8, 0x07, 0xF8, 0x0F, 0xF8, 0x0F, 0x38, 0x0E, 0x38, 0x1E, 0x38,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 0x38, 

/* Symbol 0xEC, offset 7483 */
    16, 25, 7,
    0xE0, 0x06, 0xE0, 0x0F, 0xF0, 0x1F, 0xF8, 0x3F, 0xF8, 0x3F, 0xFC, 0x7F,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 0x0E, 

/* Symbol 0xED, offset 7522 */
    13, 25, 7,
    0xE0, 0x38, 0xE0, 0x38, 0xE0, 0x38, 0xE0, 0x38, 0xE0, 0x38, 0xE0, 0x38,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 0x38, 

/* Symbol 0xEE, offset 7561 */
    13, 25, 7,
    0x0F, 0x80, 0x3F, 0xE0, 0x7F, 0xF0, 0xF0, 0x78, 0xE0, 0x78, 0xE0, 0x38,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 0xC0, 

/* Symbol 0xEF, offset 7600 */
    13, 25, 7,
    0xFF, 0x80, 0xFF, 0xE0, 0xFF, 0xF0, 0xE0, 0x78, 0xE0, 0x38, 0xE0, 0x38,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 0x38, 

/* Symbol 0xF0, offset 7639 */
    13, 30, 7,
    0xFF, 0xC0, 0xFF, 0xE0, 0xFF, 0xF0, 0xE0, 0x78, 0xE0, 0x38, 0xE0, 0x38,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 0x00, 

/* Symbol 0xF1, offset 7688 */
    11, 25, 7,
    0x1F, 0xC0, 0x7F, 0xE0, 0xFF, 0xC0, 0xF0, 0x00, 0xE0, 0x00, 0xE0, 0x00,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 0xC0, 

/* Symbol 0xF2, offset 7727 */
    18, 25, 7,
    0xFF, 0xFE, 0x00, 0xFF, 0xFF, 0x00, 0xFF, 0xFF, 0x80, 0xE1, 0xE3, 0xC0,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 0xC0, 

/* Symbol 0xF3, offset 7784 */
    13, 30, 7,
    0xE0, 0x38, 0xE0, 0x38, 0xE0, 0x38, 0xE0, 0x38, 0xE0, 0x38, 0xE0, 0x38,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 0x78, 

/* Symbol 0xF4, offset 7833 */
    18, 30, 2,
    0x00, 0xC0, 0x00, 0x01, 0xE0, 0x00, 0x01, 0xE0, 0x00, 0x01, 0xE0, 0x00,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 0x00, 

/* Symbol 0xF5, offset 7920 */
    13, 25, 7,
    0xC0, 0x38, 0xE0, 0x78, 0xF0, 0x78, 0x78, 0xF0, 0x79, 0xF0, 0x3D, 0xE0,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 0x38, 

/* Symbol 0xF6, offset 7959 */
    16, 27, 7,
    0xE0, 0x38, 0xE0, 0x38, 0xE0, 0x38, 0xE0, 0x38, 0xE0, 0x38, 0xE0, 0x38,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 0x0F, 

/* Symbol 0xF7, offset 8002 */
    13, 25, 7,
    0xE0, 0x38, 0xE0, 0x38, 0xE0, 0x38, 0xE0, 0x38, 0xE0, 0x38, 0xE0, 0x38,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 0x38, 

/* Symbol 0xF8, offset 8041 */
    18, 25, 7,
    0xE0, 0xC1, 0xC0, 0xE1, 0xE1, 0xC0, 0xE1, 0xE1, 0xC0, 0xE1, 0xE1, 0xC0,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 0xC0, 

/* Symbol 0xF9, offset 8098 */
    21, 28, 7,
    0xE0, 0xC1, 0xC0, 0xE1, 0xE1, 0xC0, 0xE1, 0xE1, 0xC0, 0xE1, 0xE1, 0xC0,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 0x30, 

/* Symbol 0xFA, offset 8164 */
    14, 25, 7,
    0xF0, 0x00, 0xF0, 0x00, 0xF0, 0x00, 0x70, 0x00, 0x70, 0x00, 0x70, 0x00,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 0xF0, 

/* Symbol 0xFB, offset 8203 */
    16, 25, 7,
    0xE0, 0x06, 0xE0, 0x0F, 0xE0, 0x0F, 0xE0, 0x0F, 0xE0, 0x0F, 0xE0, 0x0F,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 0x0F, 

/* Symbol 0xFC, offset 8242 */
    13, 25, 7,
    0xE0, 0x00, 0xE0, 0x00, 0xE0, 0x00, 0xE0, 0x00, 0xE0, 0x00, 0xE0, 0x00,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 0xC0, 

/* Symbol 0xFD, offset 8281 */
    13, 25, 7,
    0xFF, 0xC0, 0xFF, 0xE0, 0xFF, 0xF0, 0x00, 0x78, 0x00, 0x38, 0x00, 0x38,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 0xC0, 

/* Symbol 0xFE, offset 8320 */
    16, 25, 7,
    0xE0, 0xF8, 0xE3, 0xFC, 0xE7, 0xFE, 0xE7, 0x0F, 0xE7, 0x0F, 0xE7, 0x0F,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 0xF8, 

/* Symbol 0xFF, offset 8359 */
    13, 25, 7,
    0x1F, 0xF8, 0x7F, 0xF8, 0xFF, 0xF8, 0xF0, 0x38, 0xE0, 0x38, 0xE0, 0x38,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 0x38
};
