#include "Font.h"
const Font font8 = {
	8, {
/*0*/		{ 0, { 0,	0,	0,	0,	0,	0,	0,	0	} },	
/*1*/		{ 0, { 0,	0,	0,	0,	0,	0,	0,	0	} },	
/*2*/		{ 0, { 0,	0,	0,	0,	0,	0,	0,	0	} },	
/*3*/		{ 0, { 0,	0,	0,	0,	0,	0,	0,	0	} },	
/*4*/		{ 0, { 0,	0,	0,	0,	0,	0,	0,	0	} },	
/*5*/		{ 0, { 0,	0,	0,	0,	0,	0,	0,	0	} },	
/*6*/		{ 0, { 0,	0,	0,	0,	0,	0,	0,	0	} },	
/*7*/		{ 0, { 0,	0,	0,	0,	0,	0,	0,	0	} },	
/*8*/		{ 0, { 0,	0,	0,	0,	0,	0,	0,	0	} },	
/*9*/		{ 0, { 0,	0,	0,	0,	0,	0,	0,	0	} },	
/*10*/		{ 0, { 0,	0,	0,	0,	0,	0,	0,	0	} },	
/*11*/		{ 0, { 0,	0,	0,	0,	0,	0,	0,	0	} },	
/*12*/		{ 0, { 0,	0,	0,	0,	0,	0,	0,	0	} },	
/*13*/		{ 0, { 0,	0,	0,	0,	0,	0,	0,	0	} },	
/*14*/		{ 0, { 0,	0,	0,	0,	0,	0,	0,	0	} },	
/*15*/		{ 0, { 0,	0,	0,	0,	0,	0,	0,	0	} },	
/*16*/		{ 0, { 0,	0,	0,	0,	0,	0,	0,	0	} },	
/*17*/		{ 1, { 0,	0,	0,	0,	0,	0,	0,	0	} },	
/*18*/		{ 2, { 0,	0,	0,	0,	0,	0,	0,	0	} },	
/*19*/		{ 3, { 0,	0,	0,	0,	0,	0,	0,	0	} },	
/*20*/		{ 4, { 0,	0,	0,	0,	0,	0,	0,	0	} },	
/*21*/		{ 5, { 0,	0,	0,	0,	0,	0,	0,	0	} },	
/*22*/		{ 6, { 0,	0,	0,	0,	0,	0,	0,	0	} },	
/*23*/		{ 7, { 0,	0,	0,	0,	0,	0,	0,	0	} },	
/*24*/		{ 8, { 0,	0,	0,	0,	0,	0,	0,	0	} },	
/*25*/		{ 9, { 0,	0,	0,	0,	0,	0,	0,	0	} },	
/*26*/		{ 10, { 0,	0,	0,	0,	0,	0,	0,	0	} },	
/*27*/		{ 11, { 0,	0,	0,	0,	0,	0,	0,	0	} },	
/*28*/		{ 12, { 0,	0,	0,	0,	0,	0,	0,	0	} },	
/*29*/		{ 13, { 0,	0,	0,	0,	0,	0,	0,	0	} },	
/*30*/		{ 14, { 0,	0,	0,	0,	0,	0,	0,	0	} },	
/*31*/		{ 15, { 0,	0,	0,	0,	0,	0,	0,	0	} },	
/*32*/		{ 5, { 0,	0,	0,	0,	0,	0,	0,	0	} },	
/*33*/		{ 3, { 32,	32,	32,	32,	32,	32,	0,	32	} },	
/*34*/		{ 3, { 160,	160,	0,	0,	0,	0,	0,	0	} },	
/*35*/		{ 6, { 0,	72,	252,	72,	72,	252,	72,	0	} },	
/*36*/		{ 5, { 0,	32,	248,	160,	248,	40,	248,	32	} },	
/*37*/		{ 6, { 0,	196,	200,	16,	32,	76,	140,	0	} },	
/*38*/		{ 5, { 0,	32,	80,	32,	88,	144,	104,	0	} },	
/*39*/		{ 3, { 0,	32,	64,	0,	0,	0,	0,	0	} },	
/*40*/		{ 2, { 64,	64,	128,	128,	128,	64,	64,	0	} },	
/*41*/		{ 2, { 128,	128,	64,	64,	64,	128,	128,	0	} },	
/*42*/		{ 3, { 0,	0,	160,	64,	160,	0,	0,	0	} },	
/*43*/		{ 3, { 0,	0,	64,	224,	64,	0,	0,	0	} },	
/*44*/		{ 4, { 0,	0,	0,	0,	0,	0,	16,	32	} },	
/*45*/		{ 3, { 0,	0,	0,	224,	0,	0,	0,	0	} },	
/*46*/		{ 1, { 0,	0,	0,	0,	0,	0,	0,	128	} },	
/*47*/		{ 3, { 0,	32,	32,	64,	64,	128,	128,	0	} },	
/*48*/		{ 5, { 248,	136,	136,	136,	136,	136,	136,	248	} },	
/*49*/		{ 5, { 32,	96,	32,	32,	32,	32,	32,	248	} },	
/*50*/		{ 5, { 248,	8,	8,	248,	128,	128,	128,	248	} },	
/*51*/		{ 5, { 248,	8,	8,	248,	8,	8,	8,	248	} },	
/*52*/		{ 5, { 136,	136,	136,	248,	8,	8,	8,	8	} },	
/*53*/		{ 5, { 248,	128,	128,	248,	8,	8,	8,	248	} },	
/*54*/		{ 5, { 248,	128,	128,	248,	136,	136,	136,	248	} },	
/*55*/		{ 5, { 248,	8,	16,	32,	64,	128,	128,	128	} },	
/*56*/		{ 5, { 248,	136,	136,	248,	136,	136,	136,	248	} },	
/*57*/		{ 5, { 248,	136,	136,	248,	8,	8,	8,	248	} },	
/*58*/		{ 1, { 0,	128,	128,	0,	0,	128,	128,	0	} },	
/*59*/		{ 3, { 0,	32,	32,	0,	0,	32,	32,	64	} },	
/*60*/		{ 6, { 0,	36,	72,	144,	72,	36,	0,	0	} },	
/*61*/		{ 4, { 0,	0,	240,	0,	240,	0,	0,	0	} },	
/*62*/		{ 6, { 0,	144,	72,	36,	72,	144,	0,	0	} },	
/*63*/		{ 5, { 112,	136,	8,	16,	32,	32,	0,	32	} },	
/*64*/		{ 4, { 0,	144,	0,	240,	144,	240,	128,	240	} },	
/*65*/		{ 5, { 248,	136,	136,	248,	136,	136,	136,	136	} },	
/*66*/		{ 5, { 240,	136,	136,	240,	136,	136,	136,	240	} },	
/*67*/		{ 5, { 248,	128,	128,	128,	128,	128,	128,	248	} },	
/*68*/		{ 5, { 248,	136,	136,	136,	136,	136,	136,	240	} },	
/*69*/		{ 5, { 248,	128,	128,	240,	128,	128,	128,	248	} },	
/*70*/		{ 5, { 248,	128,	128,	240,	128,	128,	128,	128	} },	
/*71*/		{ 6, { 120,	132,	128,	128,	140,	132,	132,	120	} },	
/*72*/		{ 5, { 136,	136,	136,	248,	136,	136,	136,	136	} },	
/*73*/		{ 5, { 248,	32,	32,	32,	32,	32,	32,	248	} },	
/*74*/		{ 4, { 16,	16,	16,	16,	16,	144,	144,	96	} },	
/*75*/		{ 5, { 136,	144,	160,	192,	192,	160,	144,	136	} },	
/*76*/		{ 4, { 128,	128,	128,	128,	128,	128,	144,	240	} },	
/*77*/		{ 5, { 136,	216,	168,	136,	136,	136,	136,	136	} },	
/*78*/		{ 5, { 136,	136,	200,	168,	168,	152,	136,	136	} },	
/*79*/		{ 5, { 112,	136,	136,	136,	136,	136,	136,	112	} },	
/*80*/		{ 5, { 240,	136,	136,	136,	240,	128,	128,	128	} },	
/*81*/		{ 6, { 112,	136,	136,	136,	136,	152,	136,	116	} },	
/*82*/		{ 5, { 240,	136,	136,	136,	240,	144,	136,	136	} },	
/*83*/		{ 4, { 240,	128,	128,	240,	16,	16,	16,	240	} },	
/*84*/		{ 5, { 248,	32,	32,	32,	32,	32,	32,	32	} },	
/*85*/		{ 5, { 136,	136,	136,	136,	136,	136,	136,	112	} },	
/*86*/		{ 5, { 136,	136,	136,	136,	136,	136,	80,	32	} },	
/*87*/		{ 5, { 136,	136,	136,	136,	136,	136,	168,	80	} },	
/*88*/		{ 5, { 136,	80,	80,	32,	32,	80,	80,	136	} },	
/*89*/		{ 5, { 136,	136,	136,	80,	32,	32,	32,	32	} },	
/*90*/		{ 5, { 248,	8,	16,	32,	64,	128,	128,	248	} },	
/*91*/		{ 4, { 0,	112,	64,	64,	64,	64,	112,	0	} },	
/*92*/		{ 5, { 0,	0,	128,	64,	32,	16,	8,	0	} },	
/*93*/		{ 4, { 0,	112,	16,	16,	16,	16,	112,	0	} },	
/*94*/		{ 5, { 0,	32,	112,	168,	32,	32,	32,	0	} },	
/*95*/		{ 6, { 0,	0,	0,	0,	0,	0,	0,	252	} },	
/*96*/		{ 3, { 96,	64,	224,	64,	64,	64,	64,	64	} },	
/*97*/		{ 4, { 0,	0,	240,	16,	240,	144,	144,	240	} },	
/*98*/		{ 4, { 128,	128,	240,	144,	144,	144,	144,	240	} },	
/*99*/		{ 4, { 0,	0,	240,	128,	128,	128,	128,	240	} },	
/*100*/		{ 4, { 16,	16,	240,	144,	144,	144,	144,	240	} },	
/*101*/		{ 4, { 0,	0,	240,	144,	240,	128,	128,	240	} },	
/*102*/		{ 3, { 96,	64,	224,	64,	64,	64,	64,	64	} },	
/*103*/		{ 4, { 0,	0,	240,	144,	144,	240,	16,	240	} },	
/*104*/		{ 4, { 128,	128,	240,	144,	144,	144,	144,	144	} },	
/*105*/		{ 1, { 128,	0,	128,	128,	128,	128,	128,	128	} },	
/*106*/		{ 4, { 0,	16,	0,	16,	16,	16,	144,	96	} },	
/*107*/		{ 4, { 128,	128,	144,	160,	192,	160,	144,	144	} },	
/*108*/		{ 2, { 128,	128,	128,	128,	128,	128,	128,	192	} },	
/*109*/		{ 5, { 0,	0,	208,	168,	168,	168,	168,	168	} },	
/*110*/		{ 4, { 0,	0,	224,	144,	144,	144,	144,	144	} },	
/*111*/		{ 4, { 0,	0,	240,	144,	144,	144,	144,	240	} },	
/*112*/		{ 4, { 0,	0,	240,	144,	144,	240,	128,	128	} },	
/*113*/		{ 5, { 0,	0,	240,	144,	144,	240,	16,	24	} },	
/*114*/		{ 3, { 0,	0,	224,	128,	128,	128,	128,	128	} },	
/*115*/		{ 4, { 0,	0,	240,	128,	240,	16,	16,	240	} },	
/*116*/		{ 3, { 64,	64,	224,	64,	64,	64,	64,	96	} },	
/*117*/		{ 4, { 0,	0,	144,	144,	144,	144,	144,	240	} },	
/*118*/		{ 5, { 0,	0,	136,	136,	136,	80,	80,	32	} },	
/*119*/		{ 5, { 0,	0,	136,	168,	168,	168,	168,	80	} },	
/*120*/		{ 5, { 0,	0,	136,	80,	32,	32,	80,	136	} },	
/*121*/		{ 4, { 0,	0,	144,	144,	144,	240,	16,	240	} },	
/*122*/		{ 5, { 0,	0,	248,	16,	32,	64,	128,	248	} },	
/*123*/		{ 4, { 240,	144,	144,	240,	0,	0,	0,	0	} },	
/*124*/		{ 0, { 0,	0,	0,	0,	0,	0,	0,	0	} },	
/*125*/		{ 0, { 0,	0,	0,	0,	0,	0,	0,	0	} },	
/*126*/		{ 0, { 0,	0,	0,	0,	0,	0,	0,	0	} },	
/*127*/		{ 0, { 0,	0,	0,	0,	0,	0,	0,	0	} },	
/*128*/		{ 3, { 0,	32,	96,	224,	96,	32,	0,	0	} },	
/*129*/		{ 3, { 0,	128,	192,	224,	192,	128,	0,	0	} },	
/*130*/		{ 0, { 0,	0,	0,	0,	0,	0,	0,	0	} },	
/*131*/		{ 8, { 225,	162,	228,	8,	16,	39,	69,	135	} },	
/*132*/		{ 0, { 0,	0,	0,	0,	0,	0,	0,	0	} },	
/*133*/		{ 0, { 0,	0,	0,	0,	0,	0,	0,	0	} },	
/*134*/		{ 0, { 0,	0,	0,	0,	0,	0,	0,	0	} },	
/*135*/		{ 0, { 0,	0,	0,	0,	0,	0,	0,	0	} },	
/*136*/		{ 7, { 130,	68,	40,	16,	40,	68,	130,	0	} },	
/*137*/		{ 0, { 0,	0,	0,	0,	0,	0,	0,	0	} },	
/*138*/		{ 0, { 0,	0,	0,	0,	0,	0,	0,	0	} },	
/*139*/		{ 0, { 0,	0,	0,	0,	0,	0,	0,	0	} },	
/*140*/		{ 0, { 0,	0,	0,	0,	0,	0,	0,	0	} },	
/*141*/		{ 0, { 0,	0,	0,	0,	0,	0,	0,	0	} },	
/*142*/		{ 0, { 0,	0,	0,	0,	0,	0,	0,	0	} },	
/*143*/		{ 0, { 0,	0,	0,	0,	0,	0,	0,	0	} },	
/*144*/		{ 4, { 16,	48,	112,	240,	240,	112,	48,	16	} },	
/*145*/		{ 4, { 128,	192,	224,	240,	240,	224,	192,	128	} },	
/*146*/		{ 0, { 0,	0,	0,	0,	0,	0,	0,	0	} },	
/*147*/		{ 0, { 0,	0,	0,	0,	0,	0,	0,	0	} },	
/*148*/		{ 0, { 0,	0,	0,	0,	0,	0,	0,	0	} },	
/*149*/		{ 0, { 0,	0,	0,	0,	0,	0,	0,	0	} },	
/*150*/		{ 0, { 0,	0,	0,	0,	0,	0,	0,	0	} },	
/*151*/		{ 0, { 0,	0,	0,	0,	0,	0,	0,	0	} },	
/*152*/		{ 0, { 0,	0,	0,	0,	0,	0,	0,	0	} },	
/*153*/		{ 6, { 0,	16,	8,	252,	8,	16,	0,	0	} },	
/*154*/		{ 5, { 0,	32,	32,	248,	32,	32,	0,	0	} },	
/*155*/		{ 5, { 0,	0,	0,	248,	0,	0,	0,	0	} },	
/*156*/		{ 7, { 0,	16,	16,	16,	254,	16,	16,	16	} },	
/*157*/		{ 7, { 0,	0,	0,	0,	254,	0,	0,	0	} },	
/*158*/		{ 0, { 0,	0,	0,	0,	0,	0,	0,	0	} },	
/*159*/		{ 0, { 0,	0,	0,	0,	0,	0,	0,	0	} },	
/*160*/		{ 8, { 0,	0,	0,	8,	24,	40,	72,	143	} },	
/*161*/		{ 8, { 0,	0,	0,	0,	0,	0,	0,	255	} },	
/*162*/		{ 8, { 0,	0,	0,	0,	0,	0,	0,	255	} },	
/*163*/		{ 8, { 0,	0,	0,	16,	24,	20,	18,	241	} },	
/*164*/		{ 0, { 0,	0,	0,	0,	0,	0,	0,	0	} },	
/*165*/		{ 1, { 0,	128,	0,	0,	0,	128,	0,	0	} },	
/*166*/		{ 8, { 0,	0,	0,	0,	8,	4,	2,	1	} },	
/*167*/		{ 4, { 0,	0,	0,	0,	16,	32,	64,	128	} },	
/*168*/		{ 5, { 80,	248,	128,	128,	240,	128,	128,	248	} },	
/*169*/		{ 0, { 0,	0,	0,	0,	0,	0,	0,	0	} },	
/*170*/		{ 8, { 1,	3,	7,	15,	31,	63,	127,	255	} },	
/*171*/		{ 7, { 0,	128,	192,	224,	240,	248,	252,	254	} },	
/*172*/		{ 8, { 255,	127,	63,	31,	15,	7,	3,	1	} },	
/*173*/		{ 7, { 254,	252,	248,	240,	224,	192,	128,	0	} },	
/*174*/		{ 8, { 0,	63,	80,	80,	80,	80,	80,	80	} },	
/*175*/		{ 7, { 0,	252,	10,	10,	10,	10,	10,	10	} },	
/*176*/		{ 5, { 72,	40,	24,	8,	0,	0,	0,	0	} },	
/*177*/		{ 0, { 0,	0,	0,	0,	0,	0,	0,	0	} },	
/*178*/		{ 0, { 0,	0,	0,	0,	0,	0,	0,	0	} },	
/*179*/		{ 7, { 18,	20,	24,	16,	0,	0,	0,	0	} },	
/*180*/		{ 0, { 0,	0,	0,	0,	0,	0,	0,	0	} },	
/*181*/		{ 0, { 0,	0,	0,	0,	0,	0,	0,	0	} },	
/*182*/		{ 8, { 1,	2,	4,	8,	0,	0,	0,	0	} },	
/*183*/		{ 4, { 128,	64,	32,	16,	0,	0,	0,	0	} },	
/*184*/		{ 4, { 0,	144,	0,	240,	144,	240,	128,	240	} },	
/*185*/		{ 0, { 0,	0,	0,	0,	0,	0,	0,	0	} },	
/*186*/		{ 0, { 0,	0,	0,	0,	0,	0,	0,	0	} },	
/*187*/		{ 0, { 0,	0,	0,	0,	0,	0,	0,	0	} },	
/*188*/		{ 0, { 0,	0,	0,	0,	0,	0,	0,	0	} },	
/*189*/		{ 0, { 0,	0,	0,	0,	0,	0,	0,	0	} },	
/*190*/		{ 8, { 80,	95,	64,	64,	65,	65,	63,	0	} },	
/*191*/		{ 7, { 10,	250,	2,	2,	242,	18,	252,	0	} },	
/*192*/		{ 5, { 248,	136,	136,	248,	136,	136,	136,	136	} },	
/*193*/		{ 5, { 248,	128,	128,	248,	136,	136,	136,	248	} },	
/*194*/		{ 5, { 248,	136,	136,	240,	136,	136,	136,	248	} },	
/*195*/		{ 4, { 240,	128,	128,	128,	128,	128,	128,	128	} },	
/*196*/		{ 6, { 120,	72,	72,	72,	72,	72,	72,	252	} },	
/*197*/		{ 5, { 248,	128,	128,	240,	128,	128,	128,	248	} },	
/*198*/		{ 5, { 168,	168,	168,	112,	168,	168,	168,	168	} },	
/*199*/		{ 5, { 248,	136,	8,	48,	8,	136,	136,	248	} },	
/*200*/		{ 5, { 136,	136,	152,	168,	200,	136,	136,	136	} },	
/*201*/		{ 5, { 168,	136,	152,	168,	200,	136,	136,	136	} },	
/*202*/		{ 5, { 136,	144,	160,	192,	160,	144,	136,	136	} },	
/*203*/		{ 5, { 56,	72,	136,	136,	136,	136,	136,	136	} },	
/*204*/		{ 5, { 136,	216,	168,	136,	136,	136,	136,	136	} },	
/*205*/		{ 5, { 136,	136,	136,	248,	136,	136,	136,	136	} },	
/*206*/		{ 5, { 248,	136,	136,	136,	136,	136,	136,	248	} },	
/*207*/		{ 5, { 248,	136,	136,	136,	136,	136,	136,	136	} },	
/*208*/		{ 5, { 248,	136,	136,	136,	248,	128,	128,	128	} },	
/*209*/		{ 5, { 248,	136,	128,	128,	128,	128,	136,	248	} },	
/*210*/		{ 5, { 248,	32,	32,	32,	32,	32,	32,	32	} },	
/*211*/		{ 5, { 136,	136,	136,	248,	8,	8,	8,	248	} },	
/*212*/		{ 7, { 254,	146,	146,	146,	254,	16,	16,	16	} },	
/*213*/		{ 5, { 136,	80,	80,	32,	32,	80,	80,	136	} },	
/*214*/		{ 6, { 136,	136,	136,	136,	136,	136,	136,	252	} },	
/*215*/		{ 5, { 136,	136,	136,	136,	248,	8,	8,	8	} },	
/*216*/		{ 5, { 168,	168,	168,	168,	168,	168,	168,	248	} },	
/*217*/		{ 7, { 168,	168,	168,	168,	168,	168,	168,	254	} },	
/*218*/		{ 5, { 192,	64,	64,	120,	72,	72,	72,	120	} },	
/*219*/		{ 6, { 132,	132,	132,	244,	148,	148,	148,	244	} },	
/*220*/		{ 4, { 128,	128,	128,	240,	144,	144,	144,	240	} },	
/*221*/		{ 5, { 248,	8,	8,	248,	8,	8,	8,	248	} },	
/*222*/		{ 6, { 188,	164,	164,	228,	164,	164,	164,	188	} },	
/*223*/		{ 5, { 248,	136,	136,	136,	120,	40,	72,	136	} },	
/*224*/		{ 4, { 0,	0,	240,	16,	240,	144,	144,	240	} },	
/*225*/		{ 4, { 0,	0,	240,	128,	240,	144,	144,	240	} },	
/*226*/		{ 4, { 0,	0,	240,	144,	224,	144,	144,	240	} },	
/*227*/		{ 3, { 0,	0,	224,	128,	128,	128,	128,	128	} },	
/*228*/		{ 6, { 0,	0,	120,	72,	72,	72,	72,	252	} },	
/*229*/		{ 4, { 0,	0,	240,	144,	240,	128,	128,	240	} },	
/*230*/		{ 5, { 0,	0,	168,	168,	112,	168,	168,	168	} },	
/*231*/		{ 4, { 0,	0,	240,	144,	32,	144,	144,	240	} },	
/*232*/		{ 4, { 0,	0,	144,	144,	176,	208,	144,	144	} },	
/*233*/		{ 4, { 0,	32,	144,	144,	176,	208,	144,	144	} },	
/*234*/		{ 4, { 0,	0,	144,	160,	192,	192,	160,	144	} },	
/*235*/		{ 4, { 0,	0,	112,	144,	144,	144,	144,	144	} },	
/*236*/		{ 5, { 0,	0,	136,	216,	168,	136,	136,	136	} },	
/*237*/		{ 4, { 0,	0,	144,	144,	240,	144,	144,	144	} },	
/*238*/		{ 4, { 0,	0,	240,	144,	144,	144,	144,	240	} },	
/*239*/		{ 4, { 0,	0,	240,	144,	144,	144,	144,	144	} },	
/*240*/		{ 4, { 0,	0,	240,	144,	144,	240,	128,	128	} },	
/*241*/		{ 4, { 0,	0,	240,	144,	128,	128,	144,	240	} },	
/*242*/		{ 3, { 0,	0,	224,	64,	64,	64,	64,	64	} },	
/*243*/		{ 4, { 0,	0,	144,	144,	240,	16,	16,	240	} },	
/*244*/		{ 5, { 0,	0,	248,	168,	168,	248,	32,	32	} },	
/*245*/		{ 5, { 0,	0,	136,	80,	32,	32,	80,	136	} },	
/*246*/		{ 5, { 0,	0,	144,	144,	144,	144,	144,	248	} },	
/*247*/		{ 4, { 0,	0,	144,	144,	240,	16,	16,	16	} },	
/*248*/		{ 5, { 0,	0,	168,	168,	168,	168,	168,	248	} },	
/*249*/		{ 6, { 0,	0,	168,	168,	168,	168,	172,	252	} },	
/*250*/		{ 5, { 0,	0,	192,	64,	120,	72,	72,	120	} },	
/*251*/		{ 5, { 0,	0,	136,	136,	232,	168,	168,	224	} },	
/*252*/		{ 4, { 0,	0,	128,	128,	240,	144,	144,	240	} },	
/*253*/		{ 4, { 0,	0,	240,	16,	240,	16,	16,	240	} },	
/*254*/		{ 5, { 0,	0,	184,	168,	232,	168,	168,	184	} },	
/*255*/		{ 4, { 0,	0,	240,	144,	240,	48,	80,	144	} }	
} };
