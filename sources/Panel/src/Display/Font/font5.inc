#include "Font.h"
const Font font5 = {
	5, {
/*0*/		{ 0, { 0,	0,	0,	0,	0,	0,	0,	0	} },	
/*1*/		{ 0, { 0,	0,	0,	0,	0,	0,	0,	0	} },	
/*2*/		{ 0, { 0,	0,	0,	0,	0,	0,	0,	0	} },	
/*3*/		{ 0, { 0,	0,	0,	0,	0,	0,	0,	0	} },	
/*4*/		{ 0, { 0,	0,	0,	0,	0,	0,	0,	0	} },	
/*5*/		{ 0, { 0,	0,	0,	0,	0,	0,	0,	0	} },	
/*6*/		{ 0, { 0,	0,	0,	0,	0,	0,	0,	0	} },	
/*7*/		{ 0, { 0,	0,	0,	0,	0,	0,	0,	0	} },	
/*8*/		{ 0, { 0,	0,	0,	0,	0,	0,	0,	0	} },	
/*9*/		{ 0, { 0,	0,	0,	0,	0,	0,	0,	0	} },	
/*10*/		{ 0, { 0,	0,	0,	0,	0,	0,	0,	0	} },	
/*11*/		{ 0, { 0,	0,	0,	0,	0,	0,	0,	0	} },	
/*12*/		{ 0, { 0,	0,	0,	0,	0,	0,	0,	0	} },	
/*13*/		{ 0, { 0,	0,	0,	0,	0,	0,	0,	0	} },	
/*14*/		{ 0, { 0,	0,	0,	0,	0,	0,	0,	0	} },	
/*15*/		{ 0, { 0,	0,	0,	0,	0,	0,	0,	0	} },	
/*16*/		{ 0, { 0,	0,	0,	0,	0,	0,	0,	0	} },	
/*17*/		{ 1, { 0,	0,	0,	0,	0,	0,	0,	0	} },	
/*18*/		{ 2, { 0,	0,	0,	0,	0,	0,	0,	0	} },	
/*19*/		{ 3, { 0,	0,	0,	0,	0,	0,	0,	0	} },	
/*20*/		{ 4, { 0,	0,	0,	0,	0,	0,	0,	0	} },	
/*21*/		{ 5, { 0,	0,	0,	0,	0,	0,	0,	0	} },	
/*22*/		{ 6, { 0,	0,	0,	0,	0,	0,	0,	0	} },	
/*23*/		{ 7, { 0,	0,	0,	0,	0,	0,	0,	0	} },	
/*24*/		{ 8, { 0,	0,	0,	0,	0,	0,	0,	0	} },	
/*25*/		{ 9, { 0,	0,	0,	0,	0,	0,	0,	0	} },	
/*26*/		{ 10, { 0,	0,	0,	0,	0,	0,	0,	0	} },	
/*27*/		{ 11, { 0,	0,	0,	0,	0,	0,	0,	0	} },	
/*28*/		{ 12, { 0,	0,	0,	0,	0,	0,	0,	0	} },	
/*29*/		{ 13, { 0,	0,	0,	0,	0,	0,	0,	0	} },	
/*30*/		{ 14, { 0,	0,	0,	0,	0,	0,	0,	0	} },	
/*31*/		{ 15, { 0,	0,	0,	0,	0,	0,	0,	0	} },	
/*32*/		{ 1, { 0,	0,	0,	0,	0,	0,	0,	0	} },	
/*33*/		{ 1, { 128,	128,	128,	0,	128,	0,	0,	0	} },	
/*34*/		{ 1, { 0,	0,	0,	0,	128,	0,	0,	0	} },	
/*35*/		{ 5, { 0,	80,	248,	80,	80,	248,	80,	0	} },	
/*36*/		{ 5, { 0,	32,	248,	160,	248,	40,	248,	32	} },	
/*37*/		{ 4, { 144,	32,	96,	64,	144,	0,	0,	0	} },	
/*38*/		{ 5, { 0,	32,	80,	32,	88,	144,	104,	0	} },	
/*39*/		{ 3, { 0,	32,	64,	0,	0,	0,	0,	0	} },	
/*40*/		{ 2, { 64,	128,	128,	128,	64,	0,	0,	0	} },	
/*41*/		{ 2, { 128,	64,	64,	64,	128,	0,	0,	0	} },	
/*42*/		{ 5, { 0,	0,	80,	32,	248,	32,	80,	0	} },	
/*43*/		{ 3, { 0,	64,	224,	64,	0,	0,	0,	0	} },	
/*44*/		{ 2, { 0,	0,	0,	64,	128,	0,	0,	0	} },	
/*45*/		{ 3, { 0,	0,	224,	0,	0,	0,	0,	0	} },	
/*46*/		{ 1, { 0,	0,	0,	0,	128,	0,	0,	0	} },	
/*47*/		{ 2, { 0,	64,	64,	128,	128,	0,	0,	0	} },	
/*48*/		{ 3, { 224,	160,	160,	160,	224,	0,	0,	0	} },	
/*49*/		{ 3, { 192,	64,	64,	64,	224,	0,	0,	0	} },	
/*50*/		{ 3, { 224,	32,	224,	128,	224,	0,	0,	0	} },	
/*51*/		{ 3, { 224,	32,	224,	32,	224,	0,	0,	0	} },	
/*52*/		{ 3, { 160,	160,	224,	32,	32,	0,	0,	0	} },	
/*53*/		{ 3, { 224,	128,	224,	32,	224,	0,	0,	0	} },	
/*54*/		{ 3, { 224,	128,	224,	160,	224,	0,	0,	0	} },	
/*55*/		{ 3, { 224,	32,	64,	128,	128,	0,	0,	0	} },	
/*56*/		{ 3, { 224,	160,	224,	160,	224,	0,	0,	0	} },	
/*57*/		{ 3, { 224,	160,	224,	32,	224,	0,	0,	0	} },	
/*58*/		{ 1, { 128,	0,	0,	0,	128,	0,	0,	0	} },	
/*59*/		{ 3, { 0,	0,	32,	0,	0,	32,	32,	64	} },	
/*60*/		{ 3, { 160,	160,	0,	0,	0,	0,	0,	0	} },	
/*61*/		{ 2, { 0,	192,	0,	192,	0,	0,	0,	0	} },	
/*62*/		{ 3, { 128,	64,	32,	64,	128,	0,	0,	0	} },	
/*63*/		{ 5, { 0,	112,	136,	16,	32,	0,	32,	0	} },	
/*64*/		{ 5, { 0,	112,	152,	168,	176,	128,	112,	0	} },	
/*65*/		{ 3, { 224,	160,	224,	160,	160,	0,	0,	0	} },	
/*66*/		{ 3, { 224,	160,	192,	160,	224,	0,	0,	0	} },	
/*67*/		{ 3, { 224,	128,	128,	128,	224,	0,	0,	0	} },	
/*68*/		{ 3, { 192,	160,	160,	160,	192,	0,	0,	0	} },	
/*69*/		{ 3, { 224,	128,	224,	128,	224,	0,	0,	0	} },	
/*70*/		{ 3, { 224,	128,	224,	128,	128,	0,	0,	0	} },	
/*71*/		{ 3, { 224,	128,	128,	160,	224,	0,	0,	0	} },	
/*72*/		{ 3, { 160,	160,	224,	160,	160,	0,	0,	0	} },	
/*73*/		{ 3, { 224,	64,	64,	64,	224,	0,	0,	0	} },	
/*74*/		{ 3, { 32,	32,	32,	160,	224,	0,	0,	0	} },	
/*75*/		{ 3, { 160,	192,	128,	192,	160,	0,	0,	0	} },	
/*76*/		{ 3, { 128,	128,	128,	128,	224,	0,	0,	0	} },	
/*77*/		{ 5, { 136,	216,	168,	136,	136,	0,	0,	0	} },	
/*78*/		{ 4, { 144,	208,	176,	144,	144,	0,	0,	0	} },	
/*79*/		{ 3, { 224,	160,	160,	160,	224,	0,	0,	0	} },	
/*80*/		{ 3, { 224,	160,	224,	128,	128,	0,	0,	0	} },	
/*81*/		{ 4, { 224,	160,	160,	176,	224,	0,	0,	0	} },	
/*82*/		{ 3, { 224,	160,	224,	192,	160,	0,	0,	0	} },	
/*83*/		{ 3, { 224,	128,	224,	32,	224,	0,	0,	0	} },	
/*84*/		{ 3, { 224,	64,	64,	64,	64,	0,	0,	0	} },	
/*85*/		{ 3, { 160,	160,	160,	160,	224,	0,	0,	0	} },	
/*86*/		{ 3, { 160,	160,	160,	224,	64,	0,	0,	0	} },	
/*87*/		{ 5, { 136,	136,	136,	168,	80,	0,	0,	0	} },	
/*88*/		{ 4, { 144,	96,	64,	96,	144,	0,	0,	0	} },	
/*89*/		{ 3, { 160,	160,	160,	64,	64,	0,	0,	0	} },	
/*90*/		{ 4, { 240,	16,	32,	64,	240,	0,	0,	0	} },	
/*91*/		{ 2, { 192,	128,	128,	128,	192,	0,	0,	0	} },	
/*92*/		{ 5, { 0,	0,	128,	64,	32,	16,	8,	0	} },	
/*93*/		{ 2, { 192,	64,	64,	64,	192,	0,	0,	0	} },	
/*94*/		{ 5, { 0,	32,	112,	168,	32,	32,	32,	0	} },	
/*95*/		{ 3, { 0,	0,	0,	0,	224,	0,	0,	0	} },	
/*96*/		{ 5, { 0,	48,	72,	224,	64,	64,	248,	0	} },	
/*97*/		{ 3, { 224,	160,	224,	160,	160,	0,	0,	0	} },	
/*98*/		{ 3, { 224,	160,	192,	160,	224,	0,	0,	0	} },	
/*99*/		{ 3, { 224,	128,	128,	128,	224,	0,	0,	0	} },	
/*100*/		{ 3, { 192,	160,	160,	160,	192,	0,	0,	0	} },	
/*101*/		{ 3, { 224,	128,	224,	128,	224,	0,	0,	0	} },	
/*102*/		{ 3, { 224,	128,	192,	128,	128,	0,	0,	0	} },	
/*103*/		{ 3, { 224,	128,	128,	160,	224,	0,	0,	0	} },	
/*104*/		{ 3, { 160,	160,	224,	160,	160,	0,	0,	0	} },	
/*105*/		{ 3, { 224,	64,	64,	64,	224,	0,	0,	0	} },	
/*106*/		{ 3, { 32,	32,	32,	160,	224,	0,	0,	0	} },	
/*107*/		{ 3, { 160,	192,	128,	192,	160,	0,	0,	0	} },	
/*108*/		{ 3, { 128,	128,	128,	128,	224,	0,	0,	0	} },	
/*109*/		{ 5, { 136,	216,	168,	136,	136,	0,	0,	0	} },	
/*110*/		{ 4, { 144,	208,	176,	144,	144,	0,	0,	0	} },	
/*111*/		{ 3, { 224,	160,	160,	160,	224,	0,	0,	0	} },	
/*112*/		{ 3, { 224,	160,	224,	128,	128,	0,	0,	0	} },	
/*113*/		{ 4, { 224,	160,	160,	176,	224,	0,	0,	0	} },	
/*114*/		{ 3, { 224,	160,	224,	192,	160,	0,	0,	0	} },	
/*115*/		{ 3, { 224,	128,	224,	32,	224,	0,	0,	0	} },	
/*116*/		{ 3, { 224,	64,	64,	64,	64,	0,	0,	0	} },	
/*117*/		{ 3, { 160,	160,	160,	160,	224,	0,	0,	0	} },	
/*118*/		{ 3, { 160,	160,	160,	160,	64,	0,	0,	0	} },	
/*119*/		{ 5, { 136,	136,	136,	168,	80,	0,	0,	0	} },	
/*120*/		{ 5, { 136,	80,	32,	80,	136,	0,	0,	0	} },	
/*121*/		{ 3, { 160,	160,	224,	64,	64,	0,	0,	0	} },	
/*122*/		{ 4, { 240,	16,	32,	64,	240,	0,	0,	0	} },	
/*123*/		{ 5, { 0,	56,	32,	192,	32,	32,	56,	0	} },	
/*124*/		{ 3, { 0,	32,	32,	32,	32,	32,	32,	0	} },	
/*125*/		{ 5, { 0,	224,	32,	24,	32,	32,	224,	0	} },	
/*126*/		{ 5, { 0,	40,	80,	0,	0,	0,	0,	0	} },	
/*127*/		{ 0, { 0,	0,	0,	0,	0,	0,	0,	0	} },	
/*128*/		{ 0, { 0,	0,	0,	0,	0,	0,	0,	0	} },	
/*129*/		{ 0, { 0,	0,	0,	0,	0,	0,	0,	0	} },	
/*130*/		{ 0, { 0,	0,	0,	0,	0,	0,	0,	0	} },	
/*131*/		{ 0, { 0,	0,	0,	0,	0,	0,	0,	0	} },	
/*132*/		{ 0, { 0,	0,	0,	0,	0,	0,	0,	0	} },	
/*133*/		{ 0, { 0,	0,	0,	0,	0,	0,	0,	0	} },	
/*134*/		{ 0, { 0,	0,	0,	0,	0,	0,	0,	0	} },	
/*135*/		{ 0, { 0,	0,	0,	0,	0,	0,	0,	0	} },	
/*136*/		{ 6, { 0,	0,	0,	252,	0,	0,	0,	0	} },	
/*137*/		{ 6, { 252,	0,	252,	0,	0,	0,	0,	0	} },	
/*138*/		{ 0, { 0,	0,	0,	0,	0,	0,	0,	0	} },	
/*139*/		{ 0, { 0,	0,	0,	0,	0,	0,	0,	0	} },	
/*140*/		{ 0, { 0,	0,	0,	0,	0,	0,	0,	0	} },	
/*141*/		{ 0, { 0,	0,	0,	0,	0,	0,	0,	0	} },	
/*142*/		{ 0, { 0,	0,	0,	0,	0,	0,	0,	0	} },	
/*143*/		{ 0, { 0,	0,	0,	0,	0,	0,	0,	0	} },	
/*144*/		{ 7, { 0,	16,	16,	16,	16,	254,	0,	0	} },	
/*145*/		{ 7, { 0,	0,	96,	146,	12,	0,	0,	0	} },	
/*146*/		{ 7, { 0,	0,	254,	0,	214,	0,	0,	0	} },	
/*147*/		{ 2, { 0,	0,	192,	0,	0,	0,	0,	0	} },	
/*148*/		{ 0, { 0,	0,	0,	0,	0,	0,	0,	0	} },	
/*149*/		{ 0, { 0,	0,	0,	0,	0,	0,	0,	0	} },	
/*150*/		{ 0, { 0,	0,	0,	0,	0,	0,	0,	0	} },	
/*151*/		{ 0, { 0,	0,	0,	0,	0,	0,	0,	0	} },	
/*152*/		{ 0, { 0,	0,	0,	0,	0,	0,	0,	0	} },	
/*153*/		{ 0, { 0,	0,	0,	0,	0,	0,	0,	0	} },	
/*154*/		{ 0, { 0,	0,	0,	0,	0,	0,	0,	0	} },	
/*155*/		{ 0, { 0,	0,	0,	0,	0,	0,	0,	0	} },	
/*156*/		{ 0, { 0,	0,	0,	0,	0,	0,	0,	0	} },	
/*157*/		{ 0, { 0,	0,	0,	0,	0,	0,	0,	0	} },	
/*158*/		{ 0, { 0,	0,	0,	0,	0,	0,	0,	0	} },	
/*159*/		{ 0, { 0,	0,	0,	0,	0,	0,	0,	0	} },	
/*160*/		{ 3, { 0,	224,	224,	128,	224,	0,	0,	0	} },	
/*161*/		{ 8, { 24,	36,	66,	129,	0,	0,	0,	0	} },	
/*162*/		{ 8, { 0,	0,	0,	0,	129,	66,	36,	24	} },	
/*163*/		{ 8, { 24,	60,	126,	255,	0,	0,	0,	0	} },	
/*164*/		{ 8, { 0,	0,	0,	0,	255,	126,	60,	24	} },	
/*165*/		{ 1, { 128,	0,	0,	0,	128,	0,	0,	0	} },	
/*166*/		{ 5, { 224,	32,	112,	32,	56,	0,	0,	0	} },	
/*167*/		{ 5, { 56,	32,	112,	32,	224,	0,	0,	0	} },	
/*168*/		{ 1, { 128,	0,	0,	0,	128,	0,	0,	0	} },	
/*169*/		{ 8, { 240,	132,	140,	159,	140,	132,	240,	0	} },	
/*170*/		{ 0, { 0,	0,	0,	0,	0,	0,	0,	0	} },	
/*171*/		{ 0, { 0,	0,	0,	0,	0,	0,	0,	0	} },	
/*172*/		{ 0, { 0,	0,	0,	0,	0,	0,	0,	0	} },	
/*173*/		{ 0, { 0,	0,	0,	0,	0,	0,	0,	0	} },	
/*174*/		{ 0, { 0,	0,	0,	0,	0,	0,	0,	0	} },	
/*175*/		{ 0, { 0,	0,	0,	0,	0,	0,	0,	0	} },	
/*176*/		{ 3, { 0,	224,	224,	128,	224,	0,	0,	0	} },	
/*177*/		{ 8, { 0,	0,	0,	0,	0,	0,	255,	0	} },	
/*178*/		{ 8, { 124,	130,	130,	130,	130,	130,	1,	0	} },	
/*179*/		{ 8, { 62,	65,	65,	65,	65,	65,	128,	0	} },	
/*180*/		{ 8, { 0,	0,	0,	0,	0,	0,	255,	0	} },	
/*181*/		{ 8, { 63,	64,	64,	64,	64,	64,	128,	0	} },	
/*182*/		{ 8, { 252,	2,	2,	2,	2,	2,	1,	0	} },	
/*183*/		{ 0, { 0,	0,	0,	0,	0,	0,	0,	0	} },	
/*184*/		{ 0, { 0,	0,	0,	0,	0,	0,	0,	0	} },	
/*185*/		{ 0, { 0,	0,	0,	0,	0,	0,	0,	0	} },	
/*186*/		{ 0, { 0,	0,	0,	0,	0,	0,	0,	0	} },	
/*187*/		{ 0, { 0,	0,	0,	0,	0,	0,	0,	0	} },	
/*188*/		{ 0, { 0,	0,	0,	0,	0,	0,	0,	0	} },	
/*189*/		{ 0, { 0,	0,	0,	0,	0,	0,	0,	0	} },	
/*190*/		{ 0, { 0,	0,	0,	0,	0,	0,	0,	0	} },	
/*191*/		{ 0, { 0,	0,	0,	0,	0,	0,	0,	0	} },	
/*192*/		{ 3, { 224,	160,	224,	160,	160,	0,	0,	0	} },	
/*193*/		{ 3, { 224,	128,	224,	160,	224,	0,	0,	0	} },	
/*194*/		{ 3, { 224,	160,	192,	160,	224,	0,	0,	0	} },	
/*195*/		{ 3, { 224,	128,	128,	128,	128,	0,	0,	0	} },	
/*196*/		{ 5, { 112,	80,	80,	248,	136,	0,	0,	0	} },	
/*197*/		{ 3, { 224,	128,	224,	128,	224,	0,	0,	0	} },	
/*198*/		{ 4, { 144,	96,	240,	96,	144,	0,	0,	0	} },	
/*199*/		{ 3, { 224,	32,	64,	32,	224,	0,	0,	0	} },	
/*200*/		{ 4, { 144,	176,	208,	144,	144,	0,	0,	0	} },	
/*201*/		{ 4, { 144,	176,	208,	144,	144,	0,	0,	0	} },	
/*202*/		{ 3, { 160,	192,	128,	192,	160,	0,	0,	0	} },	
/*203*/		{ 3, { 96,	160,	160,	160,	160,	0,	0,	0	} },	
/*204*/		{ 5, { 136,	216,	168,	136,	136,	0,	0,	0	} },	
/*205*/		{ 3, { 160,	160,	224,	160,	160,	0,	0,	0	} },	
/*206*/		{ 3, { 224,	160,	160,	160,	224,	0,	0,	0	} },	
/*207*/		{ 3, { 224,	160,	160,	160,	160,	0,	0,	0	} },	
/*208*/		{ 3, { 224,	160,	224,	128,	128,	0,	0,	0	} },	
/*209*/		{ 3, { 224,	128,	128,	128,	224,	0,	0,	0	} },	
/*210*/		{ 3, { 224,	64,	64,	64,	64,	0,	0,	0	} },	
/*211*/		{ 3, { 160,	160,	224,	32,	224,	0,	0,	0	} },	
/*212*/		{ 5, { 248,	168,	168,	248,	32,	0,	0,	0	} },	
/*213*/		{ 4, { 144,	96,	96,	96,	144,	0,	0,	0	} },	
/*214*/		{ 4, { 160,	160,	160,	160,	240,	0,	0,	0	} },	
/*215*/		{ 3, { 160,	160,	224,	32,	32,	0,	0,	0	} },	
/*216*/		{ 5, { 168,	168,	168,	168,	248,	0,	0,	0	} },	
/*217*/		{ 6, { 168,	168,	168,	168,	252,	0,	0,	0	} },	
/*218*/		{ 4, { 192,	64,	112,	80,	112,	0,	0,	0	} },	
/*219*/		{ 5, { 136,	136,	232,	168,	232,	0,	0,	0	} },	
/*220*/		{ 3, { 128,	128,	224,	160,	224,	0,	0,	0	} },	
/*221*/		{ 3, { 224,	32,	224,	32,	224,	0,	0,	0	} },	
/*222*/		{ 5, { 184,	168,	232,	168,	184,	0,	0,	0	} },	
/*223*/		{ 4, { 240,	144,	240,	80,	144,	0,	0,	0	} },	
/*224*/		{ 3, { 224,	160,	224,	160,	160,	0,	0,	0	} },	
/*225*/		{ 3, { 224,	128,	224,	160,	224,	0,	0,	0	} },	
/*226*/		{ 3, { 224,	160,	192,	160,	224,	0,	0,	0	} },	
/*227*/		{ 3, { 224,	128,	128,	128,	128,	0,	0,	0	} },	
/*228*/		{ 5, { 112,	80,	80,	248,	136,	0,	0,	0	} },	
/*229*/		{ 3, { 224,	128,	224,	128,	224,	0,	0,	0	} },	
/*230*/		{ 4, { 144,	96,	240,	96,	144,	0,	0,	0	} },	
/*231*/		{ 3, { 224,	32,	64,	32,	224,	0,	0,	0	} },	
/*232*/		{ 4, { 144,	176,	208,	144,	144,	0,	0,	0	} },	
/*233*/		{ 4, { 144,	176,	208,	144,	144,	0,	0,	0	} },	
/*234*/		{ 3, { 160,	192,	128,	192,	160,	0,	0,	0	} },	
/*235*/		{ 3, { 96,	160,	160,	160,	160,	0,	0,	0	} },	
/*236*/		{ 5, { 136,	216,	168,	136,	136,	0,	0,	0	} },	
/*237*/		{ 3, { 160,	160,	224,	160,	160,	0,	0,	0	} },	
/*238*/		{ 3, { 224,	160,	160,	160,	224,	0,	0,	0	} },	
/*239*/		{ 3, { 224,	160,	160,	160,	160,	0,	0,	0	} },	
/*240*/		{ 3, { 224,	160,	224,	128,	128,	0,	0,	0	} },	
/*241*/		{ 3, { 224,	128,	128,	128,	224,	0,	0,	0	} },	
/*242*/		{ 3, { 224,	64,	64,	64,	64,	0,	0,	0	} },	
/*243*/		{ 3, { 160,	160,	224,	32,	224,	0,	0,	0	} },	
/*244*/		{ 5, { 248,	168,	168,	248,	32,	0,	0,	0	} },	
/*245*/		{ 4, { 144,	96,	96,	96,	144,	0,	0,	0	} },	
/*246*/		{ 4, { 160,	160,	160,	160,	240,	0,	0,	0	} },	
/*247*/		{ 3, { 160,	160,	224,	32,	32,	0,	0,	0	} },	
/*248*/		{ 5, { 168,	168,	168,	168,	248,	0,	0,	0	} },	
/*249*/		{ 6, { 168,	168,	168,	168,	252,	0,	0,	0	} },	
/*250*/		{ 4, { 192,	64,	112,	80,	112,	0,	0,	0	} },	
/*251*/		{ 5, { 136,	136,	232,	168,	232,	0,	0,	0	} },	
/*252*/		{ 3, { 128,	128,	224,	160,	224,	0,	0,	0	} },	
/*253*/		{ 3, { 224,	32,	224,	32,	224,	0,	0,	0	} },	
/*254*/		{ 5, { 184,	168,	232,	168,	184,	0,	0,	0	} },	
/*255*/		{ 4, { 240,	144,	240,	80,	144,	0,	0,	0	} }	
} };
