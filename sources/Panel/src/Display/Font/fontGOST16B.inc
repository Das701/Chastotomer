/*
    FaceName - GOST
    PointSize - 16
    FontWeight - bold
    Style - normal
    Family - swiss
    Cell width - 25
    Cell height - 25
    Offset x - -1
    Offset y - -3
*/
const unsigned char fontGOST16B[3519] =
{
/* 0x00 */   0x00, 0x00,
/* 0x01 */   0x00, 0x00,
/* 0x02 */   0x00, 0x00,
/* 0x03 */   0x00, 0x00,
/* 0x04 */   0x00, 0x00,
/* 0x05 */   0x00, 0x00,
/* 0x06 */   0x00, 0x00,
/* 0x07 */   0x00, 0x00,
/* 0x08 */   0x00, 0x00,
/* 0x09 */   0x00, 0x00,
/* 0x0A */   0x00, 0x00,
/* 0x0B */   0x00, 0x00,
/* 0x0C */   0x00, 0x00,
/* 0x0D */   0x00, 0x00,
/* 0x0E */   0x00, 0x00,
/* 0x0F */   0x00, 0x00,
/* 0x10 */   0x00, 0x00,
/* 0x11 */   0x00, 0x00,
/* 0x12 */   0x00, 0x00,
/* 0x13 */   0x00, 0x00,
/* 0x14 */   0x00, 0x00,
/* 0x15 */   0x00, 0x00,
/* 0x16 */   0x00, 0x00,
/* 0x17 */   0x00, 0x00,
/* 0x18 */   0x00, 0x00,
/* 0x19 */   0x00, 0x00,
/* 0x1A */   0x00, 0x00,
/* 0x1B */   0x00, 0x00,
/* 0x1C */   0x00, 0x00,
/* 0x1D */   0x00, 0x00,
/* 0x1E */   0x00, 0x00,
/* 0x1F */   0x00, 0x00,
/* 0x20 */   0x00, 0x02,
/* 0x21 */   0x07, 0x02,
/* 0x22 */   0x18, 0x02,
/* 0x23 */   0x1E, 0x02,
/* 0x24 */   0x3D, 0x02,
/* 0x25 */   0x50, 0x02,
/* 0x26 */   0x6F, 0x02,
/* 0x27 */   0x8E, 0x02,
/* 0x28 */   0x95, 0x02,
/* 0x29 */   0xA7, 0x02,
/* 0x2A */   0xB9, 0x02,
/* 0x2B */   0xC1, 0x02,
/* 0x2C */   0xCA, 0x02,
/* 0x2D */   0xD0, 0x02,
/* 0x2E */   0xD4, 0x02,
/* 0x2F */   0xD8, 0x02,
/* 0x30 */   0xFB, 0x02,
/* 0x31 */   0x0C, 0x03,
/* 0x32 */   0x1D, 0x03,
/* 0x33 */   0x2E, 0x03,
/* 0x34 */   0x3F, 0x03,
/* 0x35 */   0x50, 0x03,
/* 0x36 */   0x61, 0x03,
/* 0x37 */   0x72, 0x03,
/* 0x38 */   0x83, 0x03,
/* 0x39 */   0x94, 0x03,
/* 0x3A */   0xA5, 0x03,
/* 0x3B */   0xAF, 0x03,
/* 0x3C */   0xBA, 0x03,
/* 0x3D */   0xC3, 0x03,
/* 0x3E */   0xCA, 0x03,
/* 0x3F */   0xD3, 0x03,
/* 0x40 */   0xE4, 0x03,
/* 0x41 */   0x03, 0x04,
/* 0x42 */   0x22, 0x04,
/* 0x43 */   0x33, 0x04,
/* 0x44 */   0x44, 0x04,
/* 0x45 */   0x55, 0x04,
/* 0x46 */   0x66, 0x04,
/* 0x47 */   0x77, 0x04,
/* 0x48 */   0x88, 0x04,
/* 0x49 */   0x99, 0x04,
/* 0x4A */   0xAA, 0x04,
/* 0x4B */   0xBB, 0x04,
/* 0x4C */   0xCC, 0x04,
/* 0x4D */   0xDD, 0x04,
/* 0x4E */   0xFC, 0x04,
/* 0x4F */   0x0D, 0x05,
/* 0x50 */   0x1E, 0x05,
/* 0x51 */   0x2F, 0x05,
/* 0x52 */   0x4E, 0x05,
/* 0x53 */   0x5F, 0x05,
/* 0x54 */   0x70, 0x05,
/* 0x55 */   0x81, 0x05,
/* 0x56 */   0x92, 0x05,
/* 0x57 */   0xB1, 0x05,
/* 0x58 */   0xD0, 0x05,
/* 0x59 */   0xEF, 0x05,
/* 0x5A */   0x0E, 0x06,
/* 0x5B */   0x1F, 0x06,
/* 0x5C */   0x31, 0x06,
/* 0x5D */   0x54, 0x06,
/* 0x5E */   0x66, 0x06,
/* 0x5F */   0x6D, 0x06,
/* 0x60 */   0x71, 0x06,
/* 0x61 */   0x90, 0x06,
/* 0x62 */   0x9D, 0x06,
/* 0x63 */   0xAE, 0x06,
/* 0x64 */   0xBB, 0x06,
/* 0x65 */   0xCC, 0x06,
/* 0x66 */   0xD9, 0x06,
/* 0x67 */   0xEA, 0x06,
/* 0x68 */   0xFB, 0x06,
/* 0x69 */   0x0C, 0x07,
/* 0x6A */   0x1D, 0x07,
/* 0x6B */   0x32, 0x07,
/* 0x6C */   0x43, 0x07,
/* 0x6D */   0x54, 0x07,
/* 0x6E */   0x6B, 0x07,
/* 0x6F */   0x78, 0x07,
/* 0x70 */   0x85, 0x07,
/* 0x71 */   0x96, 0x07,
/* 0x72 */   0xA7, 0x07,
/* 0x73 */   0xB4, 0x07,
/* 0x74 */   0xC1, 0x07,
/* 0x75 */   0xD2, 0x07,
/* 0x76 */   0xDF, 0x07,
/* 0x77 */   0xEC, 0x07,
/* 0x78 */   0x03, 0x08,
/* 0x79 */   0x10, 0x08,
/* 0x7A */   0x21, 0x08,
/* 0x7B */   0x2E, 0x08,
/* 0x7C */   0x40, 0x08,
/* 0x7D */   0x51, 0x08,
/* 0x7E */   0x63, 0x08,
/* 0x7F */   0x68, 0x08,
/* 0x80 */   0x77, 0x08,
/* 0x81 */   0xB2, 0x08,
/* 0x82 */   0x00, 0x00,
/* 0x83 */   0x00, 0x00,
/* 0x84 */   0x00, 0x00,
/* 0x85 */   0x00, 0x00,
/* 0x86 */   0x00, 0x00,
/* 0x87 */   0x00, 0x00,
/* 0x88 */   0x00, 0x00,
/* 0x89 */   0x00, 0x00,
/* 0x8A */   0x00, 0x00,
/* 0x8B */   0x00, 0x00,
/* 0x8C */   0x00, 0x00,
/* 0x8D */   0x00, 0x00,
/* 0x8E */   0x00, 0x00,
/* 0x8F */   0x00, 0x00,
/* 0x90 */   0x00, 0x00,
/* 0x91 */   0x00, 0x00,
/* 0x92 */   0x00, 0x00,
/* 0x93 */   0x00, 0x00,
/* 0x94 */   0x00, 0x00,
/* 0x95 */   0x00, 0x00,
/* 0x96 */   0x00, 0x00,
/* 0x97 */   0x00, 0x00,
/* 0x98 */   0x00, 0x00,
/* 0x99 */   0x00, 0x00,
/* 0x9A */   0x00, 0x00,
/* 0x9B */   0x00, 0x00,
/* 0x9C */   0x00, 0x00,
/* 0x9D */   0x00, 0x00,
/* 0x9E */   0x00, 0x00,
/* 0x9F */   0x00, 0x00,
/* 0xA0 */   0x00, 0x00,
/* 0xA1 */   0x00, 0x00,
/* 0xA2 */   0x00, 0x00,
/* 0xA3 */   0x00, 0x00,
/* 0xA4 */   0x00, 0x00,
/* 0xA5 */   0x00, 0x00,
/* 0xA6 */   0x00, 0x00,
/* 0xA7 */   0x00, 0x00,
/* 0xA8 */   0x00, 0x00,
/* 0xA9 */   0x00, 0x00,
/* 0xAA */   0x00, 0x00,
/* 0xAB */   0x00, 0x00,
/* 0xAC */   0x00, 0x00,
/* 0xAD */   0x00, 0x00,
/* 0xAE */   0x00, 0x00,
/* 0xAF */   0x00, 0x00,
/* 0xB0 */   0x00, 0x00,
/* 0xB1 */   0x00, 0x00,
/* 0xB2 */   0x00, 0x00,
/* 0xB3 */   0x00, 0x00,
/* 0xB4 */   0x00, 0x00,
/* 0xB5 */   0x00, 0x00,
/* 0xB6 */   0x00, 0x00,
/* 0xB7 */   0x00, 0x00,
/* 0xB8 */   0x00, 0x00,
/* 0xB9 */   0x00, 0x00,
/* 0xBA */   0x00, 0x00,
/* 0xBB */   0x00, 0x00,
/* 0xBC */   0x00, 0x00,
/* 0xBD */   0x00, 0x00,
/* 0xBE */   0x00, 0x00,
/* 0xBF */   0x00, 0x00,
/* 0xC0 */   0xD9, 0x08,
/* 0xC1 */   0xF8, 0x08,
/* 0xC2 */   0x09, 0x09,
/* 0xC3 */   0x1A, 0x09,
/* 0xC4 */   0x2B, 0x09,
/* 0xC5 */   0x4C, 0x09,
/* 0xC6 */   0x5D, 0x09,
/* 0xC7 */   0x7C, 0x09,
/* 0xC8 */   0x8D, 0x09,
/* 0xC9 */   0x9E, 0x09,
/* 0xCA */   0xAF, 0x09,
/* 0xCB */   0xC0, 0x09,
/* 0xCC */   0xDF, 0x09,
/* 0xCD */   0xFE, 0x09,
/* 0xCE */   0x0F, 0x0A,
/* 0xCF */   0x20, 0x0A,
/* 0xD0 */   0x31, 0x0A,
/* 0xD1 */   0x42, 0x0A,
/* 0xD2 */   0x53, 0x0A,
/* 0xD3 */   0x64, 0x0A,
/* 0xD4 */   0x75, 0x0A,
/* 0xD5 */   0x94, 0x0A,
/* 0xD6 */   0xB3, 0x0A,
/* 0xD7 */   0xD6, 0x0A,
/* 0xD8 */   0xE7, 0x0A,
/* 0xD9 */   0x06, 0x0B,
/* 0xDA */   0x29, 0x0B,
/* 0xDB */   0x48, 0x0B,
/* 0xDC */   0x67, 0x0B,
/* 0xDD */   0x78, 0x0B,
/* 0xDE */   0x89, 0x0B,
/* 0xDF */   0xA8, 0x0B,
/* 0xE0 */   0xB9, 0x0B,
/* 0xE1 */   0xC6, 0x0B,
/* 0xE2 */   0xD7, 0x0B,
/* 0xE3 */   0xE8, 0x0B,
/* 0xE4 */   0xF5, 0x0B,
/* 0xE5 */   0x06, 0x0C,
/* 0xE6 */   0x13, 0x0C,
/* 0xE7 */   0x2A, 0x0C,
/* 0xE8 */   0x37, 0x0C,
/* 0xE9 */   0x44, 0x0C,
/* 0xEA */   0x55, 0x0C,
/* 0xEB */   0x62, 0x0C,
/* 0xEC */   0x6F, 0x0C,
/* 0xED */   0x7C, 0x0C,
/* 0xEE */   0x89, 0x0C,
/* 0xEF */   0x96, 0x0C,
/* 0xF0 */   0xA3, 0x0C,
/* 0xF1 */   0xB4, 0x0C,
/* 0xF2 */   0xC1, 0x0C,
/* 0xF3 */   0xD8, 0x0C,
/* 0xF4 */   0xE9, 0x0C,
/* 0xF5 */   0x0C, 0x0D,
/* 0xF6 */   0x19, 0x0D,
/* 0xF7 */   0x28, 0x0D,
/* 0xF8 */   0x35, 0x0D,
/* 0xF9 */   0x4C, 0x0D,
/* 0xFA */   0x67, 0x0D,
/* 0xFB */   0x7E, 0x0D,
/* 0xFC */   0x8B, 0x0D,
/* 0xFD */   0x98, 0x0D,
/* 0xFE */   0xA5, 0x0D,
/* 0xFF */   0xB2, 0x0D,

/* Symbol 0x20, offset 512 */
    25, 1, 0,
    0x00, 0x00, 0x00, 0x00, 

/* Symbol 0x21, offset 519 */
    2, 14, 0,
    0xC0, 0xC0, 0xC0, 0xC0, 0xC0, 0xC0, 0xC0, 0xC0, 0xC0, 0xC0, 0xC0, 0x00, 0x00, 0xC0, 

/* Symbol 0x22, offset 536 */
    3, 3, 0,
    0xE0, 0xE0, 0xE0, 

/* Symbol 0x23, offset 542 */
    11, 14, 0,
    0x0C, 0xC0, 0x0D, 0x80, 0x19, 0x80, 0x7F, 0xE0, 0x19, 0x80, 0x1B, 0x00, 0x33, 0x00, 0x33, 0x00, 0x33, 0x00, 0xFF, 0xC0, 0x36, 0x00, 0x66, 0x00, 0x66, 0x00, 0x66, 0x00, 

/* Symbol 0x24, offset 573 */
    8, 16, 0,
    0x7E, 0xFB, 0xD8, 0xD8, 0xF8, 0x78, 0x38, 0x1C, 0x1E, 0x1F, 0x1B, 0x1B, 0x1F, 0xFE, 0x18, 0x18, 

/* Symbol 0x25, offset 592 */
    16, 14, 0,
    0x7C, 0x18, 0xEE, 0x18, 0xC6, 0x30, 0xC6, 0x70, 0xEE, 0x60, 0x7C, 0xC0, 0x01, 0xC0, 0x01, 0x80, 0x03, 0x3E, 0x03, 0x77, 0x06, 0x63, 0x0C, 0x63, 0x0C, 0x77, 0x18, 0x3E, 

/* Symbol 0x26, offset 623 */
    10, 14, 0,
    0x3C, 0x00, 0x66, 0x00, 0x66, 0x00, 0x3C, 0x00, 0x1C, 0x00, 0x38, 0x00, 0x3C, 0x00, 0x66, 0x00, 0xC6, 0x00, 0xC3, 0xC0, 0xC3, 0x80, 0xC3, 0x80, 0x67, 0xC0, 0x3C, 0xC0, 

/* Symbol 0x27, offset 654 */
    1, 4, 0,
    0x80, 0x80, 0x80, 0x80, 

/* Symbol 0x28, offset 661 */
    3, 15, 0,
    0x60, 0x60, 0xC0, 0xC0, 0xC0, 0xC0, 0xC0, 0xC0, 0xC0, 0xC0, 0xC0, 0x60, 0x60, 0x60, 0x60, 

/* Symbol 0x29, offset 679 */
    3, 15, 0,
    0xC0, 0x60, 0x60, 0x60, 0x60, 0x60, 0x60, 0x60, 0x60, 0x60, 0x60, 0x60, 0xC0, 0xC0, 0xC0, 

/* Symbol 0x2A, offset 697 */
    6, 5, 0,
    0x78, 0x70, 0xFC, 0x38, 0x78, 

/* Symbol 0x2B, offset 705 */
    7, 12, 6,
    0x30, 0x30, 0x30, 0xFE, 0x30, 0x30, 

/* Symbol 0x2C, offset 714 */
    1, 16, 13,
    0x80, 0x80, 0x80, 

/* Symbol 0x2D, offset 720 */
    7, 9, 8,
    0xFE, 

/* Symbol 0x2E, offset 724 */
    2, 14, 13,
    0xC0, 

/* Symbol 0x2F, offset 728 */
    9, 16, 0,
    0x01, 0x80, 0x01, 0x80, 0x03, 0x00, 0x03, 0x00, 0x06, 0x00, 0x06, 0x00, 0x0C, 0x00, 0x0C, 0x00, 0x18, 0x00, 0x18, 0x00, 0x30, 0x00, 0x30, 0x00, 0x60, 0x00, 0x60, 0x00, 0xC0, 0x00, 0xC0, 0x00, 

/* Symbol 0x30, offset 763 */
    8, 14, 0,
    0x7E, 0xE7, 0xC3, 0xC3, 0xC3, 0xC3, 0xC3, 0xC3, 0xC3, 0xC3, 0xC3, 0xC3, 0xE7, 0x7E, 

/* Symbol 0x31, offset 780 */
    5, 14, 0,
    0x18, 0x38, 0x78, 0xD8, 0x18, 0x18, 0x18, 0x18, 0x18, 0x18, 0x18, 0x18, 0x18, 0x18, 

/* Symbol 0x32, offset 797 */
    8, 14, 0,
    0x3C, 0x66, 0xC3, 0x03, 0x03, 0x06, 0x0E, 0x0C, 0x18, 0x18, 0x30, 0x60, 0x60, 0xFF, 

/* Symbol 0x33, offset 814 */
    7, 14, 0,
    0xFC, 0x0E, 0x06, 0x06, 0x06, 0x0E, 0x1C, 0x06, 0x06, 0x06, 0x06, 0x06, 0x0E, 0xFC, 

/* Symbol 0x34, offset 831 */
    8, 14, 0,
    0x30, 0x30, 0x30, 0x60, 0x60, 0x60, 0x60, 0x6C, 0xCC, 0xCC, 0xFF, 0x0C, 0x0C, 0x0C, 

/* Symbol 0x35, offset 848 */
    7, 14, 0,
    0xFE, 0xC0, 0xC0, 0xC0, 0xC0, 0xC0, 0xFC, 0x0E, 0x06, 0x06, 0x06, 0x06, 0x0E, 0xFC, 

/* Symbol 0x36, offset 865 */
    8, 14, 0,
    0x1C, 0x38, 0x70, 0x60, 0xC0, 0xC0, 0xFE, 0xC7, 0xC3, 0xC3, 0xC3, 0xC3, 0xE7, 0x7E, 

/* Symbol 0x37, offset 882 */
    8, 14, 0,
    0xFF, 0xC3, 0xC3, 0x07, 0x06, 0x06, 0x06, 0x06, 0x0C, 0x0C, 0x0C, 0x0C, 0x18, 0x18, 

/* Symbol 0x38, offset 899 */
    8, 14, 0,
    0x3E, 0x77, 0x63, 0x63, 0x63, 0x77, 0x3E, 0x67, 0xC3, 0xC3, 0xC3, 0xC3, 0xE7, 0x7E, 

/* Symbol 0x39, offset 916 */
    8, 14, 0,
    0x7E, 0xE7, 0xC3, 0xC3, 0xC3, 0xC3, 0xE3, 0x7F, 0x03, 0x03, 0x06, 0x06, 0x1C, 0x38, 

/* Symbol 0x3A, offset 933 */
    2, 11, 4,
    0xC0, 0xC0, 0x00, 0x00, 0x00, 0x00, 0xC0, 

/* Symbol 0x3B, offset 943 */
    3, 16, 8,
    0x60, 0x00, 0x00, 0x00, 0x00, 0x60, 0x60, 0xC0, 

/* Symbol 0x3C, offset 954 */
    6, 12, 6,
    0x0C, 0x38, 0xE0, 0xE0, 0x38, 0x0C, 

/* Symbol 0x3D, offset 963 */
    6, 11, 7,
    0xFC, 0x00, 0x00, 0xFC, 

/* Symbol 0x3E, offset 970 */
    7, 12, 6,
    0xE0, 0x38, 0x0E, 0x0E, 0x38, 0xE0, 

/* Symbol 0x3F, offset 979 */
    8, 14, 0,
    0x7E, 0xC7, 0x03, 0x03, 0x03, 0x0E, 0x1C, 0x18, 0x18, 0x18, 0x18, 0x00, 0x00, 0x18, 

/* Symbol 0x40, offset 996 */
    15, 14, 0,
    0x0F, 0xE0, 0x1C, 0x70, 0x30, 0x18, 0x67, 0xEC, 0xEC, 0x6E, 0xCC, 0x66, 0xCC, 0x66, 0xCC, 0x66, 0xCC, 0x66, 0xEC, 0x6C, 0x67, 0xFC, 0x30, 0x00, 0x1C, 0x30, 0x0F, 0xE0, 

/* Symbol 0x41, offset 1027 */
    9, 14, 0,
    0x0C, 0x00, 0x1C, 0x00, 0x1C, 0x00, 0x1C, 0x00, 0x36, 0x00, 0x36, 0x00, 0x36, 0x00, 0x63, 0x00, 0x63, 0x00, 0x7F, 0x00, 0x63, 0x00, 0x61, 0x80, 0xC1, 0x80, 0xC1, 0x80, 

/* Symbol 0x42, offset 1058 */
    8, 14, 0,
    0xFE, 0xC7, 0xC3, 0xC3, 0xC3, 0xC7, 0xFE, 0xC7, 0xC3, 0xC3, 0xC3, 0xC3, 0xC7, 0xFE, 

/* Symbol 0x43, offset 1075 */
    7, 14, 0,
    0x7E, 0xE0, 0xC0, 0xC0, 0xC0, 0xC0, 0xC0, 0xC0, 0xC0, 0xC0, 0xC0, 0xC0, 0xE0, 0x7E, 

/* Symbol 0x44, offset 1092 */
    8, 14, 0,
    0xFE, 0xC7, 0xC3, 0xC3, 0xC3, 0xC3, 0xC3, 0xC3, 0xC3, 0xC3, 0xC3, 0xC3, 0xC7, 0xFE, 

/* Symbol 0x45, offset 1109 */
    7, 14, 0,
    0xFE, 0xC0, 0xC0, 0xC0, 0xC0, 0xC0, 0xF8, 0xC0, 0xC0, 0xC0, 0xC0, 0xC0, 0xC0, 0xFE, 

/* Symbol 0x46, offset 1126 */
    7, 14, 0,
    0xFE, 0xC0, 0xC0, 0xC0, 0xC0, 0xC0, 0xFE, 0xC0, 0xC0, 0xC0, 0xC0, 0xC0, 0xC0, 0xC0, 

/* Symbol 0x47, offset 1143 */
    8, 14, 0,
    0x7F, 0xE0, 0xC0, 0xC0, 0xC0, 0xC0, 0xCF, 0xC3, 0xC3, 0xC3, 0xC3, 0xC3, 0xE3, 0x7F, 

/* Symbol 0x48, offset 1160 */
    8, 14, 0,
    0xC3, 0xC3, 0xC3, 0xC3, 0xC3, 0xC3, 0xFF, 0xC3, 0xC3, 0xC3, 0xC3, 0xC3, 0xC3, 0xC3, 

/* Symbol 0x49, offset 1177 */
    2, 14, 0,
    0xC0, 0xC0, 0xC0, 0xC0, 0xC0, 0xC0, 0xC0, 0xC0, 0xC0, 0xC0, 0xC0, 0xC0, 0xC0, 0xC0, 

/* Symbol 0x4A, offset 1194 */
    6, 14, 0,
    0x0C, 0x0C, 0x0C, 0x0C, 0x0C, 0x0C, 0x0C, 0x0C, 0x0C, 0x0C, 0x0C, 0x0C, 0x1C, 0xF8, 

/* Symbol 0x4B, offset 1211 */
    8, 14, 0,
    0xC3, 0xC6, 0xCC, 0xCC, 0xD8, 0xF0, 0xF8, 0xF8, 0xDC, 0xCC, 0xCE, 0xC6, 0xC7, 0xC3, 

/* Symbol 0x4C, offset 1228 */
    6, 14, 0,
    0xC0, 0xC0, 0xC0, 0xC0, 0xC0, 0xC0, 0xC0, 0xC0, 0xC0, 0xC0, 0xC0, 0xC0, 0xC0, 0xFC, 

/* Symbol 0x4D, offset 1245 */
    10, 14, 0,
    0xC0, 0xC0, 0xE1, 0xC0, 0xE3, 0xC0, 0xF3, 0xC0, 0xDE, 0xC0, 0xDE, 0xC0, 0xCC, 0xC0, 0xC0, 0xC0, 0xC0, 0xC0, 0xC0, 0xC0, 0xC0, 0xC0, 0xC0, 0xC0, 0xC0, 0xC0, 0xC0, 0xC0, 

/* Symbol 0x4E, offset 1276 */
    8, 14, 0,
    0xC3, 0xE3, 0xE3, 0xF3, 0xF3, 0xF3, 0xDB, 0xDB, 0xCF, 0xCF, 0xC7, 0xC7, 0xC3, 0xC3, 

/* Symbol 0x4F, offset 1293 */
    8, 14, 0,
    0x7E, 0xE7, 0xC3, 0xC3, 0xC3, 0xC3, 0xC3, 0xC3, 0xC3, 0xC3, 0xC3, 0xC3, 0xE7, 0x7E, 

/* Symbol 0x50, offset 1310 */
    8, 14, 0,
    0xFE, 0xC7, 0xC3, 0xC3, 0xC3, 0xC3, 0xC7, 0xFE, 0xC0, 0xC0, 0xC0, 0xC0, 0xC0, 0xC0, 

/* Symbol 0x51, offset 1327 */
    9, 14, 0,
    0x7E, 0x00, 0xE7, 0x00, 0xC3, 0x00, 0xC3, 0x00, 0xC3, 0x00, 0xC3, 0x00, 0xC3, 0x00, 0xC3, 0x00, 0xC3, 0x00, 0xDB, 0x00, 0xCF, 0x00, 0xC7, 0x00, 0xC3, 0x00, 0x7F, 0x80, 

/* Symbol 0x52, offset 1358 */
    8, 14, 0,
    0xFE, 0xC7, 0xC3, 0xC3, 0xC3, 0xC3, 0xC7, 0xFE, 0xD8, 0xCC, 0xCC, 0xC6, 0xC6, 0xC3, 

/* Symbol 0x53, offset 1375 */
    8, 14, 0,
    0x7F, 0xE3, 0xC0, 0xC0, 0xE0, 0x70, 0x38, 0x1C, 0x0E, 0x07, 0x03, 0x03, 0x07, 0xFE, 

/* Symbol 0x54, offset 1392 */
    8, 14, 0,
    0xFF, 0x18, 0x18, 0x18, 0x18, 0x18, 0x18, 0x18, 0x18, 0x18, 0x18, 0x18, 0x18, 0x18, 

/* Symbol 0x55, offset 1409 */
    8, 14, 0,
    0xC3, 0xC3, 0xC3, 0xC3, 0xC3, 0xC3, 0xC3, 0xC3, 0xC3, 0xC3, 0xC3, 0xC3, 0xE7, 0x7E, 

/* Symbol 0x56, offset 1426 */
    9, 14, 0,
    0xC1, 0x80, 0xC1, 0x80, 0x61, 0x80, 0x63, 0x00, 0x63, 0x00, 0x73, 0x00, 0x37, 0x00, 0x36, 0x00, 0x36, 0x00, 0x1E, 0x00, 0x1C, 0x00, 0x1C, 0x00, 0x1C, 0x00, 0x0C, 0x00, 

/* Symbol 0x57, offset 1457 */
    13, 14, 0,
    0xC0, 0x18, 0xC0, 0x18, 0xC0, 0x18, 0x60, 0x18, 0x63, 0x38, 0x67, 0x30, 0x67, 0x30, 0x77, 0xB0, 0x3D, 0xB0, 0x3D, 0xF0, 0x3C, 0xE0, 0x38, 0xE0, 0x38, 0xE0, 0x18, 0x60, 

/* Symbol 0x58, offset 1488 */
    10, 14, 0,
    0xC0, 0xC0, 0x61, 0x80, 0x61, 0x80, 0x33, 0x00, 0x3F, 0x00, 0x1E, 0x00, 0x0C, 0x00, 0x0C, 0x00, 0x1E, 0x00, 0x3F, 0x00, 0x33, 0x00, 0x61, 0x80, 0x61, 0x80, 0xC0, 0xC0, 

/* Symbol 0x59, offset 1519 */
    10, 14, 0,
    0xC0, 0xC0, 0x61, 0x80, 0x61, 0x80, 0x33, 0x00, 0x3F, 0x00, 0x1E, 0x00, 0x0C, 0x00, 0x0C, 0x00, 0x0C, 0x00, 0x0C, 0x00, 0x0C, 0x00, 0x0C, 0x00, 0x0C, 0x00, 0x0C, 0x00, 

/* Symbol 0x5A, offset 1550 */
    8, 14, 0,
    0xFF, 0x03, 0x06, 0x06, 0x0C, 0x0C, 0x18, 0x18, 0x30, 0x30, 0x70, 0x60, 0xE0, 0xFF, 

/* Symbol 0x5B, offset 1567 */
    4, 15, 0,
    0xC0, 0xC0, 0xC0, 0xC0, 0xC0, 0xC0, 0xC0, 0xC0, 0xC0, 0xC0, 0xC0, 0xC0, 0xC0, 0xC0, 0xF0, 

/* Symbol 0x5C, offset 1585 */
    9, 16, 0,
    0xC0, 0x00, 0x60, 0x00, 0x60, 0x00, 0x30, 0x00, 0x30, 0x00, 0x38, 0x00, 0x18, 0x00, 0x1C, 0x00, 0x0C, 0x00, 0x0E, 0x00, 0x06, 0x00, 0x07, 0x00, 0x03, 0x00, 0x03, 0x80, 0x01, 0x80, 0x01, 0x80, 

/* Symbol 0x5D, offset 1620 */
    3, 15, 0,
    0x60, 0x60, 0x60, 0x60, 0x60, 0x60, 0x60, 0x60, 0x60, 0x60, 0x60, 0x60, 0x60, 0x60, 0xE0, 

/* Symbol 0x5E, offset 1638 */
    25, 1, 0,
    0x00, 0x00, 0x00, 0x00, 

/* Symbol 0x5F, offset 1645 */
    8, 16, 15,
    0xFF, 

/* Symbol 0x60, offset 1649 */
    14, 14, 0,
    0xFF, 0xFC, 0xC0, 0x0C, 0xC0, 0x0C, 0xC0, 0x0C, 0xC0, 0x0C, 0xC0, 0x0C, 0xC0, 0x0C, 0xC0, 0x0C, 0xC0, 0x0C, 0xC0, 0x0C, 0xC0, 0x0C, 0xC0, 0x0C, 0xC0, 0x0C, 0xFF, 0xFC, 

/* Symbol 0x61, offset 1680 */
    8, 14, 4,
    0x7E, 0xC6, 0xC6, 0xC6, 0xC6, 0xC6, 0xC6, 0xC6, 0xC6, 0x7F, 

/* Symbol 0x62, offset 1693 */
    7, 14, 0,
    0xC0, 0xC0, 0xC0, 0xC0, 0xFC, 0xC6, 0xC6, 0xC6, 0xC6, 0xC6, 0xC6, 0xC6, 0xC6, 0xFC, 

/* Symbol 0x63, offset 1710 */
    7, 14, 4,
    0x7E, 0xC0, 0xC0, 0xC0, 0xC0, 0xC0, 0xC0, 0xC0, 0xC0, 0x7E, 

/* Symbol 0x64, offset 1723 */
    7, 14, 0,
    0x06, 0x06, 0x06, 0x06, 0x7E, 0xC6, 0xC6, 0xC6, 0xC6, 0xC6, 0xC6, 0xC6, 0xC6, 0x7E, 

/* Symbol 0x65, offset 1740 */
    7, 14, 4,
    0x7C, 0xC6, 0xC6, 0xC6, 0xC6, 0xFE, 0xC0, 0xC0, 0xC0, 0x7E, 

/* Symbol 0x66, offset 1753 */
    5, 14, 0,
    0x38, 0x60, 0x60, 0x60, 0xF8, 0x60, 0x60, 0x60, 0x60, 0x60, 0x60, 0x60, 0x60, 0x60, 

/* Symbol 0x67, offset 1770 */
    7, 18, 4,
    0x7E, 0xC6, 0xC6, 0xC6, 0xC6, 0xC6, 0xC6, 0xC6, 0xC6, 0x7E, 0x06, 0x06, 0x06, 0xFC, 

/* Symbol 0x68, offset 1787 */
    7, 14, 0,
    0xC0, 0xC0, 0xC0, 0xC0, 0xFC, 0xC6, 0xC6, 0xC6, 0xC6, 0xC6, 0xC6, 0xC6, 0xC6, 0xC6, 

/* Symbol 0x69, offset 1804 */
    2, 14, 0,
    0xC0, 0x00, 0x00, 0x00, 0xC0, 0xC0, 0xC0, 0xC0, 0xC0, 0xC0, 0xC0, 0xC0, 0xC0, 0xC0, 

/* Symbol 0x6A, offset 1821 */
    2, 18, 0,
    0xC0, 0x00, 0x00, 0x00, 0xC0, 0xC0, 0xC0, 0xC0, 0xC0, 0xC0, 0xC0, 0xC0, 0xC0, 0xC0, 0xC0, 0xC0, 0xC0, 0x80, 

/* Symbol 0x6B, offset 1842 */
    7, 14, 0,
    0xC0, 0xC0, 0xC0, 0xC0, 0xC6, 0xCC, 0xD8, 0xF8, 0xF0, 0xF8, 0xD8, 0xCC, 0xCE, 0xC6, 

/* Symbol 0x6C, offset 1859 */
    4, 14, 0,
    0xC0, 0xC0, 0xC0, 0xC0, 0xC0, 0xC0, 0xC0, 0xC0, 0xC0, 0xC0, 0xC0, 0xC0, 0xC0, 0x70, 

/* Symbol 0x6D, offset 1876 */
    10, 14, 4,
    0xFF, 0x80, 0xCC, 0xC0, 0xCC, 0xC0, 0xCC, 0xC0, 0xCC, 0xC0, 0xCC, 0xC0, 0xCC, 0xC0, 0xCC, 0xC0, 0xCC, 0xC0, 0xCC, 0xC0, 

/* Symbol 0x6E, offset 1899 */
    7, 14, 4,
    0xFC, 0xC6, 0xC6, 0xC6, 0xC6, 0xC6, 0xC6, 0xC6, 0xC6, 0xC6, 

/* Symbol 0x6F, offset 1912 */
    7, 14, 4,
    0x7C, 0xC6, 0xC6, 0xC6, 0xC6, 0xC6, 0xC6, 0xC6, 0xC6, 0x7C, 

/* Symbol 0x70, offset 1925 */
    7, 18, 4,
    0xFC, 0xC6, 0xC6, 0xC6, 0xC6, 0xC6, 0xC6, 0xC6, 0xC6, 0xFC, 0xC0, 0xC0, 0xC0, 0xC0, 

/* Symbol 0x71, offset 1942 */
    7, 18, 4,
    0x7E, 0xC6, 0xC6, 0xC6, 0xC6, 0xC6, 0xC6, 0xC6, 0xC6, 0x7E, 0x06, 0x06, 0x06, 0x06, 

/* Symbol 0x72, offset 1959 */
    6, 14, 4,
    0xFC, 0xCC, 0xC0, 0xC0, 0xC0, 0xC0, 0xC0, 0xC0, 0xC0, 0xC0, 

/* Symbol 0x73, offset 1972 */
    7, 14, 4,
    0x7C, 0xC6, 0xC0, 0xE0, 0x30, 0x18, 0x0E, 0x06, 0x06, 0xFC, 

/* Symbol 0x74, offset 1985 */
    5, 14, 0,
    0x60, 0x60, 0x60, 0x60, 0xF8, 0x60, 0x60, 0x60, 0x60, 0x60, 0x60, 0x60, 0x60, 0x60, 

/* Symbol 0x75, offset 2002 */
    7, 14, 4,
    0xC6, 0xC6, 0xC6, 0xC6, 0xC6, 0xC6, 0xC6, 0xC6, 0xC6, 0x7E, 

/* Symbol 0x76, offset 2015 */
    7, 14, 4,
    0xC6, 0xC6, 0x66, 0x6C, 0x6C, 0x6C, 0x38, 0x38, 0x38, 0x18, 

/* Symbol 0x77, offset 2028 */
    11, 14, 4,
    0xC0, 0x60, 0xC0, 0x60, 0xC6, 0x60, 0x6E, 0x60, 0x6E, 0xC0, 0x6F, 0xC0, 0x7B, 0xC0, 0x3B, 0xC0, 0x31, 0x80, 0x31, 0x80, 

/* Symbol 0x78, offset 2051 */
    7, 14, 4,
    0xC6, 0x66, 0x6C, 0x3C, 0x38, 0x38, 0x3C, 0x6C, 0x66, 0xC6, 

/* Symbol 0x79, offset 2064 */
    7, 18, 4,
    0xC6, 0xC6, 0x66, 0x6C, 0x6C, 0x6C, 0x3C, 0x38, 0x38, 0x18, 0x30, 0x30, 0x30, 0xE0, 

/* Symbol 0x7A, offset 2081 */
    7, 14, 4,
    0xFE, 0x06, 0x0C, 0x1C, 0x18, 0x30, 0x30, 0x60, 0x60, 0xFE, 

/* Symbol 0x7B, offset 2094 */
    4, 15, 0,
    0x60, 0x60, 0x60, 0x60, 0x60, 0x60, 0xE0, 0x60, 0x60, 0x60, 0x60, 0x60, 0x60, 0x60, 0x70, 

/* Symbol 0x7C, offset 2112 */
    2, 14, 0,
    0xC0, 0xC0, 0xC0, 0xC0, 0xC0, 0xC0, 0xC0, 0xC0, 0xC0, 0xC0, 0xC0, 0xC0, 0xC0, 0xC0, 

/* Symbol 0x7D, offset 2129 */
    3, 15, 0,
    0xC0, 0xC0, 0xC0, 0xC0, 0xC0, 0xC0, 0x60, 0xC0, 0xC0, 0xC0, 0xC0, 0xC0, 0xC0, 0xC0, 0xC0, 

/* Symbol 0x7E, offset 2147 */
    8, 10, 8,
    0xFB, 0x1F, 

/* Symbol 0x7F, offset 2152 */
    4, 13, 1,
    0xF0, 0xB0, 0xB0, 0xB0, 0xB0, 0xB0, 0xB0, 0xB0, 0xB0, 0xB0, 0xB0, 0xF0, 

/* Symbol 0x80, offset 2167 */
    25, 17, 3,
    0x1F, 0x00, 0x01, 0x80, 0x3F, 0x00, 0x03, 0x80, 0x61, 0x80, 0x06, 0x00,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 0x80, 

/* Symbol 0x81, offset 2226 */
    25, 17, 8,
    0xFF, 0xC3, 0xFF, 0x80, 0xFF, 0xC3, 0xFF, 0x80, 0x00, 0x00, 0x00, 0x00,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 0x80, 

/* Symbol 0xC0, offset 2265 */
    9, 14, 0,
    0x0C, 0x00, 0x1C, 0x00, 0x1C, 0x00, 0x1C, 0x00, 0x36, 0x00, 0x36, 0x00, 0x36, 0x00, 0x63, 0x00, 0x63, 0x00, 0x7F, 0x00, 0x63, 0x00, 0x61, 0x80, 0xC1, 0x80, 0xC1, 0x80, 

/* Symbol 0xC1, offset 2296 */
    8, 14, 0,
    0xFF, 0xC0, 0xC0, 0xC0, 0xC0, 0xC0, 0xFE, 0xC7, 0xC3, 0xC3, 0xC3, 0xC3, 0xC7, 0xFE, 

/* Symbol 0xC2, offset 2313 */
    8, 14, 0,
    0xFE, 0xC7, 0xC3, 0xC3, 0xC3, 0xC7, 0xFE, 0xC7, 0xC3, 0xC3, 0xC3, 0xC3, 0xC7, 0xFE, 

/* Symbol 0xC3, offset 2330 */
    7, 14, 0,
    0xFE, 0xC0, 0xC0, 0xC0, 0xC0, 0xC0, 0xC0, 0xC0, 0xC0, 0xC0, 0xC0, 0xC0, 0xC0, 0xC0, 

/* Symbol 0xC4, offset 2347 */
    9, 15, 0,
    0x3F, 0x00, 0x33, 0x00, 0x33, 0x00, 0x33, 0x00, 0x33, 0x00, 0x33, 0x00, 0x33, 0x00, 0x73, 0x00, 0x63, 0x00, 0x63, 0x00, 0x63, 0x00, 0x63, 0x00, 0x63, 0x00, 0xFF, 0x80, 0xC1, 0x80, 

/* Symbol 0xC5, offset 2380 */
    7, 14, 0,
    0xFE, 0xC0, 0xC0, 0xC0, 0xC0, 0xC0, 0xF8, 0xC0, 0xC0, 0xC0, 0xC0, 0xC0, 0xC0, 0xFE, 

/* Symbol 0xC6, offset 2397 */
    10, 14, 0,
    0xCC, 0xC0, 0xED, 0xC0, 0x6D, 0x80, 0x7F, 0x80, 0x3F, 0x00, 0x3F, 0x00, 0x1E, 0x00, 0x1E, 0x00, 0x3F, 0x00, 0x3F, 0x00, 0x6D, 0x80, 0x6D, 0x80, 0x6D, 0xC0, 0xCC, 0xC0, 

/* Symbol 0xC7, offset 2428 */
    8, 14, 0,
    0x3E, 0x67, 0x03, 0x03, 0x03, 0x07, 0x3E, 0x07, 0x03, 0x03, 0x03, 0xC3, 0xE7, 0x7E, 

/* Symbol 0xC8, offset 2445 */
    8, 14, 0,
    0xC3, 0xC7, 0xC7, 0xCF, 0xCF, 0xCF, 0xDB, 0xDB, 0xF3, 0xF3, 0xE3, 0xE3, 0xC3, 0xC3, 

/* Symbol 0xC9, offset 2462 */
    8, 14, 0,
    0xC3, 0xC7, 0xC7, 0xCF, 0xCF, 0xCF, 0xDB, 0xDB, 0xF3, 0xF3, 0xE3, 0xE3, 0xC3, 0xC3, 

/* Symbol 0xCA, offset 2479 */
    8, 14, 0,
    0xC3, 0xC6, 0xCC, 0xCC, 0xD8, 0xF0, 0xF8, 0xF8, 0xDC, 0xCC, 0xCE, 0xC6, 0xC7, 0xC3, 

/* Symbol 0xCB, offset 2496 */
    9, 14, 0,
    0x0F, 0x80, 0x0D, 0x80, 0x19, 0x80, 0x19, 0x80, 0x19, 0x80, 0x39, 0x80, 0x31, 0x80, 0x31, 0x80, 0x31, 0x80, 0x61, 0x80, 0x61, 0x80, 0x61, 0x80, 0xC1, 0x80, 0xC1, 0x80, 

/* Symbol 0xCC, offset 2527 */
    10, 14, 0,
    0xC0, 0xC0, 0xE1, 0xC0, 0xE3, 0xC0, 0xF3, 0xC0, 0xDE, 0xC0, 0xDE, 0xC0, 0xCC, 0xC0, 0xC0, 0xC0, 0xC0, 0xC0, 0xC0, 0xC0, 0xC0, 0xC0, 0xC0, 0xC0, 0xC0, 0xC0, 0xC0, 0xC0, 

/* Symbol 0xCD, offset 2558 */
    8, 14, 0,
    0xC3, 0xC3, 0xC3, 0xC3, 0xC3, 0xC3, 0xFF, 0xC3, 0xC3, 0xC3, 0xC3, 0xC3, 0xC3, 0xC3, 

/* Symbol 0xCE, offset 2575 */
    8, 14, 0,
    0x7E, 0xE7, 0xC3, 0xC3, 0xC3, 0xC3, 0xC3, 0xC3, 0xC3, 0xC3, 0xC3, 0xC3, 0xE7, 0x7E, 

/* Symbol 0xCF, offset 2592 */
    8, 14, 0,
    0xFF, 0xC3, 0xC3, 0xC3, 0xC3, 0xC3, 0xC3, 0xC3, 0xC3, 0xC3, 0xC3, 0xC3, 0xC3, 0xC3, 

/* Symbol 0xD0, offset 2609 */
    8, 14, 0,
    0xFE, 0xC7, 0xC3, 0xC3, 0xC3, 0xC3, 0xC7, 0xFE, 0xC0, 0xC0, 0xC0, 0xC0, 0xC0, 0xC0, 

/* Symbol 0xD1, offset 2626 */
    7, 14, 0,
    0x7E, 0xE0, 0xC0, 0xC0, 0xC0, 0xC0, 0xC0, 0xC0, 0xC0, 0xC0, 0xC0, 0xC0, 0xE0, 0x7E, 

/* Symbol 0xD2, offset 2643 */
    8, 14, 0,
    0xFF, 0x18, 0x18, 0x18, 0x18, 0x18, 0x18, 0x18, 0x18, 0x18, 0x18, 0x18, 0x18, 0x18, 

/* Symbol 0xD3, offset 2660 */
    8, 14, 0,
    0xC3, 0xC3, 0xC3, 0xC3, 0xC3, 0xC3, 0xE3, 0x7F, 0x03, 0x03, 0x03, 0x03, 0x07, 0x7E, 

/* Symbol 0xD4, offset 2677 */
    12, 14, 0,
    0x06, 0x00, 0x06, 0x00, 0x3F, 0xC0, 0x66, 0x60, 0xC6, 0x30, 0xC6, 0x30, 0xC6, 0x30, 0xC6, 0x30, 0xC6, 0x30, 0x66, 0x60, 0x3F, 0xC0, 0x06, 0x00, 0x06, 0x00, 0x06, 0x00, 

/* Symbol 0xD5, offset 2708 */
    10, 14, 0,
    0xC0, 0xC0, 0x61, 0x80, 0x61, 0x80, 0x33, 0x00, 0x3F, 0x00, 0x1E, 0x00, 0x0C, 0x00, 0x0C, 0x00, 0x1E, 0x00, 0x3F, 0x00, 0x33, 0x00, 0x61, 0x80, 0x61, 0x80, 0xC0, 0xC0, 

/* Symbol 0xD6, offset 2739 */
    9, 16, 0,
    0xC3, 0x00, 0xC3, 0x00, 0xC3, 0x00, 0xC3, 0x00, 0xC3, 0x00, 0xC3, 0x00, 0xC3, 0x00, 0xC3, 0x00, 0xC3, 0x00, 0xC3, 0x00, 0xC3, 0x00, 0xC3, 0x00, 0xC3, 0x00, 0xFF, 0x80, 0x01, 0x80, 0x01, 0x80, 

/* Symbol 0xD7, offset 2774 */
    8, 14, 0,
    0xC3, 0xC3, 0xC3, 0xC3, 0xC3, 0xC3, 0xE3, 0x7F, 0x03, 0x03, 0x03, 0x03, 0x03, 0x03, 

/* Symbol 0xD8, offset 2791 */
    10, 14, 0,
    0xCC, 0xC0, 0xCC, 0xC0, 0xCC, 0xC0, 0xCC, 0xC0, 0xCC, 0xC0, 0xCC, 0xC0, 0xCC, 0xC0, 0xCC, 0xC0, 0xCC, 0xC0, 0xCC, 0xC0, 0xCC, 0xC0, 0xCC, 0xC0, 0xCC, 0xC0, 0xFF, 0xC0, 

/* Symbol 0xD9, offset 2822 */
    11, 16, 0,
    0xCC, 0xC0, 0xCC, 0xC0, 0xCC, 0xC0, 0xCC, 0xC0, 0xCC, 0xC0, 0xCC, 0xC0, 0xCC, 0xC0, 0xCC, 0xC0, 0xCC, 0xC0, 0xCC, 0xC0, 0xCC, 0xC0, 0xCC, 0xC0, 0xCC, 0xC0, 0xFF, 0xE0, 0x00, 0x60, 0x00, 0x60, 

/* Symbol 0xDA, offset 2857 */
    10, 14, 0,
    0xF0, 0x00, 0x30, 0x00, 0x30, 0x00, 0x30, 0x00, 0x30, 0x00, 0x30, 0x00, 0x3F, 0x80, 0x31, 0xC0, 0x30, 0xC0, 0x30, 0xC0, 0x30, 0xC0, 0x30, 0xC0, 0x31, 0xC0, 0x3F, 0x80, 

/* Symbol 0xDB, offset 2888 */
    9, 14, 0,
    0xC1, 0x80, 0xC1, 0x80, 0xC1, 0x80, 0xC1, 0x80, 0xC1, 0x80, 0xC1, 0x80, 0xFD, 0x80, 0xCF, 0x80, 0xC7, 0x80, 0xC7, 0x80, 0xC7, 0x80, 0xC7, 0x80, 0xC7, 0x80, 0xFD, 0x80, 

/* Symbol 0xDC, offset 2919 */
    8, 14, 0,
    0xC0, 0xC0, 0xC0, 0xC0, 0xC0, 0xC0, 0xFE, 0xC7, 0xC3, 0xC3, 0xC3, 0xC3, 0xC7, 0xFE, 

/* Symbol 0xDD, offset 2936 */
    8, 14, 0,
    0xFE, 0x07, 0x03, 0x03, 0x03, 0x03, 0x3F, 0x03, 0x03, 0x03, 0x03, 0x03, 0x07, 0xFE, 

/* Symbol 0xDE, offset 2953 */
    9, 14, 0,
    0xDF, 0x00, 0xFB, 0x80, 0xF1, 0x80, 0xF1, 0x80, 0xF1, 0x80, 0xF1, 0x80, 0xF1, 0x80, 0xF1, 0x80, 0xF1, 0x80, 0xF1, 0x80, 0xF1, 0x80, 0xF1, 0x80, 0xFB, 0x80, 0xDF, 0x00, 

/* Symbol 0xDF, offset 2984 */
    8, 14, 0,
    0x7F, 0xE3, 0xC3, 0xC3, 0xC3, 0xC3, 0xE3, 0x7F, 0x1B, 0x33, 0x33, 0x63, 0xE3, 0xC3, 

/* Symbol 0xE0, offset 3001 */
    8, 14, 4,
    0x7E, 0xC6, 0xC6, 0xC6, 0xC6, 0xC6, 0xC6, 0xC6, 0xC6, 0x7F, 

/* Symbol 0xE1, offset 3014 */
    7, 14, 0,
    0xFE, 0x60, 0x30, 0x18, 0x7C, 0xC6, 0xC6, 0xC6, 0xC6, 0xC6, 0xC6, 0xC6, 0xC6, 0x7C, 

/* Symbol 0xE2, offset 3031 */
    7, 14, 0,
    0x70, 0xD8, 0xD8, 0xF0, 0xFE, 0xC6, 0xC6, 0xC6, 0xC6, 0xC6, 0xC6, 0xC6, 0xC6, 0x7C, 

/* Symbol 0xE3, offset 3048 */
    7, 14, 4,
    0x7C, 0xC6, 0x06, 0x0C, 0x18, 0x30, 0x60, 0xC0, 0xC0, 0x7E, 

/* Symbol 0xE4, offset 3061 */
    7, 14, 0,
    0xFC, 0x06, 0x06, 0x06, 0x7E, 0xC6, 0xC6, 0xC6, 0xC6, 0xC6, 0xC6, 0xC6, 0xC6, 0x7C, 

/* Symbol 0xE5, offset 3078 */
    7, 14, 4,
    0x7C, 0xC6, 0xC6, 0xC6, 0xC6, 0xFE, 0xC0, 0xC0, 0xC0, 0x7E, 

/* Symbol 0xE6, offset 3091 */
    10, 14, 4,
    0xCC, 0xC0, 0x6D, 0xC0, 0x7D, 0x80, 0x3F, 0x00, 0x1F, 0x00, 0x1E, 0x00, 0x3F, 0x00, 0x6F, 0x80, 0x6D, 0x80, 0xCC, 0xC0, 

/* Symbol 0xE7, offset 3114 */
    7, 14, 4,
    0x7C, 0x66, 0x06, 0x06, 0x3C, 0x06, 0x06, 0x06, 0xC6, 0x7C, 

/* Symbol 0xE8, offset 3127 */
    7, 14, 4,
    0xC6, 0xC6, 0xC6, 0xC6, 0xC6, 0xC6, 0xC6, 0xC6, 0xC6, 0x7E, 

/* Symbol 0xE9, offset 3140 */
    8, 14, 0,
    0x3C, 0x00, 0x00, 0x00, 0xC3, 0xC3, 0xC3, 0xC3, 0xC3, 0xC3, 0xC3, 0xC3, 0xC3, 0x7F, 

/* Symbol 0xEA, offset 3157 */
    7, 14, 4,
    0xC6, 0xCC, 0xDC, 0xF8, 0xF0, 0xF8, 0xD8, 0xCC, 0xCE, 0xC6, 

/* Symbol 0xEB, offset 3170 */
    7, 14, 4,
    0x3E, 0x36, 0x36, 0x66, 0x66, 0x66, 0x66, 0xC6, 0xC6, 0xC6, 

/* Symbol 0xEC, offset 3183 */
    8, 14, 4,
    0xC3, 0xE7, 0xE7, 0xFF, 0xDB, 0xC3, 0xC3, 0xC3, 0xC3, 0xC3, 

/* Symbol 0xED, offset 3196 */
    7, 14, 4,
    0xC6, 0xC6, 0xC6, 0xC6, 0xFE, 0xC6, 0xC6, 0xC6, 0xC6, 0xC6, 

/* Symbol 0xEE, offset 3209 */
    7, 14, 4,
    0x7C, 0xC6, 0xC6, 0xC6, 0xC6, 0xC6, 0xC6, 0xC6, 0xC6, 0x7C, 

/* Symbol 0xEF, offset 3222 */
    7, 14, 4,
    0xFC, 0xC6, 0xC6, 0xC6, 0xC6, 0xC6, 0xC6, 0xC6, 0xC6, 0xC6, 

/* Symbol 0xF0, offset 3235 */
    7, 18, 4,
    0xFC, 0xC6, 0xC6, 0xC6, 0xC6, 0xC6, 0xC6, 0xC6, 0xC6, 0xFC, 0xC0, 0xC0, 0xC0, 0xC0, 

/* Symbol 0xF1, offset 3252 */
    7, 14, 4,
    0x7E, 0xC0, 0xC0, 0xC0, 0xC0, 0xC0, 0xC0, 0xC0, 0xC0, 0x7E, 

/* Symbol 0xF2, offset 3265 */
    10, 14, 4,
    0xFF, 0x80, 0xCC, 0xC0, 0xCC, 0xC0, 0xCC, 0xC0, 0xCC, 0xC0, 0xCC, 0xC0, 0xCC, 0xC0, 0xCC, 0xC0, 0xCC, 0xC0, 0xCC, 0xC0, 

/* Symbol 0xF3, offset 3288 */
    7, 18, 4,
    0xC6, 0xC6, 0xC6, 0xC6, 0xC6, 0xC6, 0xC6, 0xC6, 0xC6, 0x7E, 0x06, 0x06, 0x06, 0xFC, 

/* Symbol 0xF4, offset 3305 */
    10, 18, 2,
    0x0C, 0x00, 0x0C, 0x00, 0x7F, 0x80, 0xED, 0xC0, 0xCC, 0xC0, 0xCC, 0xC0, 0xCC, 0xC0, 0xCC, 0xC0, 0xCC, 0xC0, 0xCC, 0xC0, 0xED, 0xC0, 0x7F, 0x80, 0x0C, 0x00, 0x0C, 0x00, 0x0C, 0x00, 0x0C, 0x00, 

/* Symbol 0xF5, offset 3340 */
    7, 14, 4,
    0xC6, 0x66, 0x6C, 0x3C, 0x38, 0x38, 0x3C, 0x6C, 0x66, 0xC6, 

/* Symbol 0xF6, offset 3353 */
    8, 16, 4,
    0xC6, 0xC6, 0xC6, 0xC6, 0xC6, 0xC6, 0xC6, 0xC6, 0xC6, 0x7F, 0x03, 0x03, 

/* Symbol 0xF7, offset 3368 */
    7, 14, 4,
    0xC6, 0xC6, 0xC6, 0xC6, 0x7E, 0x06, 0x06, 0x06, 0x06, 0x06, 

/* Symbol 0xF8, offset 3381 */
    10, 14, 4,
    0xCC, 0xC0, 0xCC, 0xC0, 0xCC, 0xC0, 0xCC, 0xC0, 0xCC, 0xC0, 0xCC, 0xC0, 0xCC, 0xC0, 0xCC, 0xC0, 0xCC, 0xC0, 0x7F, 0xC0, 

/* Symbol 0xF9, offset 3404 */
    11, 16, 4,
    0xCC, 0xC0, 0xCC, 0xC0, 0xCC, 0xC0, 0xCC, 0xC0, 0xCC, 0xC0, 0xCC, 0xC0, 0xCC, 0xC0, 0xCC, 0xC0, 0xCC, 0xC0, 0x7F, 0xE0, 0x00, 0x60, 0x00, 0x60, 

/* Symbol 0xFA, offset 3431 */
    9, 14, 4,
    0xF0, 0x00, 0x30, 0x00, 0x30, 0x00, 0x30, 0x00, 0x3F, 0x00, 0x31, 0x80, 0x31, 0x80, 0x31, 0x80, 0x31, 0x80, 0x3F, 0x00, 

/* Symbol 0xFB, offset 3454 */
    8, 14, 4,
    0xC3, 0xC3, 0xC3, 0xC3, 0xFB, 0xCF, 0xCF, 0xCF, 0xCF, 0xFB, 

/* Symbol 0xFC, offset 3467 */
    7, 14, 4,
    0xC0, 0xC0, 0xC0, 0xC0, 0xFC, 0xC6, 0xC6, 0xC6, 0xC6, 0xFC, 

/* Symbol 0xFD, offset 3480 */
    7, 14, 4,
    0xFC, 0x06, 0x06, 0x06, 0x3E, 0x06, 0x06, 0x06, 0x06, 0xFC, 

/* Symbol 0xFE, offset 3493 */
    8, 14, 4,
    0xDE, 0xF3, 0xF3, 0xF3, 0xF3, 0xF3, 0xF3, 0xF3, 0xF3, 0xDE, 

/* Symbol 0xFF, offset 3506 */
    7, 14, 4,
    0x7E, 0xC6, 0xC6, 0xC6, 0x7E, 0x36, 0x76, 0x66, 0xE6, 0xC6
};
