/*
    FaceName - GOST type B
    PointSize - 18
    FontWeight - bold
    Style - normal
    Family - default
    Cell width - 30
    Cell height - 30
    Offset x - -2
    Offset y - -6
*/
const unsigned char fontGOSTB18B[5134] =
{
/* 0x00 */   0x00, 0x00,
/* 0x01 */   0x00, 0x00,
/* 0x02 */   0x00, 0x00,
/* 0x03 */   0x00, 0x00,
/* 0x04 */   0x00, 0x00,
/* 0x05 */   0x00, 0x00,
/* 0x06 */   0x00, 0x00,
/* 0x07 */   0x00, 0x00,
/* 0x08 */   0x00, 0x00,
/* 0x09 */   0x00, 0x00,
/* 0x0A */   0x00, 0x00,
/* 0x0B */   0x00, 0x00,
/* 0x0C */   0x00, 0x00,
/* 0x0D */   0x00, 0x00,
/* 0x0E */   0x00, 0x00,
/* 0x0F */   0x00, 0x00,
/* 0x10 */   0x00, 0x00,
/* 0x11 */   0x00, 0x00,
/* 0x12 */   0x00, 0x00,
/* 0x13 */   0x00, 0x00,
/* 0x14 */   0x00, 0x00,
/* 0x15 */   0x00, 0x00,
/* 0x16 */   0x00, 0x00,
/* 0x17 */   0x00, 0x00,
/* 0x18 */   0x00, 0x00,
/* 0x19 */   0x00, 0x00,
/* 0x1A */   0x00, 0x00,
/* 0x1B */   0x00, 0x00,
/* 0x1C */   0x00, 0x00,
/* 0x1D */   0x00, 0x00,
/* 0x1E */   0x00, 0x00,
/* 0x1F */   0x00, 0x00,
/* 0x20 */   0x00, 0x02,
/* 0x21 */   0x07, 0x02,
/* 0x22 */   0x1A, 0x02,
/* 0x23 */   0x22, 0x02,
/* 0x24 */   0x45, 0x02,
/* 0x25 */   0x6E, 0x02,
/* 0x26 */   0xA1, 0x02,
/* 0x27 */   0xC4, 0x02,
/* 0x28 */   0xCC, 0x02,
/* 0x29 */   0xE2, 0x02,
/* 0x2A */   0xF8, 0x02,
/* 0x2B */   0x01, 0x03,
/* 0x2C */   0x14, 0x03,
/* 0x2D */   0x1C, 0x03,
/* 0x2E */   0x23, 0x03,
/* 0x2F */   0x28, 0x03,
/* 0x30 */   0x51, 0x03,
/* 0x31 */   0x74, 0x03,
/* 0x32 */   0x87, 0x03,
/* 0x33 */   0xAA, 0x03,
/* 0x34 */   0xCD, 0x03,
/* 0x35 */   0xF0, 0x03,
/* 0x36 */   0x13, 0x04,
/* 0x37 */   0x36, 0x04,
/* 0x38 */   0x59, 0x04,
/* 0x39 */   0x7C, 0x04,
/* 0x3A */   0x9F, 0x04,
/* 0x3B */   0xAA, 0x04,
/* 0x3C */   0xB8, 0x04,
/* 0x3D */   0xCB, 0x04,
/* 0x3E */   0xDA, 0x04,
/* 0x3F */   0xED, 0x04,
/* 0x40 */   0x10, 0x05,
/* 0x41 */   0x43, 0x05,
/* 0x42 */   0x66, 0x05,
/* 0x43 */   0x89, 0x05,
/* 0x44 */   0xAC, 0x05,
/* 0x45 */   0xCF, 0x05,
/* 0x46 */   0xF2, 0x05,
/* 0x47 */   0x15, 0x06,
/* 0x48 */   0x38, 0x06,
/* 0x49 */   0x5B, 0x06,
/* 0x4A */   0x6E, 0x06,
/* 0x4B */   0x81, 0x06,
/* 0x4C */   0xA4, 0x06,
/* 0x4D */   0xC7, 0x06,
/* 0x4E */   0xEA, 0x06,
/* 0x4F */   0x0D, 0x07,
/* 0x50 */   0x30, 0x07,
/* 0x51 */   0x53, 0x07,
/* 0x52 */   0x76, 0x07,
/* 0x53 */   0x99, 0x07,
/* 0x54 */   0xBC, 0x07,
/* 0x55 */   0xDF, 0x07,
/* 0x56 */   0x02, 0x08,
/* 0x57 */   0x25, 0x08,
/* 0x58 */   0x48, 0x08,
/* 0x59 */   0x6B, 0x08,
/* 0x5A */   0x8E, 0x08,
/* 0x5B */   0xB1, 0x08,
/* 0x5C */   0xC6, 0x08,
/* 0x5D */   0xEF, 0x08,
/* 0x5E */   0x04, 0x09,
/* 0x5F */   0x0B, 0x09,
/* 0x60 */   0x12, 0x09,
/* 0x61 */   0x35, 0x09,
/* 0x62 */   0x4E, 0x09,
/* 0x63 */   0x71, 0x09,
/* 0x64 */   0x7F, 0x09,
/* 0x65 */   0xA2, 0x09,
/* 0x66 */   0xBB, 0x09,
/* 0x67 */   0xCE, 0x09,
/* 0x68 */   0xF1, 0x09,
/* 0x69 */   0x14, 0x0A,
/* 0x6A */   0x27, 0x0A,
/* 0x6B */   0x3F, 0x0A,
/* 0x6C */   0x62, 0x0A,
/* 0x6D */   0x75, 0x0A,
/* 0x6E */   0x8E, 0x0A,
/* 0x6F */   0xA7, 0x0A,
/* 0x70 */   0xC0, 0x0A,
/* 0x71 */   0xE3, 0x0A,
/* 0x72 */   0x06, 0x0B,
/* 0x73 */   0x14, 0x0B,
/* 0x74 */   0x2D, 0x0B,
/* 0x75 */   0x40, 0x0B,
/* 0x76 */   0x59, 0x0B,
/* 0x77 */   0x72, 0x0B,
/* 0x78 */   0x8B, 0x0B,
/* 0x79 */   0xA6, 0x0B,
/* 0x7A */   0xCB, 0x0B,
/* 0x7B */   0xE4, 0x0B,
/* 0x7C */   0xF9, 0x0B,
/* 0x7D */   0x0C, 0x0C,
/* 0x7E */   0x21, 0x0C,
/* 0x7F */   0x2A, 0x0C,
/* 0x80 */   0x00, 0x00,
/* 0x81 */   0x00, 0x00,
/* 0x82 */   0x00, 0x00,
/* 0x83 */   0x00, 0x00,
/* 0x84 */   0x00, 0x00,
/* 0x85 */   0x00, 0x00,
/* 0x86 */   0x00, 0x00,
/* 0x87 */   0x00, 0x00,
/* 0x88 */   0x00, 0x00,
/* 0x89 */   0x00, 0x00,
/* 0x8A */   0x00, 0x00,
/* 0x8B */   0x00, 0x00,
/* 0x8C */   0x00, 0x00,
/* 0x8D */   0x00, 0x00,
/* 0x8E */   0x00, 0x00,
/* 0x8F */   0x00, 0x00,
/* 0x90 */   0x00, 0x00,
/* 0x91 */   0x00, 0x00,
/* 0x92 */   0x00, 0x00,
/* 0x93 */   0x00, 0x00,
/* 0x94 */   0x00, 0x00,
/* 0x95 */   0x00, 0x00,
/* 0x96 */   0x00, 0x00,
/* 0x97 */   0x00, 0x00,
/* 0x98 */   0x00, 0x00,
/* 0x99 */   0x00, 0x00,
/* 0x9A */   0x00, 0x00,
/* 0x9B */   0x00, 0x00,
/* 0x9C */   0x00, 0x00,
/* 0x9D */   0x00, 0x00,
/* 0x9E */   0x00, 0x00,
/* 0x9F */   0x00, 0x00,
/* 0xA0 */   0x00, 0x00,
/* 0xA1 */   0x00, 0x00,
/* 0xA2 */   0x00, 0x00,
/* 0xA3 */   0x00, 0x00,
/* 0xA4 */   0x00, 0x00,
/* 0xA5 */   0x00, 0x00,
/* 0xA6 */   0x00, 0x00,
/* 0xA7 */   0x00, 0x00,
/* 0xA8 */   0x00, 0x00,
/* 0xA9 */   0x00, 0x00,
/* 0xAA */   0x00, 0x00,
/* 0xAB */   0x00, 0x00,
/* 0xAC */   0x00, 0x00,
/* 0xAD */   0x00, 0x00,
/* 0xAE */   0x00, 0x00,
/* 0xAF */   0x00, 0x00,
/* 0xB0 */   0x00, 0x00,
/* 0xB1 */   0x00, 0x00,
/* 0xB2 */   0x00, 0x00,
/* 0xB3 */   0x00, 0x00,
/* 0xB4 */   0x00, 0x00,
/* 0xB5 */   0x00, 0x00,
/* 0xB6 */   0x00, 0x00,
/* 0xB7 */   0x00, 0x00,
/* 0xB8 */   0x00, 0x00,
/* 0xB9 */   0x00, 0x00,
/* 0xBA */   0x00, 0x00,
/* 0xBB */   0x00, 0x00,
/* 0xBC */   0x00, 0x00,
/* 0xBD */   0x00, 0x00,
/* 0xBE */   0x00, 0x00,
/* 0xBF */   0x00, 0x00,
/* 0xC0 */   0x3C, 0x0C,
/* 0xC1 */   0x5F, 0x0C,
/* 0xC2 */   0x82, 0x0C,
/* 0xC3 */   0xA5, 0x0C,
/* 0xC4 */   0xC8, 0x0C,
/* 0xC5 */   0xEF, 0x0C,
/* 0xC6 */   0x12, 0x0D,
/* 0xC7 */   0x35, 0x0D,
/* 0xC8 */   0x58, 0x0D,
/* 0xC9 */   0x7B, 0x0D,
/* 0xCA */   0x9E, 0x0D,
/* 0xCB */   0xC1, 0x0D,
/* 0xCC */   0xE4, 0x0D,
/* 0xCD */   0x07, 0x0E,
/* 0xCE */   0x2A, 0x0E,
/* 0xCF */   0x4D, 0x0E,
/* 0xD0 */   0x70, 0x0E,
/* 0xD1 */   0x93, 0x0E,
/* 0xD2 */   0xB6, 0x0E,
/* 0xD3 */   0xD9, 0x0E,
/* 0xD4 */   0xFC, 0x0E,
/* 0xD5 */   0x1F, 0x0F,
/* 0xD6 */   0x42, 0x0F,
/* 0xD7 */   0x69, 0x0F,
/* 0xD8 */   0x8C, 0x0F,
/* 0xD9 */   0xAF, 0x0F,
/* 0xDA */   0xD6, 0x0F,
/* 0xDB */   0xF9, 0x0F,
/* 0xDC */   0x1C, 0x10,
/* 0xDD */   0x3F, 0x10,
/* 0xDE */   0x62, 0x10,
/* 0xDF */   0x85, 0x10,
/* 0xE0 */   0xA8, 0x10,
/* 0xE1 */   0xC1, 0x10,
/* 0xE2 */   0xE4, 0x10,
/* 0xE3 */   0x07, 0x11,
/* 0xE4 */   0x20, 0x11,
/* 0xE5 */   0x43, 0x11,
/* 0xE6 */   0x5C, 0x11,
/* 0xE7 */   0x77, 0x11,
/* 0xE8 */   0x85, 0x11,
/* 0xE9 */   0x9E, 0x11,
/* 0xEA */   0xC1, 0x11,
/* 0xEB */   0xDC, 0x11,
/* 0xEC */   0xF5, 0x11,
/* 0xED */   0x10, 0x12,
/* 0xEE */   0x29, 0x12,
/* 0xEF */   0x42, 0x12,
/* 0xF0 */   0x5B, 0x12,
/* 0xF1 */   0x7E, 0x12,
/* 0xF2 */   0x8C, 0x12,
/* 0xF3 */   0xA5, 0x12,
/* 0xF4 */   0xC8, 0x12,
/* 0xF5 */   0xF3, 0x12,
/* 0xF6 */   0x0E, 0x13,
/* 0xF7 */   0x29, 0x13,
/* 0xF8 */   0x42, 0x13,
/* 0xF9 */   0x5B, 0x13,
/* 0xFA */   0x78, 0x13,
/* 0xFB */   0x91, 0x13,
/* 0xFC */   0xAA, 0x13,
/* 0xFD */   0xC3, 0x13,
/* 0xFE */   0xDC, 0x13,
/* 0xFF */   0xF5, 0x13,

/* Symbol 0x20, offset 512 */
    30, 1, 0,
    0x00, 0x00, 0x00, 0x00, 

/* Symbol 0x21, offset 519 */
    2, 16, 0,
    0xC0, 0xC0, 0xC0, 0xC0, 0xC0, 0xC0, 0xC0, 0xC0, 0xC0, 0xC0, 0xC0, 0xC0, 0xC0, 0x00, 0xC0, 0xC0, 

/* Symbol 0x22, offset 538 */
    6, 5, 0,
    0xDC, 0xD8, 0xF8, 0xF8, 0xB0, 

/* Symbol 0x23, offset 546 */
    14, 16, 0,
    0x0E, 0x70, 0x0E, 0x70, 0x0E, 0x70, 0x0C, 0x60, 0x7F, 0xF8, 0x1C, 0xEC, 0x1C, 0xE0, 0x1C, 0xE0, 0x18, 0xC0, 0x39, 0xC0, 0xFF, 0xF0, 0xFF, 0xF0, 0x31, 0xC0, 0x31, 0x80, 0x73, 0x80, 0x73, 0x80, 

/* Symbol 0x24, offset 581 */
    11, 19, 0,
    0x7F, 0x80, 0xFF, 0xC0, 0xEC, 0x00, 0xCC, 0x00, 0xEC, 0x00, 0x7C, 0x00,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 0x00, 

/* Symbol 0x25, offset 622 */
    22, 16, 0,
    0x7E, 0x03, 0x80, 0xEF, 0x03, 0x00, 0xC7, 0x07, 0x00, 0xC3, 0x0E, 0x00,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 0xF0, 

/* Symbol 0x26, offset 673 */
    13, 16, 0,
    0x1F, 0x00, 0x3B, 0x80, 0x31, 0x80, 0x3B, 0x80, 0x3F, 0x80, 0x1E, 0x00, 0x1E, 0x00, 0x7E, 0x00, 0x77, 0x00, 0xE3, 0x80, 0xE3, 0x80, 0xC1, 0xF0, 0xE0, 0xF0, 0xE1, 0xE0, 0x7F, 0xF0, 0x3F, 0x38, 

/* Symbol 0x27, offset 708 */
    3, 5, 0,
    0xE0, 0xC0, 0xC0, 0xC0, 0x80, 

/* Symbol 0x28, offset 716 */
    5, 19, 0,
    0x30, 0x70, 0x70, 0xE0, 0xE0, 0xE0, 0xE0, 0xC0, 0xC0, 0xC0, 0xC0, 0xE0, 0xE0, 0xE0, 0x60, 0x70, 0x70, 0x38, 0x30, 

/* Symbol 0x29, offset 738 */
    5, 19, 0,
    0xE0, 0xE0, 0x70, 0x70, 0x70, 0x30, 0x30, 0x38, 0x38, 0x38, 0x30, 0x30, 0x70, 0x70, 0x70, 0x60, 0xE0, 0xC0, 0xC0, 

/* Symbol 0x2A, offset 760 */
    8, 6, 0,
    0x7E, 0x3C, 0xFF, 0xFF, 0x7E, 0x7E, 

/* Symbol 0x2B, offset 769 */
    9, 14, 6,
    0x18, 0x00, 0x1C, 0x00, 0x1C, 0x00, 0xFF, 0x00, 0xFF, 0x80, 0x1C, 0x00, 0x1C, 0x00, 0x1C, 0x00, 

/* Symbol 0x2C, offset 788 */
    2, 19, 14,
    0xC0, 0xC0, 0xC0, 0xC0, 0xC0, 

/* Symbol 0x2D, offset 796 */
    9, 11, 9,
    0xFF, 0x00, 0xFF, 0x80, 

/* Symbol 0x2E, offset 803 */
    2, 16, 14,
    0xC0, 0xC0, 

/* Symbol 0x2F, offset 808 */
    9, 19, 0,
    0x01, 0x80, 0x03, 0x80, 0x03, 0x80, 0x07, 0x00, 0x07, 0x00, 0x06, 0x00,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 0x00, 

/* Symbol 0x30, offset 849 */
    9, 16, 0,
    0x7F, 0x00, 0xE7, 0x00, 0xC3, 0x80, 0xC3, 0x80, 0xC3, 0x80, 0xC3, 0x80, 0xC3, 0x80, 0xC3, 0x80, 0xC3, 0x80, 0xC3, 0x80, 0xC3, 0x80, 0xC3, 0x80, 0xC3, 0x80, 0xE3, 0x80, 0xFF, 0x00, 0x7E, 0x00, 

/* Symbol 0x31, offset 884 */
    6, 16, 0,
    0x1C, 0x3C, 0x7C, 0xFC, 0xDC, 0x1C, 0x1C, 0x1C, 0x1C, 0x1C, 0x1C, 0x1C, 0x1C, 0x1C, 0x1C, 0x1C, 

/* Symbol 0x32, offset 903 */
    9, 16, 0,
    0x7E, 0x00, 0xE7, 0x00, 0xC3, 0x80, 0x03, 0x80, 0x03, 0x80, 0x03, 0x00, 0x07, 0x00, 0x0E, 0x00, 0x0E, 0x00, 0x1C, 0x00, 0x38, 0x00, 0x38, 0x00, 0x70, 0x00, 0x60, 0x00, 0xFF, 0x80, 0xFF, 0x80, 

/* Symbol 0x33, offset 938 */
    9, 16, 0,
    0xFE, 0x00, 0x07, 0x00, 0x03, 0x80, 0x03, 0x80, 0x03, 0x80, 0x07, 0x00, 0x7F, 0x00, 0x7F, 0x00, 0x07, 0x00, 0x03, 0x80, 0x03, 0x80, 0x03, 0x80, 0x03, 0x80, 0x03, 0x00, 0xFF, 0x00, 0xFE, 0x00, 

/* Symbol 0x34, offset 973 */
    10, 16, 0,
    0x1C, 0x00, 0x18, 0x00, 0x38, 0x00, 0x38, 0x00, 0x30, 0x00, 0x70, 0x00, 0x70, 0x00, 0x70, 0x00, 0x67, 0x00, 0xE7, 0x00, 0xE7, 0x00, 0xFF, 0xC0, 0xFF, 0xC0, 0x07, 0x00, 0x07, 0x00, 0x07, 0x00, 

/* Symbol 0x35, offset 1008 */
    9, 16, 0,
    0xFF, 0x80, 0xC0, 0x00, 0xC0, 0x00, 0xC0, 0x00, 0xC0, 0x00, 0xC0, 0x00, 0xFC, 0x00, 0xFF, 0x00, 0x03, 0x00, 0x03, 0x80, 0x03, 0x80, 0x03, 0x80, 0x03, 0x80, 0x03, 0x80, 0xFF, 0x00, 0xFE, 0x00, 

/* Symbol 0x36, offset 1043 */
    9, 16, 0,
    0x0E, 0x00, 0x3C, 0x00, 0x78, 0x00, 0x70, 0x00, 0xE0, 0x00, 0xE0, 0x00, 0xFE, 0x00, 0xFF, 0x00, 0xC3, 0x80, 0xC3, 0x80, 0xC3, 0x80, 0xC3, 0x80, 0xC3, 0x80, 0xC3, 0x80, 0xFF, 0x00, 0x7E, 0x00, 

/* Symbol 0x37, offset 1078 */
    9, 16, 0,
    0xFF, 0x80, 0xC3, 0x80, 0xC3, 0x00, 0x07, 0x00, 0x07, 0x00, 0x06, 0x00, 0x0E, 0x00, 0x0E, 0x00, 0x0E, 0x00, 0x0C, 0x00, 0x1C, 0x00, 0x1C, 0x00, 0x1C, 0x00, 0x18, 0x00, 0x38, 0x00, 0x38, 0x00, 

/* Symbol 0x38, offset 1113 */
    11, 16, 0,
    0x3F, 0x00, 0x73, 0x80, 0x61, 0xC0, 0xE1, 0xC0, 0x61, 0xC0, 0x73, 0x80, 0x7F, 0x80, 0x7F, 0x80, 0xE1, 0xC0, 0xE1, 0xC0, 0xC0, 0xC0, 0xC0, 0xE0, 0xE0, 0xC0, 0xE1, 0xC0, 0x7F, 0x80, 0x3F, 0x00, 

/* Symbol 0x39, offset 1148 */
    9, 16, 0,
    0x7F, 0x00, 0xE7, 0x80, 0xC3, 0x80, 0xC3, 0x80, 0xC3, 0x80, 0xC3, 0x80, 0xC3, 0x80, 0xE3, 0x80, 0x7F, 0x80, 0x03, 0x80, 0x03, 0x00, 0x07, 0x00, 0x0E, 0x00, 0x1E, 0x00, 0x3C, 0x00, 0x70, 0x00, 

/* Symbol 0x3A, offset 1183 */
    2, 16, 8,
    0xC0, 0x00, 0x00, 0x00, 0x00, 0x00, 0xC0, 0xC0, 

/* Symbol 0x3B, offset 1194 */
    2, 19, 8,
    0xC0, 0x00, 0x00, 0x00, 0x00, 0x00, 0xC0, 0xC0, 0xC0, 0xC0, 0xC0, 

/* Symbol 0x3C, offset 1208 */
    9, 14, 6,
    0x03, 0x80, 0x0F, 0x80, 0x3E, 0x00, 0xF8, 0x00, 0xF0, 0x00, 0x7C, 0x00, 0x1F, 0x00, 0x07, 0x80, 

/* Symbol 0x3D, offset 1227 */
    9, 13, 7,
    0xFF, 0x80, 0xFF, 0x00, 0x00, 0x00, 0x00, 0x00, 0xFF, 0x80, 0xFF, 0x80, 

/* Symbol 0x3E, offset 1242 */
    9, 14, 6,
    0xC0, 0x00, 0xF0, 0x00, 0x3C, 0x00, 0x0F, 0x00, 0x07, 0x80, 0x1E, 0x00, 0x78, 0x00, 0xE0, 0x00, 

/* Symbol 0x3F, offset 1261 */
    9, 16, 0,
    0x7E, 0x00, 0xE7, 0x00, 0xC3, 0x80, 0x03, 0x80, 0x03, 0x80, 0x07, 0x00, 0x0E, 0x00, 0x1C, 0x00, 0x1C, 0x00, 0x1C, 0x00, 0x1C, 0x00, 0x1C, 0x00, 0x18, 0x00, 0x00, 0x00, 0x18, 0x00, 0x1C, 0x00, 

/* Symbol 0x40, offset 1296 */
    17, 16, 0,
    0x0F, 0xF8, 0x00, 0x1E, 0x3C, 0x00, 0x38, 0x0E, 0x00, 0x70, 0x07, 0x00,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 0x00, 

/* Symbol 0x41, offset 1347 */
    12, 16, 0,
    0x06, 0x00, 0x0F, 0x00, 0x0F, 0x00, 0x0F, 0x00, 0x1F, 0x80, 0x1F, 0x80, 0x19, 0x80, 0x39, 0xC0, 0x39, 0xC0, 0x30, 0xC0, 0x7F, 0xE0, 0x7F, 0xE0, 0x60, 0x60, 0xE0, 0x70, 0xE0, 0x70, 0xC0, 0x30, 

/* Symbol 0x42, offset 1382 */
    10, 16, 0,
    0xFF, 0x80, 0xC3, 0x80, 0xC1, 0xC0, 0xC1, 0xC0, 0xC1, 0xC0, 0xC1, 0xC0, 0xFF, 0x80, 0xFF, 0xC0, 0xC0, 0xC0, 0xC0, 0xC0, 0xC0, 0xC0, 0xC0, 0xC0, 0xC0, 0xC0, 0xC0, 0xC0, 0xFF, 0xC0, 0xFF, 0x80, 

/* Symbol 0x43, offset 1417 */
    9, 16, 0,
    0x7F, 0x80, 0xE0, 0x00, 0xC0, 0x00, 0xC0, 0x00, 0xC0, 0x00, 0xC0, 0x00, 0xC0, 0x00, 0xC0, 0x00, 0xC0, 0x00, 0xC0, 0x00, 0xC0, 0x00, 0xC0, 0x00, 0xC0, 0x00, 0xC0, 0x00, 0xFF, 0x80, 0x7F, 0x80, 

/* Symbol 0x44, offset 1452 */
    10, 16, 0,
    0xFF, 0x80, 0xC1, 0xC0, 0xC0, 0xC0, 0xC0, 0xC0, 0xC0, 0xC0, 0xC0, 0xC0, 0xC0, 0xC0, 0xC0, 0xC0, 0xC0, 0xC0, 0xC0, 0xC0, 0xC0, 0xC0, 0xC0, 0xC0, 0xC0, 0xC0, 0xC0, 0xC0, 0xFF, 0xC0, 0xFF, 0x80, 

/* Symbol 0x45, offset 1487 */
    9, 16, 0,
    0xFF, 0x80, 0xC0, 0x00, 0xC0, 0x00, 0xC0, 0x00, 0xC0, 0x00, 0xC0, 0x00, 0xFE, 0x00, 0xFE, 0x00, 0xC0, 0x00, 0xC0, 0x00, 0xC0, 0x00, 0xC0, 0x00, 0xC0, 0x00, 0xC0, 0x00, 0xFF, 0x80, 0xFF, 0x80, 

/* Symbol 0x46, offset 1522 */
    9, 16, 0,
    0xFF, 0x80, 0xC0, 0x00, 0xC0, 0x00, 0xC0, 0x00, 0xC0, 0x00, 0xC0, 0x00, 0xFF, 0x80, 0xFF, 0x80, 0xC0, 0x00, 0xC0, 0x00, 0xC0, 0x00, 0xC0, 0x00, 0xC0, 0x00, 0xC0, 0x00, 0xC0, 0x00, 0xC0, 0x00, 

/* Symbol 0x47, offset 1557 */
    10, 16, 0,
    0x7F, 0xC0, 0xE0, 0x00, 0xC0, 0x00, 0xC0, 0x00, 0xC0, 0x00, 0xC0, 0x00, 0xC3, 0xC0, 0xC3, 0xC0, 0xC0, 0xC0, 0xC0, 0xC0, 0xC0, 0xC0, 0xC0, 0xC0, 0xC0, 0xC0, 0xC0, 0xC0, 0xFF, 0xC0, 0x7F, 0xC0, 

/* Symbol 0x48, offset 1592 */
    10, 16, 0,
    0xC0, 0xC0, 0xC0, 0xC0, 0xC0, 0xC0, 0xC0, 0xC0, 0xC0, 0xC0, 0xC0, 0xC0, 0xFF, 0xC0, 0xFF, 0xC0, 0xC0, 0xC0, 0xC0, 0xC0, 0xC0, 0xC0, 0xC0, 0xC0, 0xC0, 0xC0, 0xC0, 0xC0, 0xC0, 0xC0, 0xC0, 0xC0, 

/* Symbol 0x49, offset 1627 */
    2, 16, 0,
    0xC0, 0xC0, 0xC0, 0xC0, 0xC0, 0xC0, 0xC0, 0xC0, 0xC0, 0xC0, 0xC0, 0xC0, 0xC0, 0xC0, 0xC0, 0xC0, 

/* Symbol 0x4A, offset 1646 */
    7, 16, 0,
    0x06, 0x06, 0x06, 0x06, 0x06, 0x06, 0x06, 0x06, 0x06, 0x06, 0x06, 0x06, 0x06, 0x0E, 0xFE, 0xFC, 

/* Symbol 0x4B, offset 1665 */
    11, 16, 0,
    0xC0, 0xE0, 0xC1, 0xC0, 0xC7, 0x80, 0xCF, 0x00, 0xDE, 0x00, 0xFC, 0x00, 0xFC, 0x00, 0xFC, 0x00, 0xEE, 0x00, 0xC6, 0x00, 0xC7, 0x00, 0xC3, 0x80, 0xC3, 0x80, 0xC1, 0xC0, 0xC1, 0xC0, 0xC0, 0xE0, 

/* Symbol 0x4C, offset 1700 */
    9, 16, 0,
    0xC0, 0x00, 0xC0, 0x00, 0xC0, 0x00, 0xC0, 0x00, 0xC0, 0x00, 0xC0, 0x00, 0xC0, 0x00, 0xC0, 0x00, 0xC0, 0x00, 0xC0, 0x00, 0xC0, 0x00, 0xC0, 0x00, 0xC0, 0x00, 0xC0, 0x00, 0xFF, 0x80, 0xFF, 0x80, 

/* Symbol 0x4D, offset 1735 */
    12, 16, 0,
    0xC0, 0x70, 0xE0, 0x70, 0xF0, 0xF0, 0xF0, 0xF0, 0xF9, 0xF0, 0xDB, 0xB0, 0xDF, 0xB0, 0xCF, 0x30, 0xCE, 0x30, 0xC6, 0x30, 0xC0, 0x30, 0xC0, 0x30, 0xC0, 0x30, 0xC0, 0x30, 0xC0, 0x30, 0xC0, 0x30, 

/* Symbol 0x4E, offset 1770 */
    10, 16, 0,
    0xC0, 0xC0, 0xE0, 0xC0, 0xF0, 0xC0, 0xF0, 0xC0, 0xF8, 0xC0, 0xF8, 0xC0, 0xDC, 0xC0, 0xDC, 0xC0, 0xCE, 0xC0, 0xC6, 0xC0, 0xC7, 0xC0, 0xC3, 0xC0, 0xC3, 0xC0, 0xC1, 0xC0, 0xC1, 0xC0, 0xC0, 0xC0, 

/* Symbol 0x4F, offset 1805 */
    10, 16, 0,
    0x7F, 0x80, 0xE1, 0xC0, 0xC0, 0xC0, 0xC0, 0xC0, 0xC0, 0xC0, 0xC0, 0xC0, 0xC0, 0xC0, 0xC0, 0xC0, 0xC0, 0xC0, 0xC0, 0xC0, 0xC0, 0xC0, 0xC0, 0xC0, 0xC0, 0xC0, 0xC0, 0xC0, 0xFF, 0xC0, 0x7F, 0x80, 

/* Symbol 0x50, offset 1840 */
    10, 16, 0,
    0xFF, 0x80, 0xC1, 0xC0, 0xC0, 0xC0, 0xC0, 0xC0, 0xC0, 0xC0, 0xC0, 0xC0, 0xC0, 0xC0, 0xC1, 0xC0, 0xFF, 0xC0, 0xC0, 0x00, 0xC0, 0x00, 0xC0, 0x00, 0xC0, 0x00, 0xC0, 0x00, 0xC0, 0x00, 0xC0, 0x00, 

/* Symbol 0x51, offset 1875 */
    12, 16, 0,
    0x7F, 0x80, 0xE1, 0xC0, 0xC0, 0xC0, 0xC0, 0xC0, 0xC0, 0xC0, 0xC0, 0xC0, 0xC0, 0xC0, 0xC0, 0xC0, 0xC0, 0xC0, 0xC0, 0xC0, 0xC0, 0xC0, 0xC6, 0xC0, 0xC7, 0xC0, 0xC3, 0xC0, 0xFF, 0xF0, 0x7F, 0xF0, 

/* Symbol 0x52, offset 1910 */
    10, 16, 0,
    0xFF, 0x80, 0xC1, 0xC0, 0xC0, 0xC0, 0xC0, 0xC0, 0xC0, 0xC0, 0xC0, 0xC0, 0xC0, 0xC0, 0xC1, 0xC0, 0xFF, 0xC0, 0xCE, 0x00, 0xC7, 0x00, 0xC7, 0x00, 0xC3, 0x80, 0xC1, 0xC0, 0xC1, 0xC0, 0xC0, 0xC0, 

/* Symbol 0x53, offset 1945 */
    11, 16, 0,
    0x7F, 0x80, 0xF3, 0xC0, 0xE0, 0x00, 0xC0, 0x00, 0xE0, 0x00, 0x78, 0x00, 0x3C, 0x00, 0x0E, 0x00, 0x07, 0x80, 0x03, 0xC0, 0x01, 0xC0, 0x00, 0xE0, 0x00, 0xE0, 0xC1, 0xC0, 0xFF, 0xC0, 0x3F, 0x00, 

/* Symbol 0x54, offset 1980 */
    10, 16, 0,
    0xFF, 0xC0, 0x0C, 0x00, 0x0C, 0x00, 0x0C, 0x00, 0x0C, 0x00, 0x0C, 0x00, 0x0C, 0x00, 0x0C, 0x00, 0x0C, 0x00, 0x0C, 0x00, 0x0C, 0x00, 0x0C, 0x00, 0x0C, 0x00, 0x0C, 0x00, 0x0C, 0x00, 0x0C, 0x00, 

/* Symbol 0x55, offset 2015 */
    10, 16, 0,
    0xC0, 0xC0, 0xC0, 0xC0, 0xC0, 0xC0, 0xC0, 0xC0, 0xC0, 0xC0, 0xC0, 0xC0, 0xC0, 0xC0, 0xC0, 0xC0, 0xC0, 0xC0, 0xC0, 0xC0, 0xC0, 0xC0, 0xC0, 0xC0, 0xC0, 0xC0, 0xC0, 0xC0, 0xFF, 0xC0, 0x7F, 0x80, 

/* Symbol 0x56, offset 2050 */
    12, 16, 0,
    0xC0, 0x70, 0xE0, 0x70, 0xE0, 0x60, 0x60, 0xE0, 0x70, 0xE0, 0x70, 0xC0, 0x31, 0xC0, 0x39, 0xC0, 0x39, 0x80, 0x1B, 0x80, 0x1F, 0x80, 0x1F, 0x00, 0x0F, 0x00, 0x0F, 0x00, 0x0E, 0x00, 0x06, 0x00, 

/* Symbol 0x57, offset 2085 */
    15, 16, 0,
    0xC0, 0x06, 0xE0, 0x0E, 0xE0, 0x0E, 0xE0, 0x0E, 0x60, 0x0E, 0x63, 0x8C, 0x73, 0x9C, 0x73, 0x9C, 0x77, 0xDC, 0x37, 0xD8, 0x3E, 0xF8, 0x3E, 0xF8, 0x3E, 0xF8, 0x1C, 0x78, 0x1C, 0x70, 0x18, 0x30, 

/* Symbol 0x58, offset 2120 */
    12, 16, 0,
    0xC0, 0x70, 0xE0, 0x70, 0x70, 0xE0, 0x39, 0xC0, 0x39, 0xC0, 0x1F, 0x80, 0x0F, 0x00, 0x0F, 0x00, 0x0F, 0x00, 0x1F, 0x80, 0x1F, 0x80, 0x39, 0xC0, 0x70, 0xC0, 0x70, 0xE0, 0xE0, 0x70, 0xC0, 0x30, 

/* Symbol 0x59, offset 2155 */
    12, 16, 0,
    0xE0, 0x70, 0xE0, 0x70, 0x70, 0xE0, 0x39, 0xC0, 0x39, 0xC0, 0x1F, 0x80, 0x0F, 0x00, 0x0E, 0x00, 0x06, 0x00, 0x06, 0x00, 0x06, 0x00, 0x06, 0x00, 0x06, 0x00, 0x06, 0x00, 0x06, 0x00, 0x06, 0x00, 

/* Symbol 0x5A, offset 2190 */
    12, 16, 0,
    0xFF, 0xF0, 0x00, 0x70, 0x00, 0xE0, 0x01, 0xC0, 0x01, 0xC0, 0x03, 0x80, 0x07, 0x00, 0x07, 0x00, 0x0E, 0x00, 0x1C, 0x00, 0x1C, 0x00, 0x38, 0x00, 0x70, 0x00, 0x70, 0x00, 0xFF, 0xF0, 0xFF, 0xF0, 

/* Symbol 0x5B, offset 2225 */
    4, 18, 0,
    0xC0, 0xC0, 0xC0, 0xC0, 0xC0, 0xC0, 0xC0, 0xC0, 0xC0, 0xC0, 0xC0, 0xC0, 0xC0, 0xC0, 0xC0, 0xC0, 0xF0, 0xF0, 

/* Symbol 0x5C, offset 2246 */
    9, 19, 0,
    0xC0, 0x00, 0xE0, 0x00, 0xE0, 0x00, 0x70, 0x00, 0x70, 0x00, 0x70, 0x00,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 0x80, 

/* Symbol 0x5D, offset 2287 */
    4, 18, 0,
    0x70, 0x70, 0x70, 0x70, 0x70, 0x70, 0x70, 0x70, 0x70, 0x70, 0x70, 0x70, 0x70, 0x70, 0x70, 0x70, 0xF0, 0xE0, 

/* Symbol 0x5E, offset 2308 */
    30, 1, 0,
    0x00, 0x00, 0x00, 0x00, 

/* Symbol 0x5F, offset 2315 */
    9, 19, 17,
    0xFF, 0x80, 0xFF, 0x80, 

/* Symbol 0x60, offset 2322 */
    10, 16, 0,
    0x80, 0xC0, 0x80, 0xC0, 0x80, 0xC0, 0x80, 0xC0, 0x80, 0xC0, 0x80, 0xC0, 0x80, 0xC0, 0x80, 0xC0, 0x80, 0xC0, 0x80, 0xC0, 0x80, 0xC0, 0x80, 0xC0, 0x80, 0xC0, 0x80, 0xC0, 0x80, 0xC0, 0xFF, 0xC0, 

/* Symbol 0x61, offset 2357 */
    11, 16, 5,
    0x7F, 0x80, 0xE3, 0x80, 0xC3, 0x80, 0xC3, 0x80, 0xC3, 0x80, 0xC3, 0x80, 0xC3, 0x80, 0xC3, 0x80, 0xC3, 0x80, 0xFF, 0xC0, 0x7E, 0xE0, 

/* Symbol 0x62, offset 2382 */
    9, 16, 0,
    0xC0, 0x00, 0xC0, 0x00, 0xC0, 0x00, 0xC0, 0x00, 0xC0, 0x00, 0xFF, 0x00, 0xC3, 0x80, 0xC3, 0x80, 0xC3, 0x80, 0xC3, 0x80, 0xC3, 0x80, 0xC3, 0x80, 0xC3, 0x80, 0xC3, 0x80, 0xFF, 0x00, 0xFE, 0x00, 

/* Symbol 0x63, offset 2417 */
    7, 16, 5,
    0x7E, 0xE0, 0xC0, 0xC0, 0xC0, 0xC0, 0xC0, 0xC0, 0xC0, 0xFE, 0x7E, 

/* Symbol 0x64, offset 2431 */
    9, 16, 0,
    0x03, 0x80, 0x03, 0x80, 0x03, 0x80, 0x03, 0x80, 0x03, 0x80, 0x7F, 0x80, 0xE3, 0x80, 0xC3, 0x80, 0xC3, 0x80, 0xC3, 0x80, 0xC3, 0x80, 0xC3, 0x80, 0xC3, 0x80, 0xC3, 0x80, 0xFF, 0x80, 0x7F, 0x80, 

/* Symbol 0x65, offset 2466 */
    9, 16, 5,
    0x7F, 0x00, 0xE3, 0x80, 0xC3, 0x80, 0xC3, 0x80, 0xFF, 0x80, 0xFF, 0x80, 0xC0, 0x00, 0xC0, 0x00, 0xC0, 0x00, 0xFF, 0x80, 0x7F, 0x80, 

/* Symbol 0x66, offset 2491 */
    6, 16, 0,
    0x7C, 0x70, 0xE0, 0xE0, 0xE0, 0xFC, 0xE0, 0xE0, 0xE0, 0xE0, 0xE0, 0xE0, 0xE0, 0xE0, 0xE0, 0x60, 

/* Symbol 0x67, offset 2510 */
    9, 21, 5,
    0x7F, 0x80, 0xE3, 0x80, 0xC3, 0x80, 0xC3, 0x80, 0xC3, 0x80, 0xC3, 0x80, 0xC3, 0x80, 0xC3, 0x80, 0xC3, 0x80, 0xFF, 0x80, 0x7F, 0x80, 0x03, 0x80, 0x03, 0x80, 0x03, 0x80, 0x7F, 0x00, 0xFE, 0x00, 

/* Symbol 0x68, offset 2545 */
    9, 16, 0,
    0xC0, 0x00, 0xC0, 0x00, 0xC0, 0x00, 0xC0, 0x00, 0xC0, 0x00, 0xFF, 0x00, 0xC3, 0x80, 0xC3, 0x80, 0xC3, 0x80, 0xC3, 0x80, 0xC3, 0x80, 0xC3, 0x80, 0xC3, 0x80, 0xC3, 0x80, 0xC3, 0x80, 0xC3, 0x80, 

/* Symbol 0x69, offset 2580 */
    2, 16, 0,
    0xC0, 0x00, 0x00, 0x00, 0x00, 0xC0, 0xC0, 0xC0, 0xC0, 0xC0, 0xC0, 0xC0, 0xC0, 0xC0, 0xC0, 0xC0, 

/* Symbol 0x6A, offset 2599 */
    2, 21, 0,
    0xC0, 0x00, 0x00, 0x00, 0x00, 0xC0, 0xC0, 0xC0, 0xC0, 0xC0, 0xC0, 0xC0, 0xC0, 0xC0, 0xC0, 0xC0, 0xC0, 0xC0, 0xC0, 0xC0, 0x80, 

/* Symbol 0x6B, offset 2623 */
    9, 16, 0,
    0xC0, 0x00, 0xC0, 0x00, 0xC0, 0x00, 0xC0, 0x00, 0xC3, 0x00, 0xC7, 0x80, 0xCF, 0x00, 0xDE, 0x00, 0xF8, 0x00, 0xF8, 0x00, 0xF8, 0x00, 0xDC, 0x00, 0xCE, 0x00, 0xC7, 0x00, 0xC7, 0x80, 0xC3, 0x80, 

/* Symbol 0x6C, offset 2658 */
    4, 16, 0,
    0xC0, 0xC0, 0xC0, 0xC0, 0xC0, 0xC0, 0xC0, 0xC0, 0xC0, 0xC0, 0xC0, 0xC0, 0xC0, 0xC0, 0xF0, 0x70, 

/* Symbol 0x6D, offset 2677 */
    12, 16, 5,
    0xFF, 0xE0, 0xC6, 0x70, 0xC6, 0x70, 0xC6, 0x70, 0xC6, 0x70, 0xC6, 0x70, 0xC6, 0x70, 0xC6, 0x70, 0xC6, 0x70, 0xC6, 0x70, 0xC6, 0x30, 

/* Symbol 0x6E, offset 2702 */
    9, 16, 5,
    0xFF, 0x00, 0xC3, 0x80, 0xC3, 0x80, 0xC3, 0x80, 0xC3, 0x80, 0xC3, 0x80, 0xC3, 0x80, 0xC3, 0x80, 0xC3, 0x80, 0xC3, 0x80, 0xC3, 0x80, 

/* Symbol 0x6F, offset 2727 */
    9, 16, 5,
    0x7F, 0x00, 0xE7, 0x00, 0xC3, 0x80, 0xC3, 0x80, 0xC3, 0x80, 0xC3, 0x80, 0xC3, 0x80, 0xC3, 0x80, 0xE3, 0x80, 0xFF, 0x00, 0x7E, 0x00, 

/* Symbol 0x70, offset 2752 */
    9, 21, 5,
    0xFF, 0x00, 0xC3, 0x80, 0xC3, 0x80, 0xC3, 0x80, 0xC3, 0x80, 0xC3, 0x80, 0xC3, 0x80, 0xC3, 0x80, 0xC3, 0x80, 0xFF, 0x00, 0xFE, 0x00, 0xC0, 0x00, 0xC0, 0x00, 0xC0, 0x00, 0xC0, 0x00, 0xC0, 0x00, 

/* Symbol 0x71, offset 2787 */
    9, 21, 5,
    0x7F, 0x80, 0xE3, 0x80, 0xC3, 0x80, 0xC3, 0x80, 0xC3, 0x80, 0xC3, 0x80, 0xC3, 0x80, 0xC3, 0x80, 0xC3, 0x80, 0xFF, 0x80, 0x7F, 0x80, 0x03, 0x80, 0x03, 0x80, 0x03, 0x80, 0x03, 0x80, 0x03, 0x80, 

/* Symbol 0x72, offset 2822 */
    7, 16, 5,
    0xFE, 0xCE, 0xC6, 0xC0, 0xC0, 0xC0, 0xC0, 0xC0, 0xC0, 0xC0, 0xC0, 

/* Symbol 0x73, offset 2836 */
    9, 16, 5,
    0x7F, 0x00, 0xE3, 0x80, 0xC0, 0x00, 0xF0, 0x00, 0x78, 0x00, 0x1E, 0x00, 0x0F, 0x00, 0x03, 0x80, 0x03, 0x80, 0xFF, 0x00, 0x7E, 0x00, 

/* Symbol 0x74, offset 2861 */
    7, 16, 0,
    0x70, 0x70, 0x70, 0x70, 0x70, 0xFE, 0x70, 0x70, 0x70, 0x70, 0x70, 0x70, 0x70, 0x70, 0x70, 0x70, 

/* Symbol 0x75, offset 2880 */
    9, 16, 5,
    0xC3, 0x80, 0xC3, 0x80, 0xC3, 0x80, 0xC3, 0x80, 0xC3, 0x80, 0xC3, 0x80, 0xC3, 0x80, 0xC3, 0x80, 0xC3, 0x80, 0xFF, 0x80, 0x7F, 0x80, 

/* Symbol 0x76, offset 2905 */
    9, 16, 5,
    0xC3, 0x80, 0xE3, 0x00, 0xE7, 0x00, 0x67, 0x00, 0x76, 0x00, 0x7E, 0x00, 0x3E, 0x00, 0x3C, 0x00, 0x3C, 0x00, 0x1C, 0x00, 0x18, 0x00, 

/* Symbol 0x77, offset 2930 */
    12, 16, 5,
    0xC0, 0x70, 0xE0, 0x70, 0xE0, 0x70, 0xE6, 0x60, 0x6F, 0xE0, 0x7F, 0xE0, 0x7F, 0xE0, 0x7F, 0xC0, 0x3B, 0xC0, 0x39, 0xC0, 0x39, 0xC0, 

/* Symbol 0x78, offset 2955 */
    9, 16, 4,
    0x03, 0x00, 0xE3, 0x80, 0xE7, 0x00, 0x77, 0x00, 0x3E, 0x00, 0x3C, 0x00, 0x1C, 0x00, 0x3E, 0x00, 0x7E, 0x00, 0x77, 0x00, 0xE3, 0x80, 0xC3, 0x80, 

/* Symbol 0x79, offset 2982 */
    9, 21, 4,
    0x83, 0x00, 0xC3, 0x80, 0xE3, 0x00, 0xE7, 0x00, 0xE7, 0x00, 0x66, 0x00,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 0x00, 

/* Symbol 0x7A, offset 3019 */
    9, 16, 5,
    0xFF, 0x80, 0x07, 0x00, 0x07, 0x00, 0x0E, 0x00, 0x1C, 0x00, 0x1C, 0x00, 0x38, 0x00, 0x70, 0x00, 0x70, 0x00, 0xFF, 0x80, 0xFF, 0x80, 

/* Symbol 0x7B, offset 3044 */
    6, 18, 0,
    0x70, 0x70, 0x70, 0x70, 0x70, 0x70, 0x70, 0xF0, 0xF0, 0x70, 0x70, 0x70, 0x70, 0x70, 0x70, 0x70, 0x3C, 0x18, 

/* Symbol 0x7C, offset 3065 */
    6, 16, 0,
    0xCC, 0xCC, 0xCC, 0xCC, 0xCC, 0xCC, 0xCC, 0xCC, 0xCC, 0xCC, 0xCC, 0xCC, 0xCC, 0xCC, 0xCC, 0xCC, 

/* Symbol 0x7D, offset 3084 */
    6, 18, 0,
    0x70, 0x70, 0x70, 0x70, 0x70, 0x70, 0x70, 0x3C, 0x78, 0x70, 0x70, 0x70, 0x70, 0x70, 0x70, 0x70, 0xF0, 0xC0, 

/* Symbol 0x7E, offset 3105 */
    10, 12, 9,
    0xFC, 0xC0, 0xCF, 0xC0, 0x07, 0x80, 

/* Symbol 0x7F, offset 3114 */
    5, 15, 0,
    0x98, 0x98, 0x98, 0x98, 0x98, 0x98, 0x98, 0x98, 0x98, 0x98, 0x98, 0x98, 0x98, 0x98, 0xF8, 

/* Symbol 0xC0, offset 3132 */
    12, 16, 0,
    0x06, 0x00, 0x0F, 0x00, 0x0F, 0x00, 0x0F, 0x00, 0x1F, 0x80, 0x1F, 0x80, 0x19, 0x80, 0x39, 0xC0, 0x39, 0xC0, 0x30, 0xC0, 0x7F, 0xE0, 0x7F, 0xE0, 0x60, 0x60, 0xE0, 0x70, 0xE0, 0x70, 0xC0, 0x30, 

/* Symbol 0xC1, offset 3167 */
    10, 16, 0,
    0xFF, 0x80, 0xC0, 0x00, 0xC0, 0x00, 0xC0, 0x00, 0xC0, 0x00, 0xC0, 0x00, 0xFF, 0x80, 0xFF, 0xC0, 0xC0, 0xC0, 0xC0, 0xC0, 0xC0, 0xC0, 0xC0, 0xC0, 0xC0, 0xC0, 0xC0, 0xC0, 0xFF, 0xC0, 0xFF, 0x80, 

/* Symbol 0xC2, offset 3202 */
    10, 16, 0,
    0xFF, 0x80, 0xC3, 0x80, 0xC1, 0xC0, 0xC1, 0xC0, 0xC1, 0xC0, 0xC1, 0xC0, 0xFF, 0x80, 0xFF, 0xC0, 0xC0, 0xC0, 0xC0, 0xC0, 0xC0, 0xC0, 0xC0, 0xC0, 0xC0, 0xC0, 0xC0, 0xC0, 0xFF, 0xC0, 0xFF, 0x80, 

/* Symbol 0xC3, offset 3237 */
    9, 16, 0,
    0xFF, 0x80, 0xC0, 0x00, 0xC0, 0x00, 0xC0, 0x00, 0xC0, 0x00, 0xC0, 0x00, 0xC0, 0x00, 0xC0, 0x00, 0xC0, 0x00, 0xC0, 0x00, 0xC0, 0x00, 0xC0, 0x00, 0xC0, 0x00, 0xC0, 0x00, 0xC0, 0x00, 0xC0, 0x00, 

/* Symbol 0xC4, offset 3272 */
    12, 18, 0,
    0x1F, 0xC0, 0x18, 0xC0, 0x18, 0xC0, 0x18, 0xC0, 0x38, 0xC0, 0x38, 0xC0,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 0x30, 

/* Symbol 0xC5, offset 3311 */
    9, 16, 0,
    0xFF, 0x80, 0xC0, 0x00, 0xC0, 0x00, 0xC0, 0x00, 0xC0, 0x00, 0xC0, 0x00, 0xFE, 0x00, 0xFE, 0x00, 0xC0, 0x00, 0xC0, 0x00, 0xC0, 0x00, 0xC0, 0x00, 0xC0, 0x00, 0xC0, 0x00, 0xFF, 0x80, 0xFF, 0x80, 

/* Symbol 0xC6, offset 3346 */
    14, 16, 0,
    0xE7, 0x1C, 0xE7, 0x38, 0x77, 0x70, 0x3F, 0x70, 0x3F, 0xE0, 0x1F, 0xC0, 0x0F, 0xC0, 0x0F, 0xC0, 0x1F, 0xC0, 0x1F, 0xE0, 0x3F, 0xE0, 0x37, 0x70, 0x77, 0x30, 0xE7, 0x38, 0xE7, 0x18, 0xC7, 0x1C, 

/* Symbol 0xC7, offset 3381 */
    9, 16, 0,
    0x7F, 0x00, 0xE7, 0x80, 0xC3, 0x80, 0x03, 0x80, 0x03, 0x80, 0x03, 0x80, 0x7F, 0x00, 0x7F, 0x00, 0x03, 0x80, 0x03, 0x80, 0x03, 0x80, 0x03, 0x80, 0x03, 0x80, 0xC3, 0x80, 0xFF, 0x00, 0x7E, 0x00, 

/* Symbol 0xC8, offset 3416 */
    10, 16, 0,
    0xC0, 0xC0, 0xC1, 0xC0, 0xC1, 0xC0, 0xC3, 0xC0, 0xC7, 0xC0, 0xC7, 0xC0, 0xCE, 0xC0, 0xCE, 0xC0, 0xDC, 0xC0, 0xDC, 0xC0, 0xF8, 0xC0, 0xF0, 0xC0, 0xF0, 0xC0, 0xE0, 0xC0, 0xE0, 0xC0, 0xC0, 0xC0, 

/* Symbol 0xC9, offset 3451 */
    10, 16, 0,
    0xC0, 0xC0, 0xC1, 0xC0, 0xC1, 0xC0, 0xC3, 0xC0, 0xC7, 0xC0, 0xC7, 0xC0, 0xCE, 0xC0, 0xCE, 0xC0, 0xDC, 0xC0, 0xDC, 0xC0, 0xF8, 0xC0, 0xF0, 0xC0, 0xF0, 0xC0, 0xE0, 0xC0, 0xE0, 0xC0, 0xC0, 0xC0, 

/* Symbol 0xCA, offset 3486 */
    11, 16, 0,
    0xC0, 0xE0, 0xC1, 0xC0, 0xC7, 0x80, 0xCF, 0x00, 0xDE, 0x00, 0xFC, 0x00, 0xFC, 0x00, 0xFC, 0x00, 0xEE, 0x00, 0xC6, 0x00, 0xC7, 0x00, 0xC3, 0x80, 0xC3, 0x80, 0xC1, 0xC0, 0xC1, 0xC0, 0xC0, 0xE0, 

/* Symbol 0xCB, offset 3521 */
    10, 16, 0,
    0x0F, 0xC0, 0x1C, 0xC0, 0x1C, 0xC0, 0x1C, 0xC0, 0x18, 0xC0, 0x38, 0xC0, 0x38, 0xC0, 0x30, 0xC0, 0x70, 0xC0, 0x70, 0xC0, 0x70, 0xC0, 0x60, 0xC0, 0xE0, 0xC0, 0xE0, 0xC0, 0xC0, 0xC0, 0xC0, 0xC0, 

/* Symbol 0xCC, offset 3556 */
    12, 16, 0,
    0xC0, 0x70, 0xE0, 0x70, 0xF0, 0xF0, 0xF0, 0xF0, 0xF9, 0xF0, 0xDB, 0xB0, 0xDF, 0xB0, 0xCF, 0x30, 0xCE, 0x30, 0xC6, 0x30, 0xC0, 0x30, 0xC0, 0x30, 0xC0, 0x30, 0xC0, 0x30, 0xC0, 0x30, 0xC0, 0x30, 

/* Symbol 0xCD, offset 3591 */
    10, 16, 0,
    0xC0, 0xC0, 0xC0, 0xC0, 0xC0, 0xC0, 0xC0, 0xC0, 0xC0, 0xC0, 0xC0, 0xC0, 0xFF, 0xC0, 0xFF, 0xC0, 0xC0, 0xC0, 0xC0, 0xC0, 0xC0, 0xC0, 0xC0, 0xC0, 0xC0, 0xC0, 0xC0, 0xC0, 0xC0, 0xC0, 0xC0, 0xC0, 

/* Symbol 0xCE, offset 3626 */
    10, 16, 0,
    0x7F, 0x80, 0xE1, 0xC0, 0xC0, 0xC0, 0xC0, 0xC0, 0xC0, 0xC0, 0xC0, 0xC0, 0xC0, 0xC0, 0xC0, 0xC0, 0xC0, 0xC0, 0xC0, 0xC0, 0xC0, 0xC0, 0xC0, 0xC0, 0xC0, 0xC0, 0xC0, 0xC0, 0xFF, 0xC0, 0x7F, 0x80, 

/* Symbol 0xCF, offset 3661 */
    10, 16, 0,
    0xFF, 0xC0, 0xC0, 0xC0, 0xC0, 0xC0, 0xC0, 0xC0, 0xC0, 0xC0, 0xC0, 0xC0, 0xC0, 0xC0, 0xC0, 0xC0, 0xC0, 0xC0, 0xC0, 0xC0, 0xC0, 0xC0, 0xC0, 0xC0, 0xC0, 0xC0, 0xC0, 0xC0, 0xC0, 0xC0, 0xC0, 0xC0, 

/* Symbol 0xD0, offset 3696 */
    10, 16, 0,
    0xFF, 0x80, 0xC1, 0xC0, 0xC0, 0xC0, 0xC0, 0xC0, 0xC0, 0xC0, 0xC0, 0xC0, 0xC0, 0xC0, 0xC1, 0xC0, 0xFF, 0xC0, 0xC0, 0x00, 0xC0, 0x00, 0xC0, 0x00, 0xC0, 0x00, 0xC0, 0x00, 0xC0, 0x00, 0xC0, 0x00, 

/* Symbol 0xD1, offset 3731 */
    9, 16, 0,
    0x7F, 0x80, 0xE0, 0x00, 0xC0, 0x00, 0xC0, 0x00, 0xC0, 0x00, 0xC0, 0x00, 0xC0, 0x00, 0xC0, 0x00, 0xC0, 0x00, 0xC0, 0x00, 0xC0, 0x00, 0xC0, 0x00, 0xC0, 0x00, 0xC0, 0x00, 0xFF, 0x80, 0x7F, 0x80, 

/* Symbol 0xD2, offset 3766 */
    10, 16, 0,
    0xFF, 0xC0, 0x0C, 0x00, 0x0C, 0x00, 0x0C, 0x00, 0x0C, 0x00, 0x0C, 0x00, 0x0C, 0x00, 0x0C, 0x00, 0x0C, 0x00, 0x0C, 0x00, 0x0C, 0x00, 0x0C, 0x00, 0x0C, 0x00, 0x0C, 0x00, 0x0C, 0x00, 0x0C, 0x00, 

/* Symbol 0xD3, offset 3801 */
    10, 16, 0,
    0xC0, 0xC0, 0xC0, 0xC0, 0xC0, 0xC0, 0xC0, 0xC0, 0xC0, 0xC0, 0xC0, 0xC0, 0xC0, 0xC0, 0xE0, 0xC0, 0x7F, 0xC0, 0x00, 0xC0, 0x00, 0xC0, 0x00, 0xC0, 0x00, 0xC0, 0x00, 0xC0, 0x3F, 0xC0, 0x7F, 0x80, 

/* Symbol 0xD4, offset 3836 */
    14, 16, 0,
    0x07, 0x00, 0x07, 0x00, 0x3F, 0xE0, 0x7F, 0xF0, 0xE7, 0x38, 0xE7, 0x1C, 0xC7, 0x1C, 0xC7, 0x1C, 0xC7, 0x1C, 0xE7, 0x18, 0xF7, 0x38, 0x7F, 0xF0, 0x1F, 0xC0, 0x07, 0x00, 0x07, 0x00, 0x07, 0x00, 

/* Symbol 0xD5, offset 3871 */
    12, 16, 0,
    0xC0, 0x70, 0xE0, 0x70, 0x70, 0xE0, 0x39, 0xC0, 0x39, 0xC0, 0x1F, 0x80, 0x0F, 0x00, 0x0F, 0x00, 0x0F, 0x00, 0x1F, 0x80, 0x1F, 0x80, 0x39, 0xC0, 0x70, 0xC0, 0x70, 0xE0, 0xE0, 0x70, 0xC0, 0x30, 

/* Symbol 0xD6, offset 3906 */
    12, 18, 0,
    0xC0, 0xC0, 0xC0, 0xC0, 0xC0, 0xC0, 0xC0, 0xC0, 0xC0, 0xC0, 0xC0, 0xC0,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 0x70, 

/* Symbol 0xD7, offset 3945 */
    10, 16, 0,
    0xC0, 0xC0, 0xC0, 0xC0, 0xC0, 0xC0, 0xC0, 0xC0, 0xC0, 0xC0, 0xC0, 0xC0, 0xC0, 0xC0, 0xE0, 0xC0, 0x7F, 0xC0, 0x00, 0xC0, 0x00, 0xC0, 0x00, 0xC0, 0x00, 0xC0, 0x00, 0xC0, 0x00, 0xC0, 0x00, 0xC0, 

/* Symbol 0xD8, offset 3980 */
    14, 16, 0,
    0xC7, 0x1C, 0xC7, 0x1C, 0xC7, 0x1C, 0xC7, 0x1C, 0xC7, 0x1C, 0xC7, 0x1C, 0xC7, 0x1C, 0xC7, 0x1C, 0xC7, 0x1C, 0xC7, 0x1C, 0xC7, 0x1C, 0xC7, 0x1C, 0xC7, 0x1C, 0xC7, 0x1C, 0xFF, 0xFC, 0xFF, 0xFC, 

/* Symbol 0xD9, offset 4015 */
    15, 18, 0,
    0xC7, 0x1C, 0xC7, 0x1C, 0xC7, 0x1C, 0xC7, 0x1C, 0xC7, 0x1C, 0xC7, 0x1C,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 0x06, 

/* Symbol 0xDA, offset 4054 */
    14, 16, 0,
    0xFC, 0x00, 0x1C, 0x00, 0x1C, 0x00, 0x1C, 0x00, 0x1C, 0x00, 0x1C, 0x00, 0x1F, 0xF0, 0x1F, 0xF8, 0x1C, 0x1C, 0x1C, 0x1C, 0x1C, 0x1C, 0x1C, 0x1C, 0x1C, 0x1C, 0x1C, 0x1C, 0x1F, 0xF8, 0x1F, 0xF0, 

/* Symbol 0xDB, offset 4089 */
    12, 16, 0,
    0xC0, 0x70, 0xC0, 0x70, 0xC0, 0x70, 0xC0, 0x70, 0xC0, 0x70, 0xC0, 0x70, 0xFE, 0x70, 0xFF, 0x70, 0xC3, 0xF0, 0xC3, 0xF0, 0xC3, 0xF0, 0xC3, 0xF0, 0xC3, 0xF0, 0xC3, 0xF0, 0xFF, 0x70, 0xFE, 0x30, 

/* Symbol 0xDC, offset 4124 */
    10, 16, 0,
    0xC0, 0x00, 0xC0, 0x00, 0xC0, 0x00, 0xC0, 0x00, 0xC0, 0x00, 0xC0, 0x00, 0xFF, 0x80, 0xFF, 0xC0, 0xC0, 0xC0, 0xC0, 0xC0, 0xC0, 0xC0, 0xC0, 0xC0, 0xC0, 0xC0, 0xC0, 0xC0, 0xFF, 0xC0, 0xFF, 0x80, 

/* Symbol 0xDD, offset 4159 */
    10, 16, 0,
    0xFF, 0x80, 0x01, 0xC0, 0x00, 0xC0, 0x00, 0xC0, 0x00, 0xC0, 0x00, 0xC0, 0x1F, 0xC0, 0x1F, 0xC0, 0x00, 0xC0, 0x00, 0xC0, 0x00, 0xC0, 0x00, 0xC0, 0x00, 0xC0, 0x00, 0xC0, 0xFF, 0xC0, 0xFF, 0x80, 

/* Symbol 0xDE, offset 4194 */
    12, 16, 0,
    0xCF, 0xE0, 0xDC, 0x70, 0xDC, 0x70, 0xDC, 0x70, 0xDC, 0x70, 0xDC, 0x70, 0xFC, 0x70, 0xFC, 0x70, 0xDC, 0x70, 0xDC, 0x70, 0xDC, 0x70, 0xDC, 0x70, 0xDC, 0x70, 0xDC, 0x70, 0xDF, 0xF0, 0xCF, 0xE0, 

/* Symbol 0xDF, offset 4229 */
    10, 16, 0,
    0x7F, 0xC0, 0xE0, 0xC0, 0xC0, 0xC0, 0xC0, 0xC0, 0xC0, 0xC0, 0xC0, 0xC0, 0xC0, 0xC0, 0xE0, 0xC0, 0x7F, 0xC0, 0x1C, 0xC0, 0x38, 0xC0, 0x38, 0xC0, 0x70, 0xC0, 0x60, 0xC0, 0xE0, 0xC0, 0xC0, 0xC0, 

/* Symbol 0xE0, offset 4264 */
    11, 16, 5,
    0x7F, 0x80, 0xE3, 0x80, 0xC3, 0x80, 0xC3, 0x80, 0xC3, 0x80, 0xC3, 0x80, 0xC3, 0x80, 0xC3, 0x80, 0xC3, 0x80, 0xFF, 0xC0, 0x7E, 0xE0, 

/* Symbol 0xE1, offset 4289 */
    9, 16, 0,
    0xFF, 0x80, 0xF0, 0x00, 0x78, 0x00, 0x3C, 0x00, 0x0E, 0x00, 0x7F, 0x00, 0xE3, 0x80, 0xC3, 0x80, 0xC3, 0x80, 0xC3, 0x80, 0xC3, 0x80, 0xC3, 0x80, 0xC3, 0x80, 0xC3, 0x80, 0xFF, 0x00, 0x7E, 0x00, 

/* Symbol 0xE2, offset 4324 */
    9, 16, 0,
    0xFC, 0x00, 0xFC, 0x00, 0xCE, 0x00, 0xDC, 0x00, 0xFC, 0x00, 0xFF, 0x00, 0xE3, 0x80, 0xC3, 0x80, 0xC3, 0x80, 0xC3, 0x80, 0xC3, 0x80, 0xC3, 0x80, 0xC3, 0x80, 0xC3, 0x80, 0xFF, 0x00, 0x7E, 0x00, 

/* Symbol 0xE3, offset 4359 */
    9, 16, 5,
    0xFF, 0x00, 0xE7, 0x80, 0x03, 0x80, 0x07, 0x00, 0x1E, 0x00, 0x3C, 0x00, 0x70, 0x00, 0xE0, 0x00, 0xC0, 0x00, 0xFF, 0x80, 0x7F, 0x00, 

/* Symbol 0xE4, offset 4384 */
    9, 16, 0,
    0xFF, 0x00, 0x07, 0x80, 0x03, 0x80, 0x03, 0x80, 0x03, 0x80, 0x7F, 0x80, 0xE3, 0x80, 0xC3, 0x80, 0xC3, 0x80, 0xC3, 0x80, 0xC3, 0x80, 0xC3, 0x80, 0xC3, 0x80, 0xC3, 0x80, 0xFF, 0x00, 0x7E, 0x00, 

/* Symbol 0xE5, offset 4419 */
    9, 16, 5,
    0x7F, 0x00, 0xE3, 0x80, 0xC3, 0x80, 0xC3, 0x80, 0xFF, 0x80, 0xFF, 0x80, 0xC0, 0x00, 0xC0, 0x00, 0xC0, 0x00, 0xFF, 0x80, 0x7F, 0x80, 

/* Symbol 0xE6, offset 4444 */
    12, 16, 4,
    0x80, 0x60, 0xCE, 0x70, 0xEE, 0xE0, 0x7E, 0xE0, 0x7F, 0xC0, 0x3F, 0x80, 0x3F, 0x80, 0x3F, 0xC0, 0x7F, 0xC0, 0xEE, 0xE0, 0xEE, 0x70, 0xCE, 0x70, 

/* Symbol 0xE7, offset 4471 */
    8, 16, 5,
    0xFE, 0xC7, 0x07, 0x07, 0x1F, 0x3E, 0x07, 0x07, 0xC7, 0xFF, 0x7E, 

/* Symbol 0xE8, offset 4485 */
    9, 16, 5,
    0xC3, 0x80, 0xC3, 0x80, 0xC3, 0x80, 0xC3, 0x80, 0xC3, 0x80, 0xC3, 0x80, 0xC3, 0x80, 0xC3, 0x80, 0xC3, 0x80, 0xFF, 0x80, 0x7F, 0x80, 

/* Symbol 0xE9, offset 4510 */
    9, 16, 0,
    0x7E, 0x00, 0x00, 0x00, 0x00, 0x00, 0x00, 0x00, 0x00, 0x00, 0xC3, 0x80, 0xC3, 0x80, 0xC3, 0x80, 0xC3, 0x80, 0xC3, 0x80, 0xC3, 0x80, 0xC3, 0x80, 0xC3, 0x80, 0xC3, 0x80, 0xFF, 0x80, 0x7F, 0x80, 

/* Symbol 0xEA, offset 4545 */
    9, 16, 4,
    0x03, 0x00, 0xC3, 0x80, 0xC7, 0x00, 0xCE, 0x00, 0xDC, 0x00, 0xF8, 0x00, 0xFC, 0x00, 0xEC, 0x00, 0xCE, 0x00, 0xC7, 0x00, 0xC7, 0x00, 0xC3, 0x80, 

/* Symbol 0xEB, offset 4572 */
    9, 16, 5,
    0x1F, 0x80, 0x3B, 0x80, 0x3B, 0x80, 0x3B, 0x80, 0x73, 0x80, 0x73, 0x80, 0x73, 0x80, 0xE3, 0x80, 0xE3, 0x80, 0xE3, 0x80, 0xC3, 0x80, 

/* Symbol 0xEC, offset 4597 */
    10, 16, 4,
    0xC0, 0xC0, 0xE0, 0xC0, 0xE1, 0xC0, 0xF3, 0xC0, 0xFF, 0xC0, 0xFF, 0xC0, 0xDE, 0xC0, 0xCC, 0xC0, 0xC0, 0xC0, 0xC0, 0xC0, 0xC0, 0xC0, 0xC0, 0xC0, 

/* Symbol 0xED, offset 4624 */
    9, 16, 5,
    0xC3, 0x80, 0xC3, 0x80, 0xC3, 0x80, 0xC3, 0x80, 0xFF, 0x80, 0xFF, 0x80, 0xC3, 0x80, 0xC3, 0x80, 0xC3, 0x80, 0xC3, 0x80, 0xC3, 0x80, 

/* Symbol 0xEE, offset 4649 */
    9, 16, 5,
    0x7F, 0x00, 0xE7, 0x00, 0xC3, 0x80, 0xC3, 0x80, 0xC3, 0x80, 0xC3, 0x80, 0xC3, 0x80, 0xC3, 0x80, 0xE3, 0x80, 0xFF, 0x00, 0x7E, 0x00, 

/* Symbol 0xEF, offset 4674 */
    9, 16, 5,
    0xFF, 0x00, 0xC3, 0x80, 0xC3, 0x80, 0xC3, 0x80, 0xC3, 0x80, 0xC3, 0x80, 0xC3, 0x80, 0xC3, 0x80, 0xC3, 0x80, 0xC3, 0x80, 0xC3, 0x80, 

/* Symbol 0xF0, offset 4699 */
    9, 21, 5,
    0xFF, 0x00, 0xC3, 0x80, 0xC3, 0x80, 0xC3, 0x80, 0xC3, 0x80, 0xC3, 0x80, 0xC3, 0x80, 0xC3, 0x80, 0xC3, 0x80, 0xFF, 0x00, 0xFE, 0x00, 0xC0, 0x00, 0xC0, 0x00, 0xC0, 0x00, 0xC0, 0x00, 0xC0, 0x00, 

/* Symbol 0xF1, offset 4734 */
    7, 16, 5,
    0x7E, 0xE0, 0xC0, 0xC0, 0xC0, 0xC0, 0xC0, 0xC0, 0xC0, 0xFE, 0x7E, 

/* Symbol 0xF2, offset 4748 */
    12, 16, 5,
    0xFF, 0xE0, 0xC6, 0x70, 0xC6, 0x70, 0xC6, 0x70, 0xC6, 0x70, 0xC6, 0x70, 0xC6, 0x70, 0xC6, 0x70, 0xC6, 0x70, 0xC6, 0x70, 0xC6, 0x30, 

/* Symbol 0xF3, offset 4773 */
    9, 21, 5,
    0xC3, 0x80, 0xC3, 0x80, 0xC3, 0x80, 0xC3, 0x80, 0xC3, 0x80, 0xC3, 0x80, 0xC3, 0x80, 0xC3, 0x80, 0xC3, 0x80, 0xFF, 0x80, 0x7F, 0x80, 0x03, 0x80, 0x03, 0x80, 0x03, 0x80, 0x7F, 0x00, 0xFE, 0x00, 

/* Symbol 0xF4, offset 4808 */
    12, 21, 1,
    0x06, 0x00, 0x06, 0x00, 0x06, 0x00, 0x06, 0x00, 0x3F, 0xC0, 0x76, 0xE0,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 0x00, 

/* Symbol 0xF5, offset 4851 */
    9, 16, 4,
    0x03, 0x00, 0xE3, 0x80, 0xE7, 0x00, 0x77, 0x00, 0x3E, 0x00, 0x3C, 0x00, 0x1C, 0x00, 0x3E, 0x00, 0x7E, 0x00, 0x77, 0x00, 0xE3, 0x80, 0xC3, 0x80, 

/* Symbol 0xF6, offset 4878 */
    10, 17, 5,
    0xC3, 0x80, 0xC3, 0x80, 0xC3, 0x80, 0xC3, 0x80, 0xC3, 0x80, 0xC3, 0x80, 0xC3, 0x80, 0xC3, 0x80, 0xC3, 0x80, 0xFF, 0xC0, 0x7F, 0xC0, 0x00, 0xC0, 

/* Symbol 0xF7, offset 4905 */
    9, 16, 5,
    0xC3, 0x80, 0xC3, 0x80, 0xC3, 0x80, 0xC3, 0x80, 0xFF, 0x80, 0x7F, 0x80, 0x03, 0x80, 0x03, 0x80, 0x03, 0x80, 0x03, 0x80, 0x03, 0x80, 

/* Symbol 0xF8, offset 4930 */
    12, 16, 5,
    0xC6, 0x70, 0xC6, 0x70, 0xC6, 0x70, 0xC6, 0x70, 0xC6, 0x70, 0xC6, 0x70, 0xC6, 0x70, 0xC6, 0x70, 0xC6, 0x70, 0xFF, 0xF0, 0x7F, 0xF0, 

/* Symbol 0xF9, offset 4955 */
    14, 18, 5,
    0xC6, 0x70, 0xC6, 0x70, 0xC6, 0x70, 0xC6, 0x70, 0xC6, 0x70, 0xC6, 0x70, 0xC6, 0x70, 0xC6, 0x70, 0xC6, 0x70, 0xFF, 0xF8, 0x7F, 0xFC, 0x00, 0x1C, 0x00, 0x18, 

/* Symbol 0xFA, offset 4984 */
    10, 16, 5,
    0xE0, 0x00, 0xE0, 0x00, 0xE0, 0x00, 0xE0, 0x00, 0xFE, 0x00, 0xFF, 0x80, 0xE1, 0x80, 0xE1, 0xC0, 0xE1, 0xC0, 0xFF, 0x80, 0x7F, 0x00, 

/* Symbol 0xFB, offset 5009 */
    10, 16, 5,
    0xC0, 0xC0, 0xC0, 0xC0, 0xC0, 0xC0, 0xC0, 0xC0, 0xF8, 0xC0, 0xFC, 0xC0, 0xCE, 0xC0, 0xC6, 0xC0, 0xCE, 0xC0, 0xFE, 0xC0, 0xFC, 0xC0, 

/* Symbol 0xFC, offset 5034 */
    9, 16, 5,
    0xC0, 0x00, 0xC0, 0x00, 0xC0, 0x00, 0xC0, 0x00, 0xFC, 0x00, 0xFF, 0x00, 0xC3, 0x80, 0xC3, 0x80, 0xC3, 0x80, 0xFF, 0x00, 0xFE, 0x00, 

/* Symbol 0xFD, offset 5059 */
    9, 16, 5,
    0xFF, 0x00, 0x03, 0x80, 0x03, 0x80, 0x03, 0x80, 0x1F, 0x80, 0x1F, 0x80, 0x03, 0x80, 0x03, 0x80, 0x03, 0x80, 0xFF, 0x00, 0xFE, 0x00, 

/* Symbol 0xFE, offset 5084 */
    10, 16, 5,
    0xCF, 0xC0, 0xDC, 0xC0, 0xDC, 0xC0, 0xDC, 0xC0, 0xFC, 0xC0, 0xFC, 0xC0, 0xDC, 0xC0, 0xDC, 0xC0, 0xDC, 0xC0, 0xDF, 0xC0, 0xCF, 0x80, 

/* Symbol 0xFF, offset 5109 */
    9, 16, 5,
    0x7F, 0x80, 0xE3, 0x80, 0xC3, 0x80, 0xC3, 0x80, 0xFF, 0x80, 0x7F, 0x80, 0x3B, 0x80, 0x73, 0x80, 0x73, 0x80, 0xE3, 0x80, 0xC3, 0x80
};
